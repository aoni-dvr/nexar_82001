## ambalinux_sdk/ambarella/package/Config.in
```kconfig
menu "Local packages"
comment "Local packages use recipies maintained under ambarella/"
source "ambarella/package/ipcdef/Config.in"
source "ambarella/package/ambaipc/Config.in"
source "ambarella/package/ambamal/Config.in"
source "ambarella/package/ambacv/Config.in"
source "ambarella/package/hostapi/Config.in"
source "ambarella/package/ambaipc_test/Config.in"
source "ambarella/package/ambaipc_util/Config.in"
source "ambarella/package/network_turnkey/Config.in"
source "ambarella/package/amba_util/Config.in"
source "ambarella/package/amba_examples/Config.in"
source "ambarella/package/eva/Config.in"
source "ambarella/package/ambacomm/Config.in"
source "ambarella/package/commprocess/Config.in"
source "ambarella/package/rtsp_server/Config.in"
source "ambarella/package/basic_usage_environment/Config.in"
source "ambarella/package/usage_environment/Config.in"
source "ambarella/package/groupsock/Config.in"
source "ambarella/package/live_media/Config.in"
source "ambarella/package/cavalry_lib/Config.in"
source "ambarella/package/cavalry_test/Config.in"
source "ambarella/package/amba_camera/Config.in"
source "ambarella/package/amba_tvm/Config.in"
source "ambarella/package/ambavx/Config.in"
source "ambarella/package/amba_dram_statis/Config.in"

menu "Data Distribution Service (DDS)"
source "ambarella/package/cyclonedds/Config.in"
source "ambarella/package/fast-dds/Config.in"
source "ambarella/package/asio/Config.in"
source "ambarella/package/fast-cdr/Config.in"
source "ambarella/package/foonathan-memory/Config.in"
source "ambarella/package/opendds/Config.in"
source "ambarella/package/ace_tao/Config.in"
endmenu # DDS

source "ambarella/package/amba_http_server/Config.in"
source "ambarella/package/qflash/Config.in"
source "ambarella/package/quectel-gnss-fota/Config.in"
source "ambarella/package/qconnect_manager/Config.in"
source "ambarella/package/qfirehose/Config.in"
source "ambarella/package/http_control_server/Config.in"
endmenu

menu "Ambarella external packages"
comment "External SDK from Other vendors like Atheros/Realtek/Broadcom/Marvell"
source "ambarella/package/external_sdk/Config.in"
endmenu

config BR2_AMBARELLA_AUTOHIBER
	bool "Auto hibernation at bootup"
	default y
	help
	  Enabling the option will automatically hibernate at cold boot.

config BR2_AMBARELLA_LINUX_TTY
	string "Character device to use as console?"
	default ""
	help
	  tty device used for linux console

config BR2_AMBARELLA_LINUX_RESPAWN_SH
	bool "Put a getty on the serial port?"
	default y
	help
	  Do not enable this if you do not have a linux UART

config BR2_AMBARELLA_SIMPLE_RCS
	bool "Run a minimum init script"
	default n
	help
	  Enable this if you want to run a minimum system init
```

## ambalinux_sdk/ambarella/package/ace_tao/Config.in
```kconfig
config BR2_PACKAGE_ACE_TAO
	bool
	default n
	help
	  ACE (the ADAPTIVE Communication Environment) +
	  TAO (The ACE ORB) -- C++, CORBA-compliant object request broker (ORB)
	  Not be built but used by OpenDDS.
```

## ambalinux_sdk/ambarella/package/ai_cam_app/Config.in
```kconfig
config BR2_PACKAGE_AI_CAM_APP
	tristate "AI Sample App"
	select BR2_PACKAGE_JPEG
	help
	  AI Sample App.

if BR2_PACKAGE_AI_CAM_APP

config BR2_PACKAGE_AI_CAM_LIB_PREBUILT
	bool "Prebuilt library"
	depends on !BR2_PACKAGE_AI_CAM_LIB
	default y
	help
	  Using Prebuilt library.
endif
```

## ambalinux_sdk/ambarella/package/ai_cam_lib/Config.in
```kconfig
config BR2_PACKAGE_AI_CAM_LIB
	bool "AI Libraries"
	default n
	help
	  AI Libraries.
```

## ambalinux_sdk/ambarella/package/amba_camera/Config.in
```kconfig
menu "Amba Camera"

config BR2_PACKAGE_AMBA_CAMERA
	bool "amba_camera"
	help
	  This is the Amba Camera Package

if BR2_PACKAGE_AMBA_CAMERA

config BR2_PACKAGE_AMBA_CAMERA_AUTOSTART
	bool "Auto start amba_svc during bootup"
	default y

config BR2_PACKAGE_AMBA_CAMERA_SOURCE
	string "amba camera source"
	default "$(TOPDIR)/../pkg/amba_camera/cortex_a/"
	help
	  defconfig file.
	  It's absolute path.

config BR2_PACKAGE_AMBA_CAMERA_DEFCONFIG
	string "amba camera defconfig"
	default "$(TOPDIR)/../pkg/amba_camera/cortex_a/configs/cv22/cv22_svc_cv_ut_defconfig"
	help
	  defconfig file.
	  It's absolute path.

config BR2_PACKAGE_AMBA_CAMERA_KCONFIG
	string "amba camera Kconfig"
	default "svc/build/linux/Kconfig.Linux"
	help
	  First Kconfig file
	  Relative to root of amba_camera/cortex_a

config BR2_PACKAGE_AMBA_CAMERA_AMBA_MKFILE
	string "amba camera Makefile.Amba"
	default "svc/build/linux/Makefile.Amba"
	help
	  Path of Makefile.Amba
	  Relative to root of amba_camera/cortex_a


config BR2_PACKAGE_AMBA_CAMERA_OOSB
	bool
	default y
	help
	  Out-of-Source Building, i.e.
	  compile amba camera with "O=" option.
	  So that it will skip to rsync source to output folder,
	  and put object files to output folder.

config BR2_PACKAGE_AMBA_CAMERA_DIAGS
	bool "amba camera diags"
	default y
	help
	  Do "make diags" before "make".
	  Used for project who need to make diags

config BR2_PACKAGE_AMBA_CAMERA_DIAGS_LIB
	bool "amba camera diags_lib"
	default n
	help
	  Do "make diags_lib" before "make".
	  Used for project who need to make diags_lib

config BR2_PACKAGE_AMBA_CAMERA_BRIDGE_SENSOR
	string "build sensor or bridge"
	help
	  copy eva-only bridge file for sensor or radar

config BR2_PACKAGE_AMBA_CAMERA_SYSLOGD_PARAMS
	string "syslogd parameters"
	default ""
	help
	  syslogd parameters

endif # BR2_PACKAGE_AMBA_CAMERA

endmenu
```

## ambalinux_sdk/ambarella/package/amba_dram_statis/Config.in
```kconfig
config BR2_PACKAGE_AMBA_DRAM_STATIS
    bool "Build Ambarella private DRAM Statistics Driver"
    default n
    help
        Build Ambarella private DRAM statistics driver for Linux.

choice
	prompt "Ambarella_Architectue"
	default AMBARELLA_ARCH_CV3
    depends on BR2_PACKAGE_AMBA_DRAM_STATIS
	help
	  Choose Ambarella Architecture

config AMBARELLA_ARCH_CV3
	bool "AMBARELLA_ARCH_CV3"
	help
	  CV3x chip

config AMBARELLA_ARCH_CV5
	bool "AMBARELLA_ARCH_CV5"
	help
	  CV5x chip

endchoice # AMBARELLA_ARCH

config AMBARELLA_ARCH
	string
	default "cv3" if AMBARELLA_ARCH_CV3
	default "cv5" if AMBARELLA_ARCH_CV5

config AMBA_DRAM_STATIS_DRV
	string
	default "m" if BR2_PACKAGE_AMBA_DRAM_STATIS

menu "DRAM Statistics output"
    depends on BR2_PACKAGE_AMBA_DRAM_STATIS

endmenu
```

## ambalinux_sdk/ambarella/package/amba_examples/Config.in
```kconfig
menuconfig BR2_PACKAGE_AMBA_EXAMPLES
	bool "amba_examples"
	help
	  This is the Examples for Amba libraries.

config BR2_PACKAGE_AMBA_EVENTNOTIFIER_EXAMPLE
	bool "amba_eventnotifier_example"
	default y
	depends on BR2_PACKAGE_AMBA_EXAMPLES && BR2_PACKAGE_AMBAIPC
	help
	  This is the Example for Amba Event Notificatier.

config BR2_PACKAGE_AMBA_TRANSFER_EXAMPLE
	bool "amba_transfer_example"
	default y
	depends on BR2_PACKAGE_AMBA_EXAMPLES && BR2_PACKAGE_AMBAIPC
	help
	  This is the Example for Amba Transfer.

config BR2_PACKAGE_AMBA_FLEXIDAGIO_EXAMPLE
	bool "amba_flexidagio_example"
	default y
	depends on BR2_PACKAGE_AMBA_EXAMPLES
	help
	  This is the Example for Amba FlexidagIO.

config BR2_PACKAGE_AMBA_EXAMPLE_FRAMER
	bool "amba_example_framer"
	default y
	depends on BR2_PACKAGE_AMBA_EXAMPLES  && BR2_PACKAGE_AMBAIPC
	help
	  This is the Example for Amba NetFiFo.

config BR2_PACKAGE_AMBA_EXAMPLE_SOCKET_CLIENT
	bool "example_socket_client"
	default y if BR2_PACKAGE_AMBAMAL
	default n
	depends on BR2_PACKAGE_AMBA_EXAMPLES && BR2_PACKAGE_AMBAMAL
	help
	  This is the Example for Amba socket client.


config BR2_PACKAGE_AMBA_EXAMPLE_SHAREPREVIEW
	bool "amba_example_sharepreview"
	default y
	depends on BR2_PACKAGE_AMBA_EXAMPLES  && BR2_PACKAGE_AMBAIPC
	help
	  This is the Example to share Preview data with Linux for APPLib/VA.

config BR2_PACKAGE_AMBA_EXAMPLE_RTOS_API
	bool "example_rtos_api"
	default y
	depends on BR2_PACKAGE_AMBA_EXAMPLES
	help
	  This is the Example for rtos api

config BR2_PACKAGE_AMBA_EXAMPLE_FRAMESHARE
	bool "amba_example_frameshare"
	default y
	depends on BR2_PACKAGE_AMBA_EXAMPLES  && BR2_PACKAGE_AMBAIPC
	help
	  This is the Example to share Frame data with Linux for SSP.

config BR2_PACKAGE_AMBA_EXAMPLE_STREAMIN
	bool "amba_example_streamin"
	default y
	depends on BR2_PACKAGE_AMBA_EXAMPLES && BR2_PACKAGE_AMBAIPC
	help
	  This is the Example for feed frame data to RTOS through Amba NetFifo

config BR2_PACKAGE_AMBA_EXAMPLE_CAMCTRL_SERVER
	bool "amba_example_camctrl_server"
	default n
	depends on BR2_PACKAGE_AMBA_EXAMPLES && BR2_PACKAGE_AMBAIPC
	help
	  This is the Example to send camctrl message.

config BR2_PACKAGE_AMBA_EXAMPLE_AMBAPRINT
	bool "amba_example_ambaprint"
	default n
	depends on BR2_PACKAGE_AMBA_EXAMPLES
	help
	  This is the Example to handle AmbaPrint message.

config BR2_PACKAGE_AMBA_EXAMPLE_AMBAPRINT_TTY
	string "set tty port for amba print"
	default "/dev/ttyS1"
	depends on BR2_PACKAGE_AMBA_EXAMPLE_AMBAPRINT
	help
	  Set tty port (= UART port+1).

config BR2_PACKAGE_AMBA_EXAMPLE_BBXHANDLER
	bool "amba_example_bbxhandler"
	default n
	depends on BR2_PACKAGE_AMBA_EXAMPLES && BR2_PACKAGE_AMBAIPC
	help
	  This is the Example for Amba Bounding Box handler library.

config BR2_PACKAGE_AMBA_EXAMPLE_OSDDRAW
	bool "amba_example_osddraw"
	default n
	depends on BR2_PACKAGE_AMBA_EXAMPLES && BR2_PACKAGE_AMBAIPC
	help
	  This is the Example to generate osd buffer by opencv.

config BR2_PACKAGE_AMBA_EXAMPLE_FRAMESHARE_RTSP
	bool "amba_example_frameshare_rtsp"
	default n
	depends on ((BR2_PACKAGE_AMBA_EXAMPLES && BR2_PACKAGE_AMBAIPC) || (BR2_PACKAGE_AMBA_EXAMPLES && BR2_PACKAGE_AMBA_CAMERA))

config BR2_PACKAGE_AMBA_EXAMPLE_ROMFS
	bool "amba_example_romfs"
	default n
	depends on BR2_PACKAGE_AMBA_EXAMPLES
	help
	  This is the Example code to access RTOS romfs


config BR2_PACKAGE_AMBA_EXAMPLE_AUDIO
	bool "amba_example_audio"
	default n
	depends on BR2_PACKAGE_AMBA_EXAMPLES
	help
	  This is the Example code to access audio service
```

## ambalinux_sdk/ambarella/package/amba_http_server/Config.in
```kconfig
menuconfig BR2_PACKAGE_AMBA_HTTP_SERVER
	bool "amba_http_server"
	help
	  This is the Examples of httpd server for app download.
```

## ambalinux_sdk/ambarella/package/amba_netcontrol/Config.in
```kconfig
menuconfig BR2_PACKAGE_AMBA_NETCONTROL
	bool "amba_netcontrol"
	default n
	help
		Enable the net control flow.

	menuconfig BR2_PACKAGE_AMBA_NETCONTROL_WIFI
		bool "Add WiFi support"
	        default y
		depends on BR2_PACKAGE_AMBA_NETCONTROL
		help
			Add WiFi support into amba_netcontrol

		config BR2_PACKAGE_AMBA_NETCONTROL_WIFI_CMD
			bool "Add WiFi support for CMD"
	                default y
			depends on BR2_PACKAGE_AMBA_NETCONTROL_WIFI
			help
				Add WiFi support into amba_netcontrol_cmd
		config BR2_PACKAGE_AMBA_NETCONTROL_WIFI_DATA
			bool "Add WiFi support for DATA"
	                default y
			depends on BR2_PACKAGE_AMBA_NETCONTROL_WIFI
			help
				Add WiFi support into amba_netcontrol_data
	menuconfig BR2_PACKAGE_AMBA_NETCONTROL_BT
		bool "Add bluetooth support"
	        default n
		depends on BR2_PACKAGE_AMBA_NETCONTROL
		help
			Add bluetooth support into amba_netcontrol
			comment "Need BlueZ utilities to support network message for handling BT."
			depends on !(BR2_PACKAGE_BLUEZ_UTILS || BR2_PACKAGE_BLUEZ5_UTILS)
		config BR2_PACKAGE_AMBA_NETCONTROL_BT_CMD
			bool "Add bluetooth support for CMD"
	                default n
			depends on BR2_PACKAGE_AMBA_NETCONTROL_BT
			help
				Add bluetooth support into amba_netcontrol_cmd
		config BR2_PACKAGE_AMBA_NETCONTROL_BT_DATA
			bool "Add bluetooth support for DATA"
	                default n
			depends on BR2_PACKAGE_AMBA_NETCONTROL_BT
			help
				Add bluetooth support into amba_netcontrol_data
```

## ambalinux_sdk/ambarella/package/amba_netcontrol_util/Config.in
```kconfig
menuconfig BR2_PACKAGE_AMBA_NETCONTROL_UTIL
	bool "amba_netcontrol_util"
	help
	  Enable the net control flow utility.
```

## ambalinux_sdk/ambarella/package/amba_rtsp/Config.in
```kconfig
menuconfig BR2_PACKAGE_AMBA_RTSP
	bool "amba_rtsp"
	help
	  This is Amba's implementation for RTSP Service.
```

## ambalinux_sdk/ambarella/package/amba_rtsp_client/Config.in
```kconfig
menuconfig BR2_PACKAGE_AMBA_RTSP_CLIENT
	bool "amba_rtsp_client"
	help
	  This is Amba's implementation for RTSP client.
```

## ambalinux_sdk/ambarella/package/amba_tvm/Config.in
```kconfig
menuconfig BR2_PACKAGE_AMBA_TVM
	bool "Build Ambarella TVM library"
	default n
	help
		Build Ambarella TVM library

config BR2_PACKAGE_AMBA_DLR_ROOT_DIR
	string "Ambarella DLR root directory"
	default ""
	depends on BR2_PACKAGE_AMBA_TVM
```
