## ambalinux_sdk/ambarella/configs/cv3_linux_bub_dsput_spinand_defconfig
```kconfig
BR2_aarch64=y
BR2_cortex_a78=y
BR2_DL_DIR="$(TOPDIR)/../dl"
BR2_JLEVEL=4
BR2_PACKAGE_OVERRIDE_FILE="ambarella/local.mk"
BR2_TOOLCHAIN_EXTERNAL=y
BR2_TOOLCHAIN_EXTERNAL_CUSTOM=y
BR2_TOOLCHAIN_EXTERNAL_DOWNLOAD=y
BR2_TOOLCHAIN_EXTERNAL_URL="http://buildroot.ambarella.com/buildroot/dl/toolchain-external-custom/cortex-a76-2022.08-gcc12.1-linux5.15-x86_64.tar.xz"
BR2_TOOLCHAIN_EXTERNAL_CUSTOM_PREFIX="$(ARCH)-linux-gnu"
BR2_TOOLCHAIN_EXTERNAL_HEADERS_5_15=y
BR2_TOOLCHAIN_EXTERNAL_CUSTOM_GLIBC=y
# BR2_TOOLCHAIN_EXTERNAL_INET_RPC is not set
BR2_TOOLCHAIN_EXTERNAL_CXX=y
BR2_TOOLCHAIN_EXTERNAL_OPENMP=y
BR2_TARGET_OPTIMIZATION="-mcpu=cortex-a78+crypto "
BR2_ROOTFS_SKELETON_CUSTOM=y
BR2_ROOTFS_SKELETON_CUSTOM_PATH="ambarella/package/ambarella_customize/source/skeleton"
BR2_ROOTFS_DEVICE_CREATION_DYNAMIC_MDEV=y
BR2_ROOTFS_DEVICE_TABLE="ambarella/package/ambarella_customize/source/device_table.txt"
BR2_ROOTFS_POST_BUILD_SCRIPT="ambarella/package/ambarella_customize/scripts/amba_camera_post_build.sh"
BR2_LINUX_KERNEL=y
BR2_LINUX_KERNEL_USE_CUSTOM_CONFIG=y
BR2_LINUX_KERNEL_CUSTOM_CONFIG_FILE="$(LINUX_OVERRIDE_SRCDIR)/arch/arm64/configs/ambarella_cv3_defconfig"
BR2_PACKAGE_BUSYBOX_CONFIG="ambarella/package/ambarella_customize/config/busybox.config"
BR2_PACKAGE_BUSYBOX_SHOW_OTHERS=y
BR2_PACKAGE_ALSA_UTILS=y
BR2_PACKAGE_ALSA_UTILS_APLAY=y
BR2_PACKAGE_CACHE_CALIBRATOR=y
BR2_PACKAGE_IOZONE=y
BR2_PACKAGE_MEMSTAT=y
BR2_PACKAGE_RAMSMP=y
BR2_PACKAGE_STRACE=y
BR2_PACKAGE_STRESS=y
BR2_PACKAGE_TINYMEMBENCH=y
BR2_PACKAGE_MTD=y
BR2_PACKAGE_MTD_MKFSJFFS2=y
BR2_PACKAGE_MTD_MKFSUBIFS=y
BR2_PACKAGE_MEMTESTER=y
BR2_PACKAGE_OPENSSL=y
BR2_PACKAGE_DTC=y
BR2_PACKAGE_DTC_PROGRAMS=y
BR2_PACKAGE_LIBSOCKETCAN=y
BR2_PACKAGE_HAVEGED=y
BR2_PACKAGE_CAN_UTILS=y
BR2_PACKAGE_ETHTOOL=y
BR2_PACKAGE_IPERF=y
BR2_PACKAGE_IPROUTE2=y
BR2_PACKAGE_LINUXPTP=y
BR2_PACKAGE_OPENSSH=y
# BR2_PACKAGE_URANDOM_SCRIPTS is not set
BR2_TARGET_ROOTFS_SQUASHFS=y
BR2_TARGET_ROOTFS_SQUASHFS4_LZO=y
# BR2_TARGET_ROOTFS_TAR is not set
BR2_TARGET_ROOTFS_UBI=y
BR2_TARGET_ROOTFS_UBI_SUBSIZE=2048
BR2_TARGET_ROOTFS_UBI_USE_CUSTOM_CONFIG=y
BR2_TARGET_ROOTFS_UBI_CUSTOM_CONFIG_FILE="ambarella/fs/ubifs/ubinize-ambarella.cfg"
BR2_TARGET_ROOTFS_UBIFS_LEBSIZE=0x1f000
BR2_TARGET_ROOTFS_UBIFS_MAXLEBCNT=2047
BR2_TARGET_ROOTFS_UBIFS_RT_ZLIB=y
BR2_TARGET_ROOTFS_UBIFS_GZIP=y
BR2_LINUX_KERNEL_CUSTOM_LOCAL=y
BR2_AMBARELLA_LINUX_5_15=y
# BR2_PACKAGE_IPCDEF is not set
# BR2_PACKAGE_AMBAIPC is not set
# BR2_PACKAGE_AMBAIPC_TEST is not set
# BR2_PACKAGE_AMBAIPC_UTIL is not set
BR2_PACKAGE_AMBA_EXAMPLES=y
BR2_PACKAGE_AMBA_EXAMPLE_AMBAPRINT=y
BR2_PACKAGE_AMBA_EXAMPLE_AUDIO=y
BR2_PACKAGE_AMBA_CAMERA=y
BR2_PACKAGE_AMBA_CAMERA_SOURCE="../../rtos/cortex_a"
BR2_PACKAGE_AMBA_CAMERA_DEFCONFIG="../../rtos/cortex_a/configs/cv3x/dsput/linux/cv3dev_linux_bub_dsput_spinand_defconfig"
BR2_PACKAGE_AMBA_DRAM_STATIS=y
BR2_PACKAGE_AMBAGPU=y
# BR2_AMBARELLA_AUTOHIBER is not set
BR2_PACKAGE_AMBAMAL=y
```

## ambalinux_sdk/ambarella/configs/cv3_linux_dk_eva_cv_spinor_cvapiv7_clusters_defconfig
```kconfig
BR2_aarch64=y
BR2_cortex_a78=y
BR2_DL_DIR="$(TOPDIR)/../dl"
BR2_JLEVEL=4
BR2_PACKAGE_OVERRIDE_FILE="ambarella/local.mk"
BR2_TOOLCHAIN_EXTERNAL=y
BR2_TOOLCHAIN_EXTERNAL_CUSTOM=y
BR2_TOOLCHAIN_EXTERNAL_DOWNLOAD=y
BR2_TOOLCHAIN_EXTERNAL_URL="http://buildroot.ambarella.com/buildroot/dl/toolchain-external-custom/cortex-a76-2022.08-gcc12.1-linux5.15-x86_64.tar.xz"
BR2_TOOLCHAIN_EXTERNAL_CUSTOM_PREFIX="$(ARCH)-linux-gnu"
BR2_TOOLCHAIN_EXTERNAL_HEADERS_5_15=y
BR2_TOOLCHAIN_EXTERNAL_CUSTOM_GLIBC=y
# BR2_TOOLCHAIN_EXTERNAL_INET_RPC is not set
BR2_TOOLCHAIN_EXTERNAL_CXX=y
BR2_TOOLCHAIN_EXTERNAL_OPENMP=y
BR2_TARGET_OPTIMIZATION="-mcpu=cortex-a78+crypto "
BR2_ROOTFS_SKELETON_CUSTOM=y
BR2_ROOTFS_SKELETON_CUSTOM_PATH="ambarella/package/ambarella_customize/source/skeleton"
BR2_ROOTFS_DEVICE_CREATION_DYNAMIC_MDEV=y
BR2_ROOTFS_DEVICE_TABLE="ambarella/package/ambarella_customize/source/device_table.txt"
BR2_ROOTFS_POST_BUILD_SCRIPT="ambarella/package/ambarella_customize/scripts/amba_eva_dk_post_build.sh"
BR2_LINUX_KERNEL=y
BR2_LINUX_KERNEL_USE_CUSTOM_CONFIG=y
BR2_LINUX_KERNEL_CUSTOM_CONFIG_FILE="$(LINUX_OVERRIDE_SRCDIR)/arch/arm64/configs/ambarella_cv3_eva_cpio_defconfig"
BR2_PACKAGE_BUSYBOX_CONFIG="ambarella/package/ambarella_customize/config/busybox.config"
BR2_PACKAGE_BUSYBOX_SHOW_OTHERS=y
BR2_PACKAGE_CACHE_CALIBRATOR=y
BR2_PACKAGE_IOZONE=y
BR2_PACKAGE_MEMSTAT=y
BR2_PACKAGE_RAMSMP=y
BR2_PACKAGE_SPIDEV_TEST=y
BR2_PACKAGE_STRACE=y
BR2_PACKAGE_STRESS=y
BR2_PACKAGE_TINYMEMBENCH=y
BR2_PACKAGE_MTD=y
BR2_PACKAGE_MTD_MKFSJFFS2=y
BR2_PACKAGE_MTD_MKFSUBIFS=y
BR2_PACKAGE_NFS_UTILS=y
BR2_PACKAGE_MEMTESTER=y
BR2_PACKAGE_SPI_TOOLS=y
BR2_PACKAGE_OPENSSL=y
BR2_PACKAGE_DTC=y
BR2_PACKAGE_DTC_PROGRAMS=y
BR2_PACKAGE_LIBGPIOD=y
BR2_PACKAGE_LIBGPIOD_TOOLS=y
BR2_PACKAGE_LIBSOCKETCAN=y
BR2_PACKAGE_HAVEGED=y
BR2_PACKAGE_CAN_UTILS=y
BR2_PACKAGE_ETHTOOL=y
BR2_PACKAGE_ETHTOOL_PRETTY_PRINT=y
BR2_PACKAGE_IPERF=y
BR2_PACKAGE_IPROUTE2=y
BR2_PACKAGE_LINUXPTP=y
# BR2_PACKAGE_URANDOM_SCRIPTS is not set
BR2_TARGET_ROOTFS_SQUASHFS=y
BR2_TARGET_ROOTFS_SQUASHFS4_LZO=y
# BR2_TARGET_ROOTFS_TAR is not set
BR2_TARGET_ROOTFS_UBI=y
BR2_TARGET_ROOTFS_UBI_SUBSIZE=2048
BR2_TARGET_ROOTFS_UBI_USE_CUSTOM_CONFIG=y
BR2_TARGET_ROOTFS_UBI_CUSTOM_CONFIG_FILE="ambarella/fs/ubifs/ubinize-ambarella.cfg"
BR2_TARGET_ROOTFS_UBIFS_LEBSIZE=0x1f000
BR2_TARGET_ROOTFS_UBIFS_MAXLEBCNT=2047
BR2_TARGET_ROOTFS_UBIFS_RT_ZLIB=y
BR2_TARGET_ROOTFS_UBIFS_GZIP=y
BR2_LINUX_KERNEL_CUSTOM_LOCAL=y
BR2_AMBARELLA_LINUX_5_15=y
# BR2_PACKAGE_IPCDEF is not set
BR2_PACKAGE_AMBACV=y
# BR2_PACKAGE_AMBAIPC is not set
# BR2_PACKAGE_AMBAIPC_TEST is not set
# BR2_PACKAGE_AMBAIPC_UTIL is not set
BR2_PACKAGE_AMBA_EXAMPLES=y
# BR2_PACKAGE_AMBA_FLEXIDAGIO_EXAMPLE is not set
# BR2_PACKAGE_AMBA_EXAMPLE_SOCKET_CLIENT is not set
BR2_PACKAGE_AMBA_EXAMPLE_AMBAPRINT=y
BR2_PACKAGE_AMBA_CAMERA=y
BR2_PACKAGE_AMBA_CAMERA_SOURCE="../../rtos/cortex_a"
BR2_PACKAGE_AMBA_CAMERA_DEFCONFIG="../../rtos/cortex_a/configs/cv3x/eva/linux/cv3dev_linux_dk_eva_cv_spinor_cvapiv7_clusters_defconfig"
BR2_PACKAGE_AMBA_DRAM_STATIS=y
BR2_PACKAGE_AMBA_DRAM_STATIS_TW_OUTPUT=y
BR2_PACKAGE_AMBA_DRAM_STATIS_TW_GROUP=y
# BR2_AMBARELLA_AUTOHIBER is not set



BR2_PACKAGE_LUA=y
BR2_PACKAGE_PROVIDES_LUAINTERPRETER="lua"
# BR2_PACKAGE_LUA_5_1 is not set
BR2_PACKAGE_LUA_5_3=y
# BR2_PACKAGE_LUA_5_4 is not set
# BR2_PACKAGE_LUA_32BITS is not set
BR2_PACKAGE_LUA_EDITING_NONE=y
# BR2_PACKAGE_LUA_READLINE is not set
# BR2_PACKAGE_LUA_LINENOISE is not set
BR2_PACKAGE_HAS_LUAINTERPRETER=y
BR2_PACKAGE_LUAINTERPRETER_ABI_VERSION="5.3"
BR2_PACKAGE_LUAINTERPRETER_ABI_VERSION_5_3=y
BR2_PACKAGE_PROVIDES_HOST_LUAINTERPRETER="host-lua"
BR2_PACKAGE_LUAJIT_ARCH_SUPPORTS=y
BR2_PACKAGE_LUAPOSIX=y
# BR2_PACKAGE_LUAJIT is not set
BR2_PACKAGE_LUASOCKET=y

BR2_PACKAGE_DROPBEAR=y

BR2_PACKAGE_RSYSLOG=y

BR2_PACKAGE_EXFAT=y
BR2_PACKAGE_EXFAT_UTILS=y

BR2_PACKAGE_AMBAMAL=y
BR2_PACKAGE_BUILD_AMBAMAL_SHARED_LIB=y

BR2_PACKAGE_GDB=y
BR2_PACKAGE_GDB_DEBUGGER=y
BR2_PACKAGE_COREUTILS=y

BR2_PACKAGE_EVA=y
BR2_PACKAGE_EVA_CONTROLBOX_LIB=y
BR2_PACKAGE_EVA_CONTROLBOX_UNIT_TEST=y
BR2_PACKAGE_EVA_TCPSERVER=y
BR2_PACKAGE_EVA_LIB_TCP=y
BR2_PACKAGE_EVA_LIB_COMMON=y
BR2_PACKAGE_EVA_LIB_SHM=y

BR2_PACKAGE_AMBA_CAMERA_DIAGS=n

BR2_PACKAGE_AMBA_CAMERA_BRIDGE_SENSOR="y"
```

## ambalinux_sdk/ambarella/configs/cv3_linux_eva_cpio_defconfig
```kconfig
BR2_aarch64=y
BR2_cortex_a78=y
BR2_DL_DIR="$(TOPDIR)/../dl"
BR2_JLEVEL=4
BR2_PACKAGE_OVERRIDE_FILE="ambarella/local.mk"
BR2_TOOLCHAIN_EXTERNAL=y
BR2_TOOLCHAIN_EXTERNAL_CUSTOM=y
BR2_TOOLCHAIN_EXTERNAL_DOWNLOAD=y
BR2_TOOLCHAIN_EXTERNAL_URL="http://buildroot.ambarella.com/buildroot/dl/toolchain-external-custom/cortex-a76-2022.08-gcc12.1-linux5.15-x86_64.tar.xz"
BR2_TOOLCHAIN_EXTERNAL_CUSTOM_PREFIX="$(ARCH)-linux-gnu"
BR2_TOOLCHAIN_EXTERNAL_HEADERS_5_15=y
BR2_TOOLCHAIN_EXTERNAL_CUSTOM_GLIBC=y
# BR2_TOOLCHAIN_EXTERNAL_INET_RPC is not set
BR2_TOOLCHAIN_EXTERNAL_CXX=y
BR2_TOOLCHAIN_EXTERNAL_OPENMP=y
BR2_TARGET_OPTIMIZATION="-mcpu=cortex-a78+crypto "
BR2_ROOTFS_SKELETON_CUSTOM=y
BR2_ROOTFS_SKELETON_CUSTOM_PATH="ambarella/package/ambarella_customize/source/skeleton"
BR2_ROOTFS_POST_BUILD_SCRIPT="ambarella/package/ambarella_customize/scripts/eva_rootfs.cpio.sh"
# BR2_PACKAGE_URANDOM_SCRIPTS is not set
BR2_TARGET_ROOTFS_CPIO=y
# BR2_TARGET_ROOTFS_TAR is not set
BR2_AMBARELLA_LINUX_5_15=y
# BR2_PACKAGE_IPCDEF is not set
# BR2_PACKAGE_AMBAIPC is not set
# BR2_PACKAGE_AMBAIPC_TEST is not set
# BR2_PACKAGE_AMBAIPC_UTIL is not set
# BR2_AMBARELLA_AUTOHIBER is not set
```

## ambalinux_sdk/ambarella/configs/cv5_linux_dk_icam_emmc_defconfig
```kconfig
BR2_aarch64=y
BR2_cortex_a76=y
BR2_DL_DIR="$(TOPDIR)/../dl"
BR2_JLEVEL=4
BR2_PACKAGE_OVERRIDE_FILE="ambarella/local.mk"
BR2_TOOLCHAIN_EXTERNAL=y
BR2_TARGET_OPTIMIZATION="-mcpu=cortex-a76+crypto "
BR2_ROOTFS_SKELETON_CUSTOM=y
BR2_ROOTFS_SKELETON_CUSTOM_PATH="ambarella/package/ambarella_customize/source/skeleton"
BR2_ROOTFS_DEVICE_CREATION_DYNAMIC_MDEV=y
BR2_ROOTFS_DEVICE_TABLE="ambarella/package/ambarella_customize/source/device_table.txt"
BR2_ROOTFS_POST_BUILD_SCRIPT="ambarella/package/ambarella_customize/scripts/amba_icam_post_build.sh"
BR2_LINUX_KERNEL=y
BR2_LINUX_KERNEL_USE_CUSTOM_CONFIG=y
BR2_LINUX_KERNEL_CUSTOM_CONFIG_FILE="$(LINUX_OVERRIDE_SRCDIR)/arch/arm64/configs/ambarella_cv5_defconfig"
BR2_PACKAGE_BUSYBOX_CONFIG="ambarella/package/ambarella_customize/config/busybox.config"
BR2_PACKAGE_BUSYBOX_SHOW_OTHERS=y
BR2_PACKAGE_CACHE_CALIBRATOR=y
BR2_PACKAGE_IOZONE=y
BR2_PACKAGE_MEMSTAT=y
BR2_PACKAGE_RAMSMP=y
BR2_PACKAGE_STRACE=y
BR2_PACKAGE_STRESS=y
BR2_PACKAGE_TINYMEMBENCH=y
BR2_PACKAGE_MTD=y
BR2_PACKAGE_MTD_MKFSJFFS2=y
BR2_PACKAGE_MTD_MKFSUBIFS=y
BR2_PACKAGE_MEMTESTER=y
BR2_PACKAGE_OPENSSL=y
BR2_PACKAGE_IPERF=y
BR2_PACKAGE_LINUXPTP=y
BR2_TARGET_ROOTFS_EXT2=y
# BR2_PACKAGE_URANDOM_SCRIPTS is not set
BR2_TARGET_ROOTFS_SQUASHFS=y
BR2_TARGET_ROOTFS_SQUASHFS4_LZO=y
# BR2_TARGET_ROOTFS_TAR is not set
BR2_LINUX_KERNEL_CUSTOM_LOCAL=y
BR2_AMBARELLA_LINUX_5_15=y
# BR2_PACKAGE_IPCDEF is not set
# BR2_PACKAGE_AMBAIPC is not set
# BR2_PACKAGE_AMBAIPC_TEST is not set
# BR2_PACKAGE_AMBAIPC_UTIL is not set
BR2_PACKAGE_AMBA_EXAMPLES=y
BR2_PACKAGE_AMBA_EXAMPLE_AMBAPRINT=y
BR2_PACKAGE_AMBA_CAMERA=y
BR2_PACKAGE_AMBA_CAMERA_SOURCE="../../rtos/cortex_a"
BR2_PACKAGE_AMBA_CAMERA_DEFCONFIG="../../rtos/cortex_a/configs/cv5/icam/lnx/cv5_linux_dk_icam_cv_emmc_imx577_defconfig"
BR2_PACKAGE_ALSA_UTILS=y
BR2_PACKAGE_ALSA_UTILS_ALSACTL=y
BR2_PACKAGE_ALSA_UTILS_ALSAMIXER=y
BR2_PACKAGE_ALSA_UTILS_APLAY=y
BR2_PACKAGE_PULSEAUDIO_HAS_ATOMIC=y
BR2_PACKAGE_ALSA_LIB=y
BR2_PACKAGE_ALSA_LIB_DEVDIR="/dev/snd"
BR2_PACKAGE_ALSA_LIB_PCM_PLUGINS="all"
BR2_PACKAGE_ALSA_LIB_CTL_PLUGINS="all"
BR2_PACKAGE_ALSA_LIB_ALOAD=y
BR2_PACKAGE_ALSA_LIB_MIXER=y
BR2_PACKAGE_ALSA_LIB_PCM=y
BR2_PACKAGE_ALSA_LIB_RAWMIDI=y
BR2_PACKAGE_ALSA_LIB_HWDEP=y
BR2_PACKAGE_ALSA_LIB_SEQ=y
BR2_PACKAGE_ALSA_LIB_UCM=y
BR2_PACKAGE_ALSA_LIB_ALISP=y
BR2_PACKAGE_ALSA_LIB_OLD_SYMBOLS=y
BR2_PACKAGE_AMBA_EXAMPLE_AUDIO=y
# BR2_AMBARELLA_AUTOHIBER is not set
```

## ambalinux_sdk/ambarella/configs/nexar_h32_d081_spinand_defconfig
```kconfig
BR2_aarch64=y
BR2_DL_DIR="$(TOPDIR)/../dl"
BR2_JLEVEL=4
BR2_PACKAGE_OVERRIDE_FILE="ambarella/local.mk"
BR2_TOOLCHAIN_EXTERNAL=y
BR2_TARGET_OPTIMIZATION="-mcpu=cortex-a53+crypto"
BR2_ROOTFS_SKELETON_CUSTOM=y
BR2_ROOTFS_SKELETON_CUSTOM_PATH="ambarella/package/ambarella_customize/source/skeleton"
BR2_ROOTFS_DEVICE_CREATION_DYNAMIC_MDEV=y
BR2_ROOTFS_DEVICE_TABLE="ambarella/package/ambarella_customize/source/device_table.txt"
BR2_ROOTFS_POST_BUILD_SCRIPT="ambarella/package/ambarella_customize/scripts/post_build.sh"
BR2_LINUX_KERNEL=y
BR2_LINUX_KERNEL_USE_CUSTOM_CONFIG=y
BR2_LINUX_KERNEL_CUSTOM_CONFIG_FILE="$(LINUX_OVERRIDE_SRCDIR)/arch/arm64/configs/ambarella_cv2x_ambalink_defconfig"
BR2_LINUX_KERNEL_DTS_SUPPORT=y
BR2_LINUX_KERNEL_CUSTOM_DTS_PATH="$(TOPDIR)/../ambarella/bootloader/boards/h32bub/bsp/h32mbub_ambalink.dts"
BR2_PACKAGE_BUSYBOX_CONFIG="ambarella/package/ambarella_customize/config/busybox.config"
BR2_PACKAGE_BUSYBOX_SHOW_OTHERS=y
BR2_PACKAGE_CACHE_CALIBRATOR=y
BR2_PACKAGE_IOZONE=y
BR2_PACKAGE_MEMSTAT=y
BR2_PACKAGE_RAMSMP=y
BR2_PACKAGE_STRACE=y
BR2_PACKAGE_STRESS=y
BR2_PACKAGE_TINYMEMBENCH=y
BR2_PACKAGE_MEMTESTER=y
BR2_PACKAGE_OPENSSL=y
BR2_PACKAGE_LIBEV=y
BR2_PACKAGE_NCURSES=y
BR2_PACKAGE_BRIDGE_UTILS=y
BR2_PACKAGE_DNSMASQ=y
# BR2_PACKAGE_DNSMASQ_TFTP is not set
BR2_PACKAGE_IPERF=y
BR2_PACKAGE_IW=y
# BR2_PACKAGE_URANDOM_SCRIPTS is not set
BR2_TARGET_ROOTFS_SQUASHFS=y
BR2_TARGET_ROOTFS_SQUASHFS4_LZO=y
# BR2_TARGET_ROOTFS_TAR is not set
BR2_LINUX_KERNEL_CUSTOM_LOCAL=y
BR2_AMBARELLA_LINUX_5_15=y
BR2_PACKAGE_NETWORK_TURNKEY=y
BR2_PACKAGE_NETWORK_TURNKEY_STARTUP=y
BR2_PACKAGE_BT_TURNKEY_STARTUP=y
BR2_PACKAGE_AMBA_UTIL=y
BR2_PACKAGE_AMBA_EXAMPLES=y
# BR2_PACKAGE_AMBA_EVENTNOTIFIER_EXAMPLE is not set
# BR2_PACKAGE_AMBA_EXAMPLE_FRAMER is not set
# BR2_PACKAGE_AMBA_EXAMPLE_SHAREPREVIEW is not set
# BR2_PACKAGE_AMBA_EXAMPLE_STREAMIN is not set
BR2_PACKAGE_AMBA_EXAMPLE_FRAMESHARE_RTSP=y
BR2_PACKAGE_MTD=y
BR2_PACKAGE_MTD_UBIFORMAT=y
BR2_PACKAGE_MTD_UBIATTACH=y
BR2_PACKAGE_MTD_UBIMKVOL=y
BR2_PACKAGE_IPERF3=y
BR2_PACKAGE_CYPRESS=y
BR2_PACKAGE_CY_43455=y
BR2_PACKAGE_CY_QUECTEL=y
# BR2_AMBARELLA_AUTOHIBER is not set

BR2_PACKAGE_BLUEZ5_UTILS=y
BR2_PACKAGE_BLUEZ5_UTILS_OBEX=y
BR2_PACKAGE_BLUEZ5_UTILS_CLIENT=y
BR2_PACKAGE_BLUEZ5_UTILS_GATTTOOL=y
BR2_PACKAGE_BLUEZ5_UTILS_EXPERIMENTAL=y
BR2_PACKAGE_BLUEZ5_UTILS_TOOLS=y
# BR2_PACKAGE_BLUEZ5_UTILS_TEST is not set


BR2_PACKAGE_HOSTAPD=y
BR2_PACKAGE_HOSTAPD_DRIVER_HOSTAP=y
BR2_PACKAGE_HOSTAPD_DRIVER_NL80211=y
# BR2_PACKAGE_HOSTAPD_DRIVER_RTW is not set
# BR2_PACKAGE_HOSTAPD_DRIVER_WIRED is not set
BR2_PACKAGE_HOSTAPD_HAS_WIFI_DRIVERS=y
BR2_PACKAGE_HOSTAPD_ACS=y
BR2_PACKAGE_HOSTAPD_EAP=y
BR2_PACKAGE_HOSTAPD_WPS=y
BR2_PACKAGE_HOSTAPD_VLAN=y
BR2_PACKAGE_HOSTAPD_VLAN_DYNAMIC=y
BR2_PACKAGE_HOSTAPD_VLAN_NETLINK=y

BR2_PACKAGE_LIBCURL=y
BR2_PACKAGE_LIBCURL_CURL=y
# BR2_PACKAGE_LIBCURL_VERBOSE is not set
BR2_PACKAGE_LIBCURL_OPENSSL=y
BR2_PACKAGE_PPTP_LINUX=y

BR2_PACKAGE_LIBEVENT=y
BR2_PACKAGE_NTP=y
# BR2_PACKAGE_NTP_SNTP is not set
# BR2_PACKAGE_NTP_NTP_KEYGEN is not set
# BR2_PACKAGE_NTP_NTP_SHM_CLK is not set
# BR2_PACKAGE_NTP_NTPD is not set
BR2_PACKAGE_NTP_NTPDATE=y
# BR2_PACKAGE_NTP_NTPDC is not set
# BR2_PACKAGE_NTP_NTPQ is not set
# BR2_PACKAGE_NTP_NTPSNMPD is not set
# BR2_PACKAGE_NTP_NTPTIME is not set
# BR2_PACKAGE_NTP_TICKADJ is not set

BR2_PACKAGE_POPT=y
BR2_PACKAGE_RSYNC=y
BR2_PACKAGE_SQLITE=y
BR2_PACKAGE_HTTP_CONTROL_SERVER=y
# BR2_TARGET_LOCALTIME="Asia/Chongqing"
BR2_TARGET_LOCALTIME="UTC"
BR2_PACKAGE_OPENSSH=y
BR2_PACKAGE_AMBA_HTTP_SERVER=y

BR2_PACKAGE_QCONNECT_MANAGER=y
BR2_PACKAGE_QFIREHOSE=y
```
