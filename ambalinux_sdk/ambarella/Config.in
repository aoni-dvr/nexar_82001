## ambalinux_sdk/ambarella/Config.in
```kconfig
comment "Ambarella Overlay Configurations"

choice
	prompt "Linux tree"
	default BR2_AMBARELLA_LINUX_5_15
	help
	  Choose Linux tree

config BR2_AMBARELLA_LINUX_5_4
	bool "Linux 5.4.x"
	help
	  Linux v5.4.x

config BR2_AMBARELLA_LINUX_5_10
	bool "Linux 5.10.x"
	help
	  Linux v5.10.x

config BR2_AMBARELLA_LINUX_5_15
	bool "Linux 5.15.x"
	help
	  Linux v5.15.x

endchoice # BR2_AMBARELLA_LINUX

config BR2_AMBARELLA_LINUX_VERSION
	string
	default "5.4"  if BR2_AMBARELLA_LINUX_5_4
	default "5.10" if BR2_AMBARELLA_LINUX_5_10
	default "5.15" if BR2_AMBARELLA_LINUX_5_15

source "ambarella/package/Config.in"
```

## ambalinux_sdk/ambarella/configs/cv22_linux_bub_iout_optee_nand_defconfig
```kconfig
BR2_aarch64=y
BR2_DL_DIR="$(TOPDIR)/../dl"
BR2_JLEVEL=4
BR2_PACKAGE_OVERRIDE_FILE="ambarella/local.mk"
BR2_TOOLCHAIN_EXTERNAL=y
BR2_TARGET_OPTIMIZATION="-mcpu=cortex-a53+crypto"
BR2_ROOTFS_SKELETON_CUSTOM=y
BR2_ROOTFS_SKELETON_CUSTOM_PATH="ambarella/package/ambarella_customize/source/skeleton"
BR2_ROOTFS_DEVICE_CREATION_DYNAMIC_MDEV=y
BR2_ROOTFS_DEVICE_TABLE="ambarella/package/ambarella_customize/source/device_table.txt"
BR2_ROOTFS_POST_BUILD_SCRIPT="ambarella/package/ambarella_customize/scripts/amba_camera_post_build.sh"
BR2_LINUX_KERNEL=y
BR2_LINUX_KERNEL_USE_CUSTOM_CONFIG=y
BR2_LINUX_KERNEL_CUSTOM_CONFIG_FILE="$(LINUX_OVERRIDE_SRCDIR)/arch/arm64/configs/ambarella_cv2x_defconfig"
BR2_PACKAGE_BUSYBOX_CONFIG="ambarella/package/ambarella_customize/config/busybox.config"
BR2_PACKAGE_BUSYBOX_SHOW_OTHERS=y
BR2_PACKAGE_CACHE_CALIBRATOR=y
BR2_PACKAGE_IOZONE=y
BR2_PACKAGE_MEMSTAT=y
BR2_PACKAGE_RAMSMP=y
BR2_PACKAGE_STRACE=y
BR2_PACKAGE_STRESS=y
BR2_PACKAGE_TINYMEMBENCH=y
BR2_PACKAGE_MEMTESTER=y
BR2_PACKAGE_OPENSSL=y
BR2_PACKAGE_LIBEV=y
BR2_PACKAGE_NCURSES=y
BR2_PACKAGE_HAVEGED=y
BR2_PACKAGE_BRIDGE_UTILS=y
BR2_PACKAGE_DNSMASQ=y
# BR2_PACKAGE_DNSMASQ_TFTP is not set
BR2_PACKAGE_IPERF=y
BR2_PACKAGE_IW=y
BR2_PACKAGE_OPTEE_BENCHMARK=y
BR2_PACKAGE_OPTEE_EXAMPLES=y
BR2_PACKAGE_OPTEE_TEST=y
# BR2_PACKAGE_URANDOM_SCRIPTS is not set
BR2_TARGET_ROOTFS_SQUASHFS=y
BR2_TARGET_ROOTFS_SQUASHFS4_LZO=y
# BR2_TARGET_ROOTFS_TAR is not set
BR2_TARGET_ROOTFS_UBI=y
BR2_TARGET_ROOTFS_UBI_SUBSIZE=2048
BR2_TARGET_ROOTFS_UBI_USE_CUSTOM_CONFIG=y
BR2_TARGET_ROOTFS_UBI_CUSTOM_CONFIG_FILE="ambarella/fs/ubifs/ubinize-ambarella.cfg"
BR2_TARGET_ROOTFS_UBIFS_LEBSIZE=0x1f000
BR2_TARGET_ROOTFS_UBIFS_MAXLEBCNT=2047
BR2_TARGET_ROOTFS_UBIFS_RT_ZLIB=y
BR2_TARGET_ROOTFS_UBIFS_GZIP=y
BR2_TARGET_OPTEE_OS=y
BR2_TARGET_OPTEE_OS_PLATFORM="ambarella"
BR2_TARGET_OPTEE_OS_PLATFORM_FLAVOR="ambarella_cv22"
BR2_TARGET_OPTEE_OS_ADDITIONAL_VARIABLES="DEBUG=1 CFG_TEE_CORE_LOG_LEVEL=1 CFG_TEE_TA_LOG_LEVEL=1 CFG_TZDRAM_START=0x00100000 CFG_TZDRAM_SIZE=0x00B00000 CFG_SHMEM_START=0x7FC00000 CFG_SHMEM_SIZE=0x400000 CFG_TEE_RAM_VA_SIZE=0x100000 PLATFORM_ARCH=ambarella_cv22 "
BR2_LINUX_KERNEL_CUSTOM_LOCAL=y
BR2_AMBARELLA_LINUX_5_15=y
# BR2_PACKAGE_IPCDEF is not set
# BR2_PACKAGE_AMBAIPC is not set
# BR2_PACKAGE_AMBAIPC_TEST is not set
# BR2_PACKAGE_AMBAIPC_UTIL is not set
BR2_PACKAGE_AMBA_CAMERA=y
BR2_PACKAGE_AMBA_CAMERA_SOURCE="../../rtos/cortex_a"
BR2_PACKAGE_AMBA_CAMERA_DEFCONFIG="../../rtos/cortex_a/svc/configs/cv22/iout/linux/cv22_linux_bub_iout_optee_nand_defconfig"
# BR2_AMBARELLA_AUTOHIBER is not set
```

## ambalinux_sdk/ambarella/configs/cv22_tx32_linux_bub_emmc_defconfig
```kconfig
BR2_aarch64=y
BR2_DL_DIR="$(TOPDIR)/../dl"
BR2_JLEVEL=4
BR2_PACKAGE_OVERRIDE_FILE="ambarella/local.mk"
BR2_TOOLCHAIN_EXTERNAL=y
BR2_TARGET_OPTIMIZATION="-mcpu=cortex-a53+crypto"
BR2_ROOTFS_SKELETON_CUSTOM=y
BR2_ROOTFS_SKELETON_CUSTOM_PATH="ambarella/package/ambarella_customize/source/skeleton"
BR2_ROOTFS_DEVICE_CREATION_DYNAMIC_MDEV=y
BR2_ROOTFS_DEVICE_TABLE="ambarella/package/ambarella_customize/source/device_table.txt"
BR2_ROOTFS_POST_BUILD_SCRIPT="ambarella/package/ambarella_customize/scripts/post_build.sh"
BR2_LINUX_KERNEL=y
BR2_LINUX_KERNEL_USE_CUSTOM_CONFIG=y
BR2_LINUX_KERNEL_CUSTOM_CONFIG_FILE="$(LINUX_OVERRIDE_SRCDIR)/arch/arm64/configs/ambarella_cv2x_ambalink_emmc_defconfig"
BR2_LINUX_KERNEL_DTS_SUPPORT=y
BR2_LINUX_KERNEL_CUSTOM_DTS_PATH="$(TOPDIR)/../ambarella/bootloader/boards/cv22bub/bsp/cv22bub_ambalink_emmc.dts"
BR2_PACKAGE_BUSYBOX_CONFIG="ambarella/package/ambarella_customize/config/busybox.config"
BR2_PACKAGE_BUSYBOX_SHOW_OTHERS=y
BR2_PACKAGE_CACHE_CALIBRATOR=y
BR2_PACKAGE_IOZONE=y
BR2_PACKAGE_MEMSTAT=y
BR2_PACKAGE_RAMSMP=y
BR2_PACKAGE_STRACE=y
BR2_PACKAGE_STRESS=y
BR2_PACKAGE_TINYMEMBENCH=y
BR2_PACKAGE_MEMTESTER=y
BR2_PACKAGE_OPENSSL=y
BR2_PACKAGE_NCURSES=y
BR2_PACKAGE_BRIDGE_UTILS=y
BR2_PACKAGE_DNSMASQ=y
# BR2_PACKAGE_DNSMASQ_TFTP is not set
BR2_PACKAGE_IPERF=y
BR2_TARGET_ROOTFS_EXT2=y
BR2_PACKAGE_OPTEE_BENCHMARK=y
BR2_PACKAGE_OPTEE_EXAMPLES=y
BR2_PACKAGE_OPTEE_TEST=y
# BR2_PACKAGE_URANDOM_SCRIPTS is not set
BR2_TARGET_ROOTFS_SQUASHFS=y
BR2_TARGET_ROOTFS_SQUASHFS4_LZO=y
# BR2_TARGET_ROOTFS_TAR is not set
BR2_TARGET_OPTEE_OS=y
BR2_TARGET_OPTEE_OS_PLATFORM="ambarella"
BR2_TARGET_OPTEE_OS_PLATFORM_FLAVOR="ambarella_cv22"
BR2_TARGET_OPTEE_OS_ADDITIONAL_VARIABLES="DEBUG=1 CFG_TEE_CORE_LOG_LEVEL=1 CFG_TEE_TA_LOG_LEVEL=1 CFG_TZDRAM_START=0x00100000 CFG_TZDRAM_SIZE=0x00B00000 CFG_SHMEM_START=0x7FC00000 CFG_SHMEM_SIZE=0x400000 CFG_TEE_RAM_VA_SIZE=0x100000 PLATFORM_ARCH=ambarella_cv22 "
BR2_LINUX_KERNEL_CUSTOM_LOCAL=y
BR2_AMBARELLA_LINUX_5_15=y
BR2_PACKAGE_NETWORK_TURNKEY=y
# BR2_PACKAGE_NETWORK_TURNKEY_STARTUP is not set
BR2_PACKAGE_AMBA_UTIL=y
BR2_PACKAGE_AMBA_EXAMPLES=y
# BR2_PACKAGE_AMBA_EVENTNOTIFIER_EXAMPLE is not set
# BR2_PACKAGE_AMBA_EXAMPLE_FRAMER is not set
# BR2_PACKAGE_AMBA_EXAMPLE_SHAREPREVIEW is not set
# BR2_PACKAGE_AMBA_EXAMPLE_STREAMIN is not set
# BR2_AMBARELLA_AUTOHIBER is not set
```

## ambalinux_sdk/ambarella/configs/cv22_tx32_linux_bub_iout_spinor_defconfig
```kconfig
BR2_aarch64=y
BR2_DL_DIR="$(TOPDIR)/../dl"
BR2_JLEVEL=4
BR2_PACKAGE_OVERRIDE_FILE="ambarella/local.mk"
BR2_TOOLCHAIN_EXTERNAL=y
BR2_TARGET_OPTIMIZATION="-mcpu=cortex-a53+crypto"
BR2_ROOTFS_SKELETON_CUSTOM=y
BR2_ROOTFS_SKELETON_CUSTOM_PATH="ambarella/package/ambarella_customize/source/skeleton"
BR2_ROOTFS_DEVICE_CREATION_DYNAMIC_MDEV=y
BR2_ROOTFS_DEVICE_TABLE="ambarella/package/ambarella_customize/source/device_table.txt"
BR2_ROOTFS_POST_BUILD_SCRIPT="ambarella/package/ambarella_customize/scripts/post_build.sh"
BR2_LINUX_KERNEL=y
BR2_LINUX_KERNEL_USE_CUSTOM_CONFIG=y
BR2_LINUX_KERNEL_CUSTOM_CONFIG_FILE="$(LINUX_OVERRIDE_SRCDIR)/arch/arm64/configs/ambarella_cv2x_ambalink_spinor_defconfig"
BR2_LINUX_KERNEL_DTS_SUPPORT=y
BR2_LINUX_KERNEL_CUSTOM_DTS_PATH="$(TOPDIR)/../ambarella/bootloader/boards/cv22bub/bsp/cv22bub_ambalink_spinor.dts"
BR2_PACKAGE_BUSYBOX_CONFIG="ambarella/package/ambarella_customize/config/busybox.config"
BR2_PACKAGE_BUSYBOX_SHOW_OTHERS=y
# BR2_PACKAGE_URANDOM_SCRIPTS is not set
BR2_TARGET_ROOTFS_SQUASHFS=y
BR2_TARGET_ROOTFS_SQUASHFS4_LZO=y
# BR2_TARGET_ROOTFS_TAR is not set
BR2_LINUX_KERNEL_CUSTOM_LOCAL=y
BR2_AMBARELLA_LINUX_5_15=y
BR2_PACKAGE_AMBA_UTIL=y
# BR2_AMBARELLA_AUTOHIBER is not set
```

## ambalinux_sdk/ambarella/configs/cv28_linux_dk_b_ut_spinand_defconfig
```kconfig
BR2_aarch64=y
BR2_DL_DIR="$(TOPDIR)/../dl"
BR2_JLEVEL=4
BR2_PACKAGE_OVERRIDE_FILE="ambarella/local.mk"
BR2_TOOLCHAIN_EXTERNAL=y
BR2_TARGET_OPTIMIZATION="-mcpu=cortex-a53+crypto"
BR2_ROOTFS_SKELETON_CUSTOM=y
BR2_ROOTFS_SKELETON_CUSTOM_PATH="ambarella/package/ambarella_customize/source/skeleton"
BR2_ROOTFS_DEVICE_CREATION_DYNAMIC_MDEV=y
BR2_ROOTFS_DEVICE_TABLE="ambarella/package/ambarella_customize/source/device_table.txt"
BR2_ROOTFS_POST_BUILD_SCRIPT="ambarella/package/ambarella_customize/scripts/amba_camera_post_build.sh"
BR2_LINUX_KERNEL=y
BR2_LINUX_KERNEL_USE_CUSTOM_CONFIG=y
BR2_LINUX_KERNEL_CUSTOM_CONFIG_FILE="$(LINUX_OVERRIDE_SRCDIR)/arch/arm64/configs/ambarella_cv2x_defconfig"
BR2_PACKAGE_BUSYBOX_CONFIG="ambarella/package/ambarella_customize/config/busybox.config"
BR2_PACKAGE_BUSYBOX_SHOW_OTHERS=y
BR2_PACKAGE_ALSA_UTILS=y
BR2_PACKAGE_ALSA_UTILS_ALSACTL=y
BR2_PACKAGE_ALSA_UTILS_ALSAMIXER=y
BR2_PACKAGE_ALSA_UTILS_APLAY=y
BR2_PACKAGE_PULSEAUDIO_HAS_ATOMIC=y
BR2_PACKAGE_CACHE_CALIBRATOR=y
BR2_PACKAGE_GDB=y
BR2_PACKAGE_GDB_DEBUGGER=y
BR2_PACKAGE_IOZONE=y
BR2_PACKAGE_MEMSTAT=y
BR2_PACKAGE_RAMSMP=y
BR2_PACKAGE_STRACE=y
BR2_PACKAGE_STRESS=y
BR2_PACKAGE_TINYMEMBENCH=y
BR2_PACKAGE_MTD=y
BR2_PACKAGE_MTD_MKFSJFFS2=y
BR2_PACKAGE_MTD_MKFSUBIFS=y
BR2_PACKAGE_MEMTESTER=y
BR2_PACKAGE_DTC=y
BR2_PACKAGE_DTC_PROGRAMS=y
BR2_PACKAGE_JSON_C=y
BR2_PACKAGE_BRIDGE_UTILS=y
BR2_PACKAGE_DNSMASQ=y
# BR2_PACKAGE_DNSMASQ_TFTP is not set
BR2_PACKAGE_IPERF=y
# BR2_PACKAGE_URANDOM_SCRIPTS is not set
BR2_TARGET_ROOTFS_SQUASHFS=y
BR2_TARGET_ROOTFS_SQUASHFS4_LZO=y
# BR2_TARGET_ROOTFS_TAR is not set
BR2_LINUX_KERNEL_CUSTOM_LOCAL=y
BR2_AMBARELLA_LINUX_5_15=y
BR2_PACKAGE_AMBACV=y
BR2_PACKAGE_AMBA_UTIL=y
BR2_PACKAGE_AMBA_EXAMPLES=y
BR2_PACKAGE_AMBA_EXAMPLE_AMBAPRINT=y
BR2_PACKAGE_AMBA_EXAMPLE_AMBAPRINT_TTY="/dev/ttyS3"
# BR2_PACKAGE_AMBA_EVENTNOTIFIER_EXAMPLE is not set
BR2_PACKAGE_AMBA_TRANSFER_EXAMPLE=y
BR2_PACKAGE_AMBA_FLEXIDAGIO_EXAMPLE=y
# BR2_PACKAGE_AMBA_EXAMPLE_FRAMER is not set
# BR2_PACKAGE_AMBA_EXAMPLE_SHAREPREVIEW is not set
# BR2_PACKAGE_AMBA_EXAMPLE_STREAMIN is not set
BR2_PACKAGE_AMBA_EXAMPLE_CAMCTRL_SERVER=y
# BR2_AMBARELLA_AUTOHIBER is not set

#
# Amba Camera
#
BR2_PACKAGE_AMBA_CAMERA=y
BR2_PACKAGE_AMBA_CAMERA_SOURCE="../../rtos/cortex_a"
BR2_PACKAGE_AMBA_CAMERA_DEFCONFIG="../../rtos/cortex_a/configs/cv28/ut/linux/cv28_linux_dk_b_ut_spinand_defconfig"
BR2_PACKAGE_AMBA_CAMERA_KCONFIG="svc/build/linux/Kconfig.Linux"
BR2_PACKAGE_AMBA_CAMERA_AMBA_MKFILE="svc/build/linux/Makefile.Amba"
BR2_PACKAGE_AMBA_CAMERA_OOSB=y
BR2_PACKAGE_ALSA_LIB=y
BR2_PACKAGE_ALSA_LIB_DEVDIR="/dev/snd"
BR2_PACKAGE_ALSA_LIB_PCM_PLUGINS="all"
BR2_PACKAGE_ALSA_LIB_CTL_PLUGINS="all"
BR2_PACKAGE_ALSA_LIB_ALOAD=y
BR2_PACKAGE_ALSA_LIB_MIXER=y
BR2_PACKAGE_ALSA_LIB_PCM=y
BR2_PACKAGE_ALSA_LIB_RAWMIDI=y
BR2_PACKAGE_ALSA_LIB_HWDEP=y
BR2_PACKAGE_ALSA_LIB_SEQ=y
BR2_PACKAGE_ALSA_LIB_UCM=y
BR2_PACKAGE_ALSA_LIB_ALISP=y
BR2_PACKAGE_ALSA_LIB_OLD_SYMBOLS=y
BR2_PACKAGE_AMBA_EXAMPLE_AUDIO=y
BR2_PACKAGE_AMBAMAL=y
```

## ambalinux_sdk/ambarella/configs/cv28_linux_dk_cvut_cv_spinand_defconfig
```kconfig
BR2_aarch64=y
BR2_DL_DIR="$(TOPDIR)/../dl"
BR2_JLEVEL=4
BR2_PACKAGE_OVERRIDE_FILE="ambarella/local.mk"
BR2_TOOLCHAIN_EXTERNAL=y
BR2_TARGET_OPTIMIZATION="-mcpu=cortex-a53+crypto"
BR2_ROOTFS_SKELETON_CUSTOM=y
BR2_ROOTFS_SKELETON_CUSTOM_PATH="ambarella/package/ambarella_customize/source/skeleton"
BR2_ROOTFS_DEVICE_CREATION_DYNAMIC_MDEV=y
BR2_ROOTFS_DEVICE_TABLE="ambarella/package/ambarella_customize/source/device_table.txt"
BR2_ROOTFS_POST_BUILD_SCRIPT="ambarella/package/ambarella_customize/scripts/amba_camera_post_build.sh"
BR2_LINUX_KERNEL=y
BR2_LINUX_KERNEL_USE_CUSTOM_CONFIG=y
BR2_LINUX_KERNEL_CUSTOM_CONFIG_FILE="$(LINUX_OVERRIDE_SRCDIR)/arch/arm64/configs/ambarella_cv2x_defconfig"
BR2_PACKAGE_BUSYBOX_CONFIG="ambarella/package/ambarella_customize/config/busybox.config"
BR2_PACKAGE_BUSYBOX_SHOW_OTHERS=y
BR2_PACKAGE_CACHE_CALIBRATOR=y
BR2_PACKAGE_GDB=y
BR2_PACKAGE_GDB_DEBUGGER=y
BR2_PACKAGE_IOZONE=y
BR2_PACKAGE_MEMSTAT=y
BR2_PACKAGE_RAMSMP=y
BR2_PACKAGE_STRACE=y
BR2_PACKAGE_STRESS=y
BR2_PACKAGE_TINYMEMBENCH=y
BR2_PACKAGE_MEMTESTER=y
BR2_PACKAGE_OPENCV4=y
BR2_PACKAGE_OPENCV4_LIB_SHAPE=y
BR2_PACKAGE_OPENCV4_LIB_STITCHING=y
BR2_PACKAGE_OPENCV4_LIB_SUPERRES=y
BR2_PACKAGE_OPENCV4_LIB_TS=y
BR2_PACKAGE_OPENCV4_LIB_VIDEOSTAB=y
BR2_PACKAGE_OPENCV4_BUILD_TESTS=y
BR2_PACKAGE_OPENCV4_BUILD_PERF_TESTS=y
BR2_PACKAGE_OPENCV4_WITH_FFMPEG=y
BR2_PACKAGE_OPENCV4_WITH_JASPER=y
BR2_PACKAGE_OPENCV4_WITH_JPEG=y
BR2_PACKAGE_OPENCV4_WITH_PNG=y
BR2_PACKAGE_OPENCV4_WITH_TIFF=y
BR2_PACKAGE_OPENCV4_WITH_V4L=y
BR2_PACKAGE_OPENCV4_INSTALL_DATA=y
BR2_PACKAGE_DTC=y
BR2_PACKAGE_DTC_PROGRAMS=y
BR2_PACKAGE_JSON_C=y
BR2_PACKAGE_BRIDGE_UTILS=y
BR2_PACKAGE_DNSMASQ=y
# BR2_PACKAGE_DNSMASQ_TFTP is not set
BR2_PACKAGE_IPERF=y
# BR2_PACKAGE_URANDOM_SCRIPTS is not set
BR2_TARGET_ROOTFS_SQUASHFS=y
BR2_TARGET_ROOTFS_SQUASHFS4_LZO=y
# BR2_TARGET_ROOTFS_TAR is not set
BR2_LINUX_KERNEL_CUSTOM_LOCAL=y
BR2_AMBARELLA_LINUX_5_15=y
# BR2_PACKAGE_IPCDEF is not set
# BR2_PACKAGE_AMBAIPC is not set
BR2_PACKAGE_AMBACV=y
# BR2_PACKAGE_AMBAIPC_TEST is not set
# BR2_PACKAGE_AMBAIPC_UTIL is not set
BR2_PACKAGE_AMBA_EXAMPLES=y
BR2_PACKAGE_AMBA_EXAMPLE_AMBAPRINT=y
BR2_PACKAGE_AMBA_EXAMPLE_AMBAPRINT_TTY="/dev/ttyS3"
# BR2_AMBARELLA_AUTOHIBER is not set

#
# Amba Camera
#
BR2_PACKAGE_AMBA_CAMERA=y
BR2_PACKAGE_AMBA_CAMERA_SOURCE="../../rtos/cortex_a"
BR2_PACKAGE_AMBA_CAMERA_DEFCONFIG="../../rtos/cortex_a/svc/build/linux/cv28_linux_dk_cvut_cv_spinand_defconfig"
BR2_PACKAGE_AMBA_CAMERA_KCONFIG="svc/build/linux/Kconfig.Linux"
BR2_PACKAGE_AMBA_CAMERA_AMBA_MKFILE="svc/build/linux/Makefile.Amba"
BR2_PACKAGE_AMBA_CAMERA_OOSB=y
```

## ambalinux_sdk/ambarella/configs/cv2_tx32_linux_bub_emmc_defconfig
```kconfig
BR2_aarch64=y
BR2_DL_DIR="$(TOPDIR)/../dl"
BR2_JLEVEL=4
BR2_PACKAGE_OVERRIDE_FILE="ambarella/local.mk"
BR2_TOOLCHAIN_EXTERNAL=y
BR2_TARGET_OPTIMIZATION="-mcpu=cortex-a53+crypto"
BR2_ROOTFS_SKELETON_CUSTOM=y
BR2_ROOTFS_SKELETON_CUSTOM_PATH="ambarella/package/ambarella_customize/source/skeleton"
BR2_ROOTFS_DEVICE_CREATION_DYNAMIC_MDEV=y
BR2_ROOTFS_DEVICE_TABLE="ambarella/package/ambarella_customize/source/device_table.txt"
BR2_ROOTFS_POST_BUILD_SCRIPT="ambarella/package/ambarella_customize/scripts/post_build.sh"
BR2_LINUX_KERNEL=y
BR2_LINUX_KERNEL_USE_CUSTOM_CONFIG=y
BR2_LINUX_KERNEL_CUSTOM_CONFIG_FILE="$(LINUX_OVERRIDE_SRCDIR)/arch/arm64/configs/ambarella_cv2x_ambalink_emmc_defconfig"
BR2_LINUX_KERNEL_DTS_SUPPORT=y
BR2_LINUX_KERNEL_CUSTOM_DTS_PATH="$(TOPDIR)/../ambarella/bootloader/boards/cv2bub/bsp/cv2bub_ambalink_emmc.dts"
BR2_PACKAGE_BUSYBOX_CONFIG="ambarella/package/ambarella_customize/config/busybox.config"
BR2_PACKAGE_BUSYBOX_SHOW_OTHERS=y
BR2_PACKAGE_CACHE_CALIBRATOR=y
BR2_PACKAGE_IOZONE=y
BR2_PACKAGE_MEMSTAT=y
BR2_PACKAGE_RAMSMP=y
BR2_PACKAGE_STRACE=y
BR2_PACKAGE_STRESS=y
BR2_PACKAGE_TINYMEMBENCH=y
BR2_PACKAGE_MEMTESTER=y
BR2_PACKAGE_OPENSSL=y
BR2_PACKAGE_LIBEV=y
BR2_PACKAGE_NCURSES=y
BR2_PACKAGE_BRIDGE_UTILS=y
BR2_PACKAGE_DNSMASQ=y
# BR2_PACKAGE_DNSMASQ_TFTP is not set
BR2_PACKAGE_IPERF=y
BR2_PACKAGE_IW=y
BR2_TARGET_ROOTFS_EXT2=y
BR2_TARGET_ROOTFS_EXT2_SIZE="40M"
# BR2_PACKAGE_URANDOM_SCRIPTS is not set
BR2_TARGET_ROOTFS_SQUASHFS=y
BR2_TARGET_ROOTFS_SQUASHFS4_LZO=y
# BR2_TARGET_ROOTFS_TAR is not set
BR2_LINUX_KERNEL_CUSTOM_LOCAL=y
BR2_AMBARELLA_LINUX_5_15=y
BR2_PACKAGE_NETWORK_TURNKEY=y
# BR2_PACKAGE_NETWORK_TURNKEY_STARTUP is not set
BR2_PACKAGE_AMBA_UTIL=y
BR2_PACKAGE_AMBA_EXAMPLES=y
# BR2_PACKAGE_AMBA_EVENTNOTIFIER_EXAMPLE is not set
# BR2_PACKAGE_AMBA_EXAMPLE_FRAMER is not set
# BR2_PACKAGE_AMBA_EXAMPLE_SHAREPREVIEW is not set
# BR2_PACKAGE_AMBA_EXAMPLE_STREAMIN is not set
BR2_PACKAGE_AMBA_EXAMPLE_FRAMESHARE_RTSP=y
# BR2_AMBARELLA_AUTOHIBER is not set
```
