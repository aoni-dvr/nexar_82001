## ambalinux_sdk/ambarella/package/amba_util/Config.in
```kconfig
menuconfig BR2_PACKAGE_AMBA_UTIL
	bool "amba_util"
	help
	  This is the AMBA_UTIL implementation.
```

## ambalinux_sdk/ambarella/package/ambacomm/Config.in
```kconfig
config BR2_PACKAGE_AMBACOMM
	bool "ambacomm"
	help
	  Ambacomm communication library

config BR2_PACKAGE_AMBACOMM_EXAMPLES
        bool "AMBACOMM Examples"
        depends on BR2_PACKAGE_AMBACOMM
        help
          AMBACOMM Examples

config BR2_PACKAGE_AMBACOMM_TOOLS
        bool "AMBACOMM Tools"
        depends on BR2_PACKAGE_AMBACOMM
        help
          AMBACOMM tools


config BR2_PACKAGE_AMBACOMM_TESTS
        bool "AMBACOMM tests"
        depends on BR2_PACKAGE_AMBACOMM
        help
          AMBACOMM tests
```

## ambalinux_sdk/ambarella/package/ambacv/Config.in
```kconfig
menuconfig BR2_PACKAGE_AMBACV
	bool "Ambarella CV scheduler framework"
	default n

config BR2_PACKAGE_CAMCTRL_IPC
	bool "Ambarella Camera Control CVTask through IPC"
	default n
	depends on BR2_PACKAGE_AMBACV

config BR2_PACKAGE_BUILD_AMBACV_SHARED_LIB
	bool "Build shared libs"
	default n
	depends on BR2_PACKAGE_AMBACV

config BR2_PACKAGE_BUILD_AMBACV_DIAGS_SHARED_LIB
	bool "Build shared Libs for build diags"
	default n
	depends on BR2_PACKAGE_AMBACV

config BR2_PACKAGE_BUILD_AMBACV_DIAGS_OOSB
	bool "Out-of-Source Building for build diags"
	default n
	depends on BR2_PACKAGE_AMBACV
	help
	  Copy source code to output, which is used to build binary
```

## ambalinux_sdk/ambarella/package/ambaipc_test/Config.in
```kconfig
menuconfig BR2_PACKAGE_AMBAIPC_TEST
	bool "Ambarella IPC framework test"
	default y
```

## ambalinux_sdk/ambarella/package/ambaipc_util/Config.in
```kconfig
menuconfig BR2_PACKAGE_AMBAIPC_UTIL
	bool "Ambarella IPC utility framework"
	default y
```

## ambalinux_sdk/ambarella/package/ambamal/Config.in
```kconfig
config BR2_PACKAGE_AMBAMAL
	bool "ambamal"
	default y
	depends on BR2_PACKAGE_AMBA_CAMERA
	help
	  This is AMBA MAL implementation.

config BR2_PACKAGE_BUILD_AMBAMAL_SHARED_LIB
	bool "Build shared libs"
	default y
	depends on BR2_PACKAGE_AMBAMAL
```

## ambalinux_sdk/ambarella/package/ambavx/Config.in
```kconfig
menuconfig BR2_PACKAGE_AMBAVX
	bool "ambavx"
	default n
	help
	  This is AmbaVX libraries.
```

## ambalinux_sdk/ambarella/package/asio/Config.in
```kconfig
config BR2_PACKAGE_ASIO
	bool "Asio C++ Library"
	default n
#	select BR2_PACKAGE_BOOST
#	select BR2_PACKAGE_BOOST_REGEX
#	select BR2_PACKAGE_BOOST_THREAD
	help
	  Asio is a cross-platform C++ library for network and low-level I/O
	  programming that provides developers with a consistent asynchronous
	  model using a modern C++ approach.
```

## ambalinux_sdk/ambarella/package/basic_usage_environment/Config.in
```kconfig
config BR2_PACKAGE_BASIC_USAGE_ENVIRONMENT
	bool "BasicUsageEnvironment"
	help
	  This is the basic usage environment lib.
```

## ambalinux_sdk/ambarella/package/cavalry_lib/Config.in
```kconfig
menuconfig BR2_PACKAGE_CAVALRY_LIB
	bool "cavalry lib"
	help
	  This is cavalry lib.

config BR2_PACKAGE_CAVALRY_MEM
	bool "cavalry memory lib"
	default y
	depends on BR2_PACKAGE_CAVALRY_LIB
	help
	  This is the cavalry memory lib.

config BR2_PACKAGE_NNCTRL
	bool "nn control lib"
	default y
	depends on BR2_PACKAGE_CAVALRY_LIB
	help
	  This is the nn control lib.
```

## ambalinux_sdk/ambarella/package/cavalry_test/Config.in
```kconfig
config BR2_PACKAGE_CAVALRY_TEST
	bool "cavalry test"
	default y
	depends on BR2_PACKAGE_CAVALRY_LIB
	help
	  This is the cavalry test.
```

## ambalinux_sdk/ambarella/package/commprocess/Config.in
```kconfig
config BR2_PACKAGE_COMMPROCESS
	bool "commprocess"
	help
	  CV1 Communication Process
```

## ambalinux_sdk/ambarella/package/controlbox/Config.in
```kconfig
menuconfig BR2_PACKAGE_CONTROLBOX
	bool "control box app"
	help
	  This is the control box app

menuconfig BR2_PACKAGE_CONTROLBOX_S
	bool "control box apps"
	help
	  This is the control box app for supercam 1s.
```

## ambalinux_sdk/ambarella/package/cyclonedds/Config.in
```kconfig
config BR2_PACKAGE_CYCLONEDDS
	bool "Eclipse Cyclone DDS"
	default n
	help
	  Eclipse Cyclone DDS

#config BR2_PACKAGE_ICEORYX
```

## ambalinux_sdk/ambarella/package/dms_example/Config.in
```kconfig
config BR2_PACKAGE_DMS_EXAMPLE
	bool "dms_example"
	default n
	help
	  This is the Example to show DMS with Linux for APPLib/VA.
```

## ambalinux_sdk/ambarella/package/eva/Config.in
```kconfig
menuconfig BR2_PACKAGE_EVA
	bool "eva_apps"
	help
	  This is the Apps for Amba Eva.

config BR2_PACKAGE_EVA_CONTROLBOX_LIB
        bool "eva_controlbox"
        default y
        depends on BR2_PACKAGE_EVA
        help
          This is the control box lib.
          
config BR2_PACKAGE_EVA_CONTROLBOX_UNIT_TEST
        bool "eva_controlbox_unit_test"
        default y
        depends on BR2_PACKAGE_EVA
        help
          This is the control box App.

config BR2_PACKAGE_EVA_TCPSERVER
        bool "eva_tcpserver"
        default y
        depends on BR2_PACKAGE_EVA
        help
          This is EVA TCP service.
          
config BR2_PACKAGE_EVA_LIB_TCP
        bool "eva_lib_tcp"
        default y
        depends on BR2_PACKAGE_EVA
        help
          This is EVA TCP library.

config BR2_PACKAGE_EVA_LIB_COMMON
        bool "eva_lib_common"
        default y
        depends on BR2_PACKAGE_EVA
        help
          This is EVA Common library.

config BR2_PACKAGE_EVA_LIB_SHM
        bool "eva_lib_shm"
        default y
        depends on BR2_PACKAGE_EVA
        help
          This is EVA SHM library.
```

## ambalinux_sdk/ambarella/package/external_sdk/Config.in
```kconfig
#menu "Atheros SDK"
#source "ambarella/package/external_sdk/ar6003_3_1_568/Config.in"
#source "ambarella/package/external_sdk/ar6003_3_4_patch4/Config.in"
#source "ambarella/package/external_sdk/ar6004/Config.in"
#endmenu

menu "Broadcom SDK"
source "ambarella/package/external_sdk/bcmdhd/Config.in"
endmenu

menu "Cypress SDK"
source "ambarella/package/external_sdk/cypress/Config.in"
endmenu

#menu "Marvell SDK"
#source "ambarella/package/external_sdk/mrvl/Config.in"
#endmenu

#menu "Realtek SDK"
#source "ambarella/package/external_sdk/rtl8188eu/Config.in"
#source "ambarella/package/external_sdk/rtl8188fu/Config.in"
#source "ambarella/package/external_sdk/rtl8189es/Config.in"
#source "ambarella/package/external_sdk/rtl8192eu/Config.in"
#source "ambarella/package/external_sdk/rtl8723bs/Config.in"
#source "ambarella/package/external_sdk/rtl8723bu/Config.in"
#source "ambarella/package/external_sdk/rtl8812au/Config.in"
#source "ambarella/package/external_sdk/rtl8821as/Config.in"
#source "ambarella/package/external_sdk/rtl8821au/Config.in"
#endmenu

menu "Imagination Technologies"
source "ambarella/package/external_sdk/ambagpu/Config.in"
endmenu
```

## ambalinux_sdk/ambarella/package/external_sdk/ambagpu/Config.in
```kconfig
config BR2_PACKAGE_AMBAGPU
	bool "Install prebuild binary for Ambarella GPU"
	default n
	help
	  Graphics libraries for Ambarella GPU
```

## ambalinux_sdk/ambarella/package/external_sdk/ar6003_3_1_568/Config.in
```kconfig
config BR2_PACKAGE_AR6003_3_1_568
	bool "ar6003_3_1_568"
	help
		Atheros AR6003 SDK 3.1.568
```

## ambalinux_sdk/ambarella/package/external_sdk/ar6003_3_4_patch4/Config.in
```kconfig
config BR2_PACKAGE_AR6003_3_4_PATCH4
	bool "ar6003_3_4_patch4"
	help
		Atheros SDK 3.4 Patch 4
```

## ambalinux_sdk/ambarella/package/external_sdk/bcmdhd/Config.in
```kconfig
config BR2_PACKAGE_BCMDHD
	tristate "Broadcom DHD"
	select BR2_PACKAGE_WPA_SUPPLICANT
	select BR2_PACKAGE_WPA_SUPPLICANT_NL80211
	select BR2_PACKAGE_WPA_SUPPLICANT_AP_SUPPORT
	select BR2_PACKAGE_WPA_SUPPLICANT_EAP
	select BR2_PACKAGE_WPA_SUPPLICANT_HOTSPOT
	select BR2_PACKAGE_WPA_SUPPLICANT_DEBUG_SYSLOG
	select BR2_PACKAGE_WPA_SUPPLICANT_WPS
	select BR2_PACKAGE_WPA_SUPPLICANT_CLI
	help
		Broadcom SDK.

if BR2_PACKAGE_BCMDHD

choice
	prompt "Select type"
	help
	  Choose chip

#config BR2_PACKAGE_BCMDHD_43340
#	tristate "bcm43340"
#	help
#		Broadcom BCM43340
#
#config BR2_PACKAGE_BCMDHD_43438
#	tristate "bcm43438"
#	help
#		Broadcom BCM43438
#
#config BR2_PACKAGE_BCMDHD_43436
#	tristate "bcm43436"
#	help
#		Broadcom BCM43436

config BR2_PACKAGE_BCMDHD_43455
	tristate "bcm43455"
	help
		Broadcom BCM43455
		
config BR2_PACKAGE_BCMDHD_43456
	tristate "bcm43456"
	help
		Broadcom BCM43456

#config BR2_PACKAGE_BCMDHD_43596
#	tristate "bcm43596"
#	help
#		Broadcom BCM43596

#config BR2_PACKAGE_BCMDHD_43362
#	tristate "bcm43362"
#	help
#		Broadcom BCM43362
#		(No P2P supported.)

endchoice

choice
	prompt "Select vendor/maker"
	help
	  Choose vendor/maker

#config BR2_PACKAGE_BCMDHD_AW
#	bool "AzureWave"
#	depends on BR2_PACKAGE_BCMDHD_43340 || BR2_PACKAGE_BCMDHD_43362 || \
#		BR2_PACKAGE_BCMDHD_43438 || BR2_PACKAGE_BCMDHD_43455
#	help
#	  AzureWave
#	  AW-AH640 (bcm43340), AW-AH650 (bcm43362), AW-NB197SM (bcm43438)

config BR2_PACKAGE_BCMDHD_AMPAK
	bool "Ampak"
	depends on BR2_PACKAGE_BCMDHD_43340 || BR2_PACKAGE_BCMDHD_43362 || \
		BR2_PACKAGE_BCMDHD_43438 || BR2_PACKAGE_BCMDHD_43455 || \
		BR2_PACKAGE_BCMDHD_43596 || BR2_PACKAGE_BCMDHD_43456
	help
	  Ampak
	  AP6234, AP6210
	  bcm43596: AP6359H

#config BR2_PACKAGE_BCMDHD_USI
#	bool "USI"
#	depends on BR2_PACKAGE_BCMDHD_4334 || BR2_PACKAGE_BCMDHD_43438
#	help
#	  USI
#	  WM-BN-BM-26_A_EVB (bcm43438)

endchoice

if BR2_PACKAGE_BCMDHD_43438

choice
	prompt "Select version of bcm43438"

config BR2_PACKAGE_BCMDHD_43438_A0
	bool "bcm43438 A0"
	depends on BR2_PACKAGE_BCMDHD_AW || BR2_PACKAGE_BCMDHD_AMPAK
	help
	  bcm43438 A0

config BR2_PACKAGE_BCMDHD_43438_A1
	bool "bcm43438 A1"
	depends on BR2_PACKAGE_BCMDHD_USI || BR2_PACKAGE_BCMDHD_AMPAK
	help
	  bcm43438 A1

config BR2_PACKAGE_BCMDHD_43438_A1_WOT
	bool "bcm43438 A1 w/ wider operating temperature"
	depends on BR2_PACKAGE_BCMDHD_AMPAK
	help
	  AP6212SD (bcm43438-A1)

config BR2_PACKAGE_BCMDHD_43438_A1_GPS
	bool "bcm43438 A1 w/ GPS (bcm4774)"
	depends on BR2_PACKAGE_BCMDHD_AMPAK
	help
	  AP6474 (bcm43438-A1 + bcm4774)

endchoice

endif

#config BR2_PACKAGE_BCMDHD_AUTOFW
#	bool "Auto select FW"
#	default y
#	depends on BR2_PACKAGE_BCMDHD_43340 || \
#		BR2_PACKAGE_BCMDHD_43438_A1 || \
#		BR2_PACKAGE_BCMDHD_43438_A1_WOT || \
#		BR2_PACKAGE_BCMDHD_43438_A1_GPS || \
#		BR2_PACKAGE_BCMDHD_43455
#	help
#	  Select firmware/nvram by chip-ID.

endif
```

## ambalinux_sdk/ambarella/package/external_sdk/cypress/Config.in
```kconfig
config BR2_PACKAGE_CYPRESS
	tristate "Cypress DHD"
	select BR2_PACKAGE_WPA_SUPPLICANT
	select BR2_PACKAGE_WPA_SUPPLICANT_NL80211
	select BR2_PACKAGE_WPA_SUPPLICANT_AP_SUPPORT
	select BR2_PACKAGE_WPA_SUPPLICANT_EAP
	select BR2_PACKAGE_WPA_SUPPLICANT_HOTSPOT
	select BR2_PACKAGE_WPA_SUPPLICANT_DEBUG_SYSLOG
	select BR2_PACKAGE_WPA_SUPPLICANT_WPS
	select BR2_PACKAGE_WPA_SUPPLICANT_CLI
	select BR2_PACKAGE_WPA_SUPPLICANT_WPA_CLIENT_SO
	select BR2_PACKAGE_WPA_SUPPLICANT_PASSPHRASE
	help
	  Cypress SDK.

if BR2_PACKAGE_CYPRESS

choice
	prompt "Select type"
	help
	  Select 43455, etc.

config BR2_PACKAGE_CY_43455
	tristate "43455"
	help
	  Cypress BCM43340 SDK.

config BR2_PACKAGE_CY_43456
	tristate "43456"
	help
	  Cypress BCM43340 SDK.

endchoice

choice
	prompt "Select vendor/maker"
	help
	  Choose vendor/maker

config BR2_PACKAGE_CY_AW
	bool "AzureWave"
	depends on BR2_PACKAGE_CY_43455 || BR2_PACKAGE_CY_43456
	help
	  AzureWave

config BR2_PACKAGE_CY_AMPAK
	bool "Ampak"
	depends on BR2_PACKAGE_CY_43455
	help
	  Ampak

config BR2_PACKAGE_CY_QUECTEL
	bool "Quectel"
	depends on BR2_PACKAGE_CY_43455
	help
	  Quectel

endchoice

endif
```

## ambalinux_sdk/ambarella/package/external_sdk/mrvl/Config.in
```kconfig
config BR2_PACKAGE_MRVL
	tristate "Marvell"
	select BR2_PACKAGE_HOSTAPD
	select BR2_PACKAGE_HOSTAPD_EAP
	select BR2_PACKAGE_HOSTAPD_WPS
	select BR2_PACKAGE_WPA_SUPPLICANT
	select BR2_PACKAGE_WPA_SUPPLICANT_NL80211
	select BR2_PACKAGE_WPA_SUPPLICANT_AP_SUPPORT
	select BR2_PACKAGE_WPA_SUPPLICANT_EAP
	select BR2_PACKAGE_WPA_SUPPLICANT_HOTSPOT
	select BR2_PACKAGE_WPA_SUPPLICANT_DEBUG_SYSLOG
	select BR2_PACKAGE_WPA_SUPPLICANT_WPS
	select BR2_PACKAGE_WPA_SUPPLICANT_CLI
	select BR2_PACKAGE_WPA_SUPPLICANT_WPA_CLIENT_SO
	select BR2_PACKAGE_WPA_SUPPLICANT_PASSPHRASE
	help
	  Marvell SDK.
	  Using hostapd for uAP and wpa_supplicant for STA.

if BR2_PACKAGE_MRVL

choice
	prompt "Select type"
	help
	  Select 88W8977, etc.

config BR2_PACKAGE_MRVL_88W8977
	tristate "88W8977"
	help
	  Marvell 88W8977 SDK.

config BR2_PACKAGE_MRVL_88W8801
	tristate "88W8801"
	help
	  Marvell 88W8801 SDK.

endchoice


endif # BR2_PACKAGE_MRVL
```
