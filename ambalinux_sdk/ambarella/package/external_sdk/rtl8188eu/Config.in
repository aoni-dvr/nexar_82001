## ambalinux_sdk/ambarella/package/external_sdk/rtl8188eu/Config.in
```kconfig
config BR2_PACKAGE_RTL8188EU
	bool "RTL8188-EU/ETV/EUS"
	help
	  Realtek RTL8188EU, RTL8188ETV, ETL8188EUS
	  Module name is 8188eu.ko
	  Driver is the same.
```

## ambalinux_sdk/ambarella/package/external_sdk/rtl8188fu/Config.in
```kconfig
config BR2_PACKAGE_RTL8188FU
	bool "RTL8188-FU/FTV/FUS"
	help
	  Realtek RTL8188FU, RTL8188FTV, ETL8188FUS
	  Module name is 8188fu.ko
	  Driver is the same.
```

## ambalinux_sdk/ambarella/package/external_sdk/rtl8189es/Config.in
```kconfig
config BR2_PACKAGE_RTL8189ES
	bool "RTL8189ES"
	help
		Realtek RTL8189ES with WoW support.

if BR2_PACKAGE_RTL8189ES

config BR2_PACKAGE_RTL8189ES_WOWLAN_EN
	bool "Enable WoWLAN with GPIO"
	help
	  Enable WoWLAN by GPIO.

config BR2_PACKAGE_RTL8189ES_REDUCE_TX_CPU_LOADING
	bool "Reduce cpu loading when Tx"
	default n
	help
	  Enable function of reducing CPU loading when Tx.
	  For slower clock or worse performance CPU,
	  this function would help.
	  For higher clock or better performance CPU,
	  this function would not help and even make throughput worse.

endif # BR2_PACKAGE_RTL8189ES
```

## ambalinux_sdk/ambarella/package/external_sdk/rtl8723bs/Config.in
```kconfig
config BR2_PACKAGE_RTL8723BS
	bool "RTL8723BS"
	help
		Realtek RTL8723BS with WoW support.

if BR2_PACKAGE_RTL8723BS

config BR2_PACKAGE_RTL8723BS_WOWLAN_EN
	bool "Enable WoWLAN with GPIO"
	help
	  Enable WoWLAN by GPIO.

config BR2_PACKAGE_RTL8723BS_REDUCE_TX_CPU_LOADING
	bool "Reduce cpu loading when Tx"
	default n
	help
	  Enable function of reducing CPU loading when Tx.
	  For slower clock or worse performance CPU,
	  this function would help.
	  For higher clock or better performance CPU,
	  this function would not help and even make throughput worse.

endif # BR2_PACKAGE_RTL8723BS
```

## ambalinux_sdk/ambarella/package/external_sdk/rtl8723bu/Config.in
```kconfig
config BR2_PACKAGE_RTL8723BU
	bool "RTL8723BU"
	help
	  Realtek RTL8723BU 11n 1x1 USB WiFi + Bluetooth COMBO
```

## ambalinux_sdk/ambarella/package/external_sdk/rtl8812au/Config.in
```kconfig
config BR2_PACKAGE_RTL8812AU
	bool "RTL8812AU"
	help
	  Realtek RTL8812AU 11ac 2x2
	  CONFIG_USB_EHCI_AMBARELLA of Linux is required.
```

## ambalinux_sdk/ambarella/package/external_sdk/rtl8821as/Config.in
```kconfig
config BR2_PACKAGE_RTL8821AS
	bool "RTL8821AS"
	help
	  Realtek RTL8821AS.

#if BR2_PACKAGE_RTL8821AS
#
#config BR2_PACKAGE_RTL8821AS_BT
#	bool "Support Bluetooth"
#	help
#	  Support Bluetooth.
#
#endif
```

## ambalinux_sdk/ambarella/package/external_sdk/rtl8821au/Config.in
```kconfig
config BR2_PACKAGE_RTL8821AU
	bool "RTL8811AU or RTL8821AU"
	help
	  Realtek RTL8811AU or
	  Realtek RTL8821AU (RTL8811AU + Bluetooth)

if BR2_PACKAGE_RTL8821AU
config BR2_PACKAGE_RTL8821AU_BT
	bool "Include Bluetooth"
	help
	  i.e. Realtek RTL8821AU (RTL8811AU + Bluetooth)

endif
```

## ambalinux_sdk/ambarella/package/fast-cdr/Config.in
```kconfig
config BR2_PACKAGE_FAST_CDR
	bool "Fast-CDR"
	default n
	help
	  Fast-CDR
	  eProsima Fast CDR is a C++ library that provides two serialization mechanisms.
```

## ambalinux_sdk/ambarella/package/fast-dds/Config.in
```kconfig
config BR2_PACKAGE_FAST_DDS
	bool "Fast-DDS"
	default n
	select BR2_PACKAGE_ASIO
	select BR2_PACKAGE_TINYXML2
	select BR2_PACKAGE_FAST_CDR
	select BR2_PACKAGE_FOONATHAN_MEMORY
	help
	  Fast-DDS
	  eprosima Fast DDS (formerly Fast RTPS) is a C++ implementation of the DDS
	  (Data Distribution Service) standard of the OMG (Object Management Group).
```

## ambalinux_sdk/ambarella/package/foonathan-memory/Config.in
```kconfig
config BR2_PACKAGE_FOONATHAN_MEMORY
	bool "foonathan / memory"
	default n
	help
	  The C++ STL allocator model has various flaws.
```

## ambalinux_sdk/ambarella/package/groupsock/Config.in
```kconfig
config BR2_PACKAGE_GROUPSOCK
	bool "groupsock"
	help
	  This is the groupsock lib.
```

## ambalinux_sdk/ambarella/package/http_control_server/Config.in
```kconfig
menuconfig BR2_PACKAGE_HTTP_CONTROL_SERVER
	bool "http_control_server"
	help
	  This is the http_control_server implementation.
```

## ambalinux_sdk/ambarella/package/ipcdef/Config.in
```kconfig
menuconfig BR2_PACKAGE_IPCDEF
	bool "Ambarella IPC defintion framework"
	default y
```

## ambalinux_sdk/ambarella/package/libeventnotifier/Config.in
```kconfig
menuconfig BR2_PACKAGE_LIBEVENTNOTIFIER
	bool "libeventnotifier"
	help
	  This is the LIBEVENTNOTIFIER implementation.
```

## ambalinux_sdk/ambarella/package/libnetfifo/Config.in
```kconfig
menuconfig BR2_PACKAGE_LIBNETFIFO
	bool "libnetfifo"
	help
	  This is the LIBNETFIFO implementation.
      config BR2_PACKAGE_LIBNETFIFO_DIRECT
      bool "using direct ambaipc (support single client process)"
      depends on BR2_PACKAGE_LIBNETFIFO
      help
        This is the libnetfifo using direct ambaipc(better performance), but this only support one client process
```

## ambalinux_sdk/ambarella/package/live555_server/Config.in
```kconfig
menuconfig BR2_PACKAGE_LIVE555_SERVER
	bool "live555_server"
    select BR2_PACKAGE_LIVE555
	help
	  This is the Examples of ambastram with live555.
```

## ambalinux_sdk/ambarella/package/live_media/Config.in
```kconfig
config BR2_PACKAGE_LIVE_MEDIA
	bool "live_media"
	help
	  This is the live media lib.
```

## ambalinux_sdk/ambarella/package/network_turnkey/Config.in
```kconfig
config BR2_PACKAGE_NETWORK_TURNKEY
	bool "Ready-made network turnkey scripts"

config BR2_PACKAGE_NETWORK_TURNKEY_STARTUP
	bool "Start WiFi turnkey at System Startup"
	default y
	depends on BR2_PACKAGE_NETWORK_TURNKEY

config BR2_PACKAGE_NETWORK_TURNKEY_STARTUP_KEEP_POWER
	bool "Start WiFi Turnkey Script Before hibernation"
	default n
	depends on BR2_PACKAGE_NETWORK_TURNKEY_STARTUP && BR2_AMBARELLA_AUTOHIBER
	help
	  Remember to always Keep WiFi Power for Fast Boot
	  Re-do hibernation when WiFi lost power, e.g., Change Camera Battery
	  Re-do hibernation when you want to change WiFi Setting, e.g., Change SSID

config BR2_PACKAGE_BT_TURNKEY_STARTUP
	bool "Start turnkey at /etc/init.d/S53bt"
	default n
	depends on BR2_PACKAGE_NETWORK_TURNKEY

config BR2_PACKAGE_LTE_TURNKEY_STARTUP
	bool "Start LTE at /etc/init.d/S54lte"
	default n
	depends on BR2_PACKAGE_NETWORK_TURNKEY

config BR2_PACKAGE_TURNKEY_WIFI_EN_GPIO
	bool "GPIO pin to enable or disable WiFi"
	default n
	depends on BR2_PACKAGE_NETWORK_TURNKEY

config BR2_PACKAGE_TURNKEY_WIFI_EN_GPIO_PIN
	int "GPIO pin to enable or disable WiFi"
	default 95
	depends on BR2_PACKAGE_TURNKEY_WIFI_EN_GPIO


config BR2_PACKAGE_TURNKEY_WIFI_EN_GPIO_STATUS
	int "GPIO value to enable WiFi, default GPIO high to enable WiFi"
	range 0 1
	default 1
	depends on BR2_PACKAGE_TURNKEY_WIFI_EN_GPIO

config BR2_PACKAGE_TURNKEY_WIFI_SWITCH_GPIO
	bool "GPIO physical button that user can turn WiFi ON/OFF"
	default n
	depends on BR2_PACKAGE_NETWORK_TURNKEY

config BR2_PACKAGE_TURNKEY_WIFI_SWITCH_GPIO_PIN
	int "GPIO physical button that user can turn WiFi ON/OFF"
	depends on BR2_PACKAGE_TURNKEY_WIFI_SWITCH_GPIO

config BR2_PACKAGE_TURNKEY_BT_EN_GPIO
	bool "GPIO pin to enable or disable Bluetooth"
	default n
	depends on BR2_PACKAGE_NETWORK_TURNKEY

config BR2_PACKAGE_TURNKEY_BT_EN_GPIO_PIN
	int "GPIO pin to enable or disable Bluetooth"
	default 93
	depends on BR2_PACKAGE_TURNKEY_BT_EN_GPIO

config BR2_PACKAGE_TURNKEY_BT_EN_GPIO_STATUS
	int "GPIO value to enable Bluetooth, default GPIO high to enable BT"
	range 0 1
	default 1
	depends on BR2_PACKAGE_TURNKEY_BT_EN_GPIO
```

## ambalinux_sdk/ambarella/package/open_utils/Config.in
```kconfig
menuconfig BR2_PACKAGE_OPEN_UTILS
	bool "open_utils"
	help
	  The open source utilities.

config BR2_PACKAGE_OPEN_UTIL_FSSTRESS
	bool "fsstress"
	default y
	depends on BR2_PACKAGE_OPEN_UTILS
	help
	  It is used to test file system.

config BR2_PACKAGE_OPEN_UTIL_INOTIFY
	bool "inotify"
	default y
	depends on BR2_PACKAGE_OPEN_UTILS
	help
	  It is the example to use inotify to monitor files/dirs.
```
