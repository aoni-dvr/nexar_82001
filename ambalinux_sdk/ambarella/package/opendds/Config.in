## ambalinux_sdk/ambarella/package/opendds/Config.in
```kconfig
config BR2_PACKAGE_OPENDDS
	bool "OpenDDS"
	default n
#	select BR2_PACKAGE_PERL
#	select BR2_PACKAGE_PERL_THREADS
    select BR2_PACKAGE_ACE_TAO
	help
	  OpneDDS
```

## ambalinux_sdk/ambarella/package/qconnect_manager/Config.in
```kconfig
config BR2_PACKAGE_QCONNECT_MANAGER
	bool "qconnect_manager"
	default n
	help
	  This is the qconnect_manager for quectel lte.
```

## ambalinux_sdk/ambarella/package/qfirehose/Config.in
```kconfig
config BR2_PACKAGE_QFIREHOSE
	bool "qfirehose"
	default n
	help
	  This is the qfirehose for quectel lte.
```

## ambalinux_sdk/ambarella/package/qflash/Config.in
```kconfig
config BR2_PACKAGE_QUECTEL_LTE_QFLASH
	bool "qflash"
	default n
	help
	  This is the qflash for quectel lte.
```

## ambalinux_sdk/ambarella/package/quectel-gnss-fota/Config.in
```kconfig
config BR2_PACKAGE_QUECTEL_GNSS_FOTA
	bool "quectel-gnss-fota"
	default n
	help
	  This is the fota for quectel gnss.
```

## ambalinux_sdk/ambarella/package/rtsp_server/Config.in
```kconfig
config BR2_PACKAGE_RTSP_SERVER
	bool "rtsp_server"
    select BR2_PACKAGE_USAGE_ENVIRONMENT
    select BR2_PACKAGE_BASIC_USAGE_ENVIRONMENT
    select BR2_PACKAGE_GROUPSOCK
    select BR2_PACKAGE_LIVE_MEDIA
	help
	  This is the live555 rtsp server.
```

## ambalinux_sdk/ambarella/package/supercam/Config.in
```kconfig
menuconfig BR2_PACKAGE_SUPERCAM
	bool "supercam apps"
	help
	  This is the Apps for Amba supercam.

config BR2_PACKAGE_SUPERCAM_FRAMESHARE
	bool "amba_example_frameshare"
	default y
	depends on BR2_PACKAGE_SUPERCAM
	help
	  This is the Example to share Frame data with Linux for SSP.

config BR2_PACKAGE_SUPERCAM_METADATA
        bool "amba_example_metadata"
        default y
        depends on BR2_PACKAGE_SUPERCAM
        help
          This is the Example to share Meta data with Linux for SSP.

config BR2_PACKAGE_SUPERCAM_STATUSUPDATE
        bool "amba_example_statusupdate"
        default y
        depends on BR2_PACKAGE_SUPERCAM
        select BR2_PACKAGE_SUPERCAM_LIB_TCP
        help
          This is the Example to share status with Linux for SSP.

config BR2_PACKAGE_SUPERCAM_PREVMETADATA
        bool "amba_example_prevmetadata"
        default y
        depends on BR2_PACKAGE_SUPERCAM
        help
          This is the Example for Sending preview meta data.

config BR2_PACKAGE_SUPERCAM_LOGTHREADX
		bool "amba_example_logthreadx"
		default y
		depends on BR2_PACKAGE_SUPERCAM
		help
		  This is the Example for Linux to log threadx msg .

config BR2_PACKAGE_SUPERCAM_LIB_TCP
        bool "supercam_lib_tcp"
        default y
        depends on BR2_PACKAGE_SUPERCAM
        help
          This is Supercam TCP library.

config BR2_PACKAGE_SUPERCAM_LIB_SHM
        bool "supercam_lib_shm"
        default y
        depends on BR2_PACKAGE_SUPERCAM
        help
          This is Supercam SHM library.

config BR2_PACKAGE_SUPERCAM_LIB_CAMCTRL
        bool "supercam_lib_camctrl"
        default y
        depends on BR2_PACKAGE_SUPERCAM
        help
          This is Supercam camctrl library.
```

## ambalinux_sdk/ambarella/package/superdrone/Config.in
```kconfig
menuconfig BR2_PACKAGE_SUPERDRONE
	bool "superdrone apps"
	help
	  This is the Apps for Amba superdrone.

config BR2_PACKAGE_SUPERDRONE_STATUSUPDATE
        bool "amba_example_statusupdate"
        default y
        depends on BR2_PACKAGE_SUPERDRONE
        select BR2_PACKAGE_SUPERDRONE_LIB_TCP
        help
          This is the Example to share status with Linux for SSP.
```

## ambalinux_sdk/ambarella/package/usage_environment/Config.in
```kconfig
config BR2_PACKAGE_USAGE_ENVIRONMENT
	bool "UsageEnvironment"
	help
	  This is the usage environment lib.
```

## ambalinux_sdk/ambarella/package/youtube_livestream/Config.in
```kconfig
menuconfig BR2_PACKAGE_YOUTUBE_LIVESTREAM
	bool "youtube_livestream"
    select BR2_PACKAGE_OPENSSL
    select BR2_PACKAGE_FFMPEG
	help
	  This is the Examples for Amba Youtube livestreaming.
```

## ambalinux_sdk/buildroot/package/avdecc-cmd/Config.in
```kconfig
config BR2_PACKAGE_AVDECC_CMD
	bool "avdecc-cmd"
	select BR2_PACKAGE_JDKSAVDECC_C
	select BR2_PACKAGE_LIBPCAP
	help
	  Source code for simple command line tools for generating and
	  sending arbitrary AVDECC commands.

	  https://github.com/jdkoftinoff/avdecc-cmd
```

## ambalinux_sdk/buildroot/package/jdksavdecc-c/Config.in
```kconfig
config BR2_PACKAGE_JDKSAVDECC_C
	bool "jdksavdecc-c"
	help
	  A library for the AVDECC protocol in the C programming language.

	  http://avb.statusbar.com/page/code/jdksavdecc-c/
```

## ambalinux_sdk/linux-5.15/arch/arm64/configs/ambarella_cv2x_ambalink_spinor_defconfig
```kconfig
# CONFIG_LOCALVERSION_AUTO is not set
CONFIG_DEFAULT_HOSTNAME="Ambarella"
CONFIG_SYSVIPC=y
CONFIG_POSIX_MQUEUE=y
CONFIG_USELIB=y
CONFIG_NO_HZ_IDLE=y
CONFIG_HIGH_RES_TIMERS=y
CONFIG_PREEMPT=y
CONFIG_BSD_PROCESS_ACCT=y
CONFIG_BSD_PROCESS_ACCT_V3=y
CONFIG_IKCONFIG=y
CONFIG_IKCONFIG_PROC=y
CONFIG_LOG_BUF_SHIFT=16
CONFIG_CGROUP_HUGETLB=y
CONFIG_SCHED_AUTOGROUP=y
CONFIG_EXPERT=y
# CONFIG_PERF_EVENTS is not set
# CONFIG_COMPAT_BRK is not set
CONFIG_PROFILING=y
CONFIG_ARCH_AMBARELLA=y
CONFIG_NR_CPUS=4
CONFIG_HZ_1000=y
CONFIG_COMPAT=y
# CONFIG_EFI is not set
CONFIG_ARM64_CRYPTO=y
CONFIG_CRYPTO_SHA1_ARM64_CE=y
CONFIG_CRYPTO_SHA2_ARM64_CE=y
CONFIG_CRYPTO_GHASH_ARM64_CE=y
CONFIG_CRYPTO_AES_ARM64_CE_CCM=y
CONFIG_CRYPTO_AES_ARM64_CE_BLK=y
CONFIG_CRYPTO_AES_ARM64_NEON_BLK=y
CONFIG_JUMP_LABEL=y
# CONFIG_SECCOMP is not set
# CONFIG_GCC_PLUGINS is not set
CONFIG_MODULES=y
CONFIG_MODULE_UNLOAD=y
CONFIG_BLK_DEV_BSGLIB=y
CONFIG_PARTITION_ADVANCED=y
# CONFIG_EFI_PARTITION is not set
# CONFIG_CORE_DUMP_DEFAULT_ELF_HEADERS is not set
CONFIG_CMA=y
CONFIG_NET=y
CONFIG_PACKET=y
CONFIG_UNIX=y
CONFIG_UNIX_DIAG=y
CONFIG_XFRM_USER=y
CONFIG_INET=y
CONFIG_IP_MULTICAST=y
CONFIG_IP_ADVANCED_ROUTER=y
CONFIG_IP_PNP=y
CONFIG_IP_PNP_DHCP=y
CONFIG_IP_PNP_BOOTP=y
# CONFIG_INET_DIAG is not set
# CONFIG_IPV6 is not set
CONFIG_NETFILTER=y
CONFIG_ARCH_AMBARELLA_AMBALINK=y
CONFIG_AMBALINK_PPM=y
CONFIG_UEVENT_HELPER=y
CONFIG_DEVTMPFS=y
CONFIG_DEVTMPFS_MOUNT=y
# CONFIG_STANDALONE is not set
# CONFIG_PREVENT_FIRMWARE_BUILD is not set
CONFIG_CONNECTOR=y
CONFIG_MTD=y
CONFIG_MTD_CMDLINE_PARTS=y
CONFIG_MTD_BLOCK_AMBRO=y
CONFIG_MTD_SPI_NOR=y
# CONFIG_MTD_SPI_NOR_USE_4K_SECTORS is not set
CONFIG_SPI_AMBARELLA_QUADSPI=y
CONFIG_MTD_UBI=y
CONFIG_BLK_DEV_LOOP=y
CONFIG_BLK_DEV_RAM=y
CONFIG_BLK_DEV_RAM_COUNT=1
CONFIG_BLK_DEV_RAM_SIZE=65536
CONFIG_NETDEVICES=y
# CONFIG_NET_VENDOR_ALACRITECH is not set
CONFIG_NET_VENDOR_AMBARELLA=m
CONFIG_NET_VENDOR_AMBARELLA_INTEN_TUE=y
# CONFIG_NET_VENDOR_AMAZON is not set
# CONFIG_NET_VENDOR_AMD is not set
# CONFIG_NET_VENDOR_AQUANTIA is not set
# CONFIG_NET_VENDOR_ARC is not set
# CONFIG_NET_VENDOR_BROADCOM is not set
# CONFIG_NET_VENDOR_CADENCE is not set
# CONFIG_NET_VENDOR_CAVIUM is not set
# CONFIG_NET_VENDOR_CORTINA is not set
# CONFIG_NET_VENDOR_EZCHIP is not set
# CONFIG_NET_VENDOR_GOOGLE is not set
# CONFIG_NET_VENDOR_HISILICON is not set
# CONFIG_NET_VENDOR_HUAWEI is not set
# CONFIG_NET_VENDOR_INTEL is not set
# CONFIG_NET_VENDOR_MARVELL is not set
# CONFIG_NET_VENDOR_MICREL is not set
# CONFIG_NET_VENDOR_MICROCHIP is not set
# CONFIG_NET_VENDOR_MICROSEMI is not set
# CONFIG_NET_VENDOR_NI is not set
# CONFIG_NET_VENDOR_NATSEMI is not set
# CONFIG_NET_VENDOR_NETRONOME is not set
# CONFIG_NET_VENDOR_PENSANDO is not set
# CONFIG_NET_VENDOR_QUALCOMM is not set
# CONFIG_NET_VENDOR_RENESAS is not set
# CONFIG_NET_VENDOR_ROCKER is not set
# CONFIG_NET_VENDOR_SAMSUNG is not set
# CONFIG_NET_VENDOR_SEEQ is not set
# CONFIG_NET_VENDOR_SOLARFLARE is not set
# CONFIG_NET_VENDOR_SMSC is not set
# CONFIG_NET_VENDOR_SOCIONEXT is not set
# CONFIG_NET_VENDOR_STMICRO is not set
# CONFIG_NET_VENDOR_SYNOPSYS is not set
# CONFIG_NET_VENDOR_VIA is not set
# CONFIG_NET_VENDOR_WIZNET is not set
CONFIG_PHYLIB=y
CONFIG_MICROSEMI_PHY=m
CONFIG_PPP=m
CONFIG_PPP_ASYNC=m
# CONFIG_WLAN is not set
# CONFIG_KEYBOARD_ATKBD is not set
# CONFIG_INPUT_MOUSE is not set
CONFIG_INPUT_MISC=y
# CONFIG_SERIO is not set
CONFIG_VT_HW_CONSOLE_BINDING=y
# CONFIG_LEGACY_PTYS is not set
CONFIG_SERIAL_AMBARELLA=y
CONFIG_SERIAL_AMBARELLA_CONSOLE=y
# CONFIG_HW_RANDOM is not set
CONFIG_SPI=y
CONFIG_SPI_DEBUG=y
CONFIG_GPIOLIB=y
CONFIG_GPIO_SYSFS=y
# CONFIG_HWMON is not set
CONFIG_MFD_SYSCON=y
CONFIG_MMC=y
# CONFIG_PWRSEQ_EMMC is not set
# CONFIG_PWRSEQ_SIMPLE is not set
CONFIG_MMC_BLOCK_MINORS=32
CONFIG_MMC_AMBARELLA=y
CONFIG_RTC_CLASS=y
CONFIG_RTC_INTF_DEV_UIE_EMUL=y
CONFIG_DMADEVICES=y
CONFIG_AMBARELLA_DMA=y
# CONFIG_IOMMU_SUPPORT is not set
CONFIG_AMBARELLA_RPROC=y
CONFIG_RPMSG_ECHO=y
# CONFIG_DNOTIFY is not set
CONFIG_VFAT_FS=y
CONFIG_TMPFS=y
CONFIG_TMPFS_POSIX_ACL=y
CONFIG_HUGETLBFS=y
CONFIG_CONFIGFS_FS=y
CONFIG_SQUASHFS=y
CONFIG_SQUASHFS_LZ4=y
CONFIG_SQUASHFS_LZO=y
CONFIG_SQUASHFS_XZ=y
CONFIG_NFS_FS=y
CONFIG_NLS_DEFAULT="utf8"
CONFIG_NLS_CODEPAGE_437=y
CONFIG_NLS_ISO8859_1=y
CONFIG_NLS_UTF8=y
CONFIG_CRYPTO_CRC32C=y
CONFIG_CRYPTO_ANSI_CPRNG=y
CONFIG_CRC_CCITT=y
CONFIG_CRC_ITU_T=y
CONFIG_CRC7=y
CONFIG_DMA_CMA=y
CONFIG_PRINTK_TIME=y
CONFIG_DYNAMIC_DEBUG=y
CONFIG_DEBUG_SECTION_MISMATCH=y
CONFIG_DEBUG_FS=y
# CONFIG_FTRACE is not set
# CONFIG_STRICT_DEVMEM is not set
```

## ambalinux_sdk/linux-5.15/drivers/ambacv/Kconfig
```kconfig
menuconfig ARCH_AMBARELLA_CV
	tristate "Amba Cvtask Scheduler Support"
	default m
        depends on ARCH_AMBARELLA
	help
                This enables Ambarella cvtask scheduler module
```

## ambalinux_sdk/linux-5.15/drivers/ambamal/Kconfig
```kconfig
menuconfig ARCH_AMBARELLA_MAL
	tristate "Amba MAL Support"
	default m
        depends on ARCH_AMBARELLA
	help
                This enables Ambarella MAL module
```

## ambalinux_sdk/linux-5.15/drivers/eva/Kconfig
```kconfig
# SPDX-License-Identifier: GPL-2.0
menu "EVA drivers"
source "drivers/eva/eva_audio_tick/Kconfig"
source "drivers/eva/eva_imu_sync/Kconfig"
endmenu
```

## ambalinux_sdk/linux-5.15/drivers/eva/eva_audio_tick/Kconfig
```kconfig
# SPDX-License-Identifier: GPL-2.0

config EVA_AUDIO_TICK
	tristate "EVA Audio Tick Support"
	default n
	help
	  enable eva audio tick.
```

## ambalinux_sdk/linux-5.15/drivers/eva/eva_imu_sync/Kconfig
```kconfig
# SPDX-License-Identifier: GPL-2.0

config EVA_IMU_SYNC
	tristate "EVA IMU Sync Support"
	default n
	help
	  enable eva imu sync support.
```

## ambalinux_sdk/linux-5.15/drivers/rpmsg/ambarella/Kconfig
```kconfig
source "drivers/rpmsg/ambarella/common/echo/Kconfig"
#source "drivers/rpmsg/ambarella/common/rsh/Kconfig"
source "drivers/rpmsg/ambarella/common/veth/Kconfig"
```

## ambalinux_sdk/linux-5.15/drivers/soc/ambarella/Kconfig
```kconfig
#
# Ambarella SoC drivers
#

config AMBARELLA_PIO
	tristate "Ambarella Enable PIO mem allocator"
	depends on ARCH_AMBARELLA
	default m if ARCH_AMBA_CAMERA
	default n if !ARCH_AMBA_CAMERA
	help
	  Say y here to peripheral IO memory allocator

config AMBARELLA_RCT_PROFILE
	tristate "Ambarella Enable RCT profile"
	depends on ARCH_AMBARELLA
	default y if ARCH_AMBA_CAMERA
	default n if !ARCH_AMBA_CAMERA
	help
	  Say y here to enable rct profile

config AMBARELLA_SUPPORT_GDMA
	bool "Ambarella Enable GDMA"
        depends on ARCH_AMBARELLA
	default n
	help
	  Say y here to enable gdma

config AMBARELLA_LPDDR5_ADJUST
	bool "Ambarella adjust lpddr5 dynamically"
	depends on ARCH_AMBARELLA
	default n
	help
	  Say y here to adjust lpddr5 dynamically

config AMBARELLA_DRAMC_STATS
	bool "Ambarella show dramc stats"
	depends on ARCH_AMBARELLA
	default n
	help
	  Say y here to show dramc stats
```

## ambalinux_sdk/linux-5.15/drivers/staging/ambarella/Kconfig
```kconfig
config ARMHSM
       tristate "ARMHSM"
       depends on ARM64
       default n
       help
          Enable this to support ARMHSM which in turn interfaces with ORCHSM
```
