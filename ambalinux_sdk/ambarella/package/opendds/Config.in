## rtos/cortex_a/boot/Kconfig
```kconfig
menu "Boot Configuration"

comment "DRAM Component"

choice DRAM_TYPE_SELECTION
	prompt "Dram Type"
	default DRAM_TYPE_LPDDR4

config DRAM_TYPE_LPDDR5
	bool "LPDDR5 DRAM"
config DRAM_TYPE_LPDDR4
	bool "LPDDR4 DRAM"
config DRAM_TYPE_DDR4
	bool "DDR4 DRAM"
endchoice

config DDR_SIZE
	hex "Dram size in bytes"
	default 0x80000000

comment "Boot Device"

choice
	prompt "Boot Type"
	default ENABLE_NAND_BOOT

config ENABLE_EMMC_BOOT
	bool "eMMC Boot"
	help
	Boot from eMMC Managed NAND flash

config ENABLE_NAND_BOOT
	bool "Parallel-NAND Boot"
	help
	Boot from NAND flash

config ENABLE_SPINAND_BOOT
	bool "Serial-NAND Boot"
	help
	Boot from Serial(SPI interface) NAND flash

config ENABLE_SPINOR_BOOT
	bool "Serial-NOR Boot"
	help
	Boot from Serial(SPI interface) NOR flash

endchoice

choice
	prompt "EMMC Access Bus Width"
	default CONFIG_EMMC_ACCESS_8BIT
	help
	  Select the data bus width to use for EMMC boot flow

config EMMC_ACCESS_8BIT
	bool "8 bit"
	help
	  Always assume a 8 bit data access without doing a bus test.

config EMMC_ACCESS_4BIT
	bool "4 bit"
	help
	  Always assume a 4 bit data access without doing a bus test.

config EMMC_ACCESS_1BIT
 bool "1 bit"
 depends on !ENABLE_EMMC_HS200
 help
	  Always assume a 1 bit data access without doing a bus test.

endchoice

config ENABLE_EMMC_HS200
	bool "eMMC Enable HS200 Mode"
	help
	Use HS200 Mode timing on eMMC device


comment "CRC32 Validation"

choice CHECK_TARGET_SELECTION
	prompt "Check Target"
	default CHECK_TARGET_NONE
config CHECK_TARGET_NONE
	bool "None"
config CHECK_TARGET_BST
	bool "Bst"
config CHECK_TARGET_BLD
	bool "Bld"
config CHECK_TARGET_ALL
	bool "Bst and Bld"
endchoice

menu "Set SPINOR boot parameter"
depends on ENABLE_SPINOR_BOOT

config MUTI_BOOT_DEVICE
	bool "Mutiple boot device (spinor & emmc)"
	help
	Mutiple boot device. Second device is emmc.
	default n
config SPINOR_DMA_ENABLE
    bool "Enable DMA for SPINOR"
    help
	Enable DMA for SPINOR.
    default n
config SPINOR_DEFAULT_MODE_OCT
    bool "SPINOR device default on OCT DDR mode"
    help
	SPINOR device default use OCT DDR.
    default n
endmenu

menu "Set EMMC boot parameter"
depends on ENABLE_EMMC_BOOT || MUTI_BOOT_DEVICE

config EMMC_MAX_CLOCK
	hex "MAX eMMC clock rate"
	default 0x500000

choice
	prompt "EMMC ACCESS PARTITON "
	depends on ENABLE_EMMC_BOOT
	default CONFIG_EMMC_ACCPART_USER
	help
	  Select the area of access partition for EMMC boot flow

config EMMC_ACCPART_USER
	bool "user"
	help
	  Always assume a 1 bit data access without doing a bus test.

config EMMC_ACCPART_BP1
	bool "BP1"
	help
	  Always assume a 4 bit data access without doing a bus test.

config EMMC_ACCPART_BP2
	bool "BP2"
	help
	  Always assume a 8 bit data access without doing a bus test.

endchoice

choice
	prompt "EMMC BOOT PARTITON "
	depends on ENABLE_EMMC_BOOT || MUTI_BOOT_DEVICE
	default CONFIG_EMMC_BOOTPART_USER
	help
	  Select the area of boot partition for EMMC boot flow

config EMMC_BOOTPART_USER
	bool "user"
	help
	  Always assume a 1 bit data access without doing a bus test.

config EMMC_BOOTPART_BP1
	bool "BP1"
	help
	  Always assume a 4 bit data access without doing a bus test.

config EMMC_BOOTPART_BP2
	bool "BP2"
	help
	  Always assume a 8 bit data access without doing a bus test.

endchoice

choice
	prompt "EMMC Boot Bus Width"
	depends on ENABLE_EMMC_BOOT || MUTI_BOOT_DEVICE
	default CONFIG_EMMC_BOOT_8BIT
	help
	  Select the data bus width to use for EMMC boot flow

config EMMC_BOOT_1BIT
	bool "1 bit"
	help
	  Always assume a 1 bit data access without doing a bus test.

config EMMC_BOOT_4BIT
	bool "4 bit"
	help
	  Always assume a 4 bit data access without doing a bus test.

config EMMC_BOOT_8BIT
	bool "8 bit"
	help
	  Always assume a 8 bit data access without doing a bus test.

endchoice
config ENABLE_EMMC_HIGHSPEED_TIMING
	bool "eMMC Enable Highspeed"
	help
	Use High speed timing on eMMC device

config ENABLE_EMMC_HW_RESET
	bool "Enable EMMC HW reset pin function"
	default n
	help
	  EMMC RST_n pin should be pull high.

endmenu

menu "Secure Boot Option"
comment "This page only works with secure booting mode."
comment "Don't enable it if your board configuration is normal booting."
config ENABLE_SECURITY
	bool "Enable system security service"
	default n
	select SECURE_TYPE_RSA if !(SOC_CV5 || SOC_CV52)
	select SECURE_TYPE_ECC if (SOC_CV5 || SOC_CV52)
	help
	  Enable system secure features

if ENABLE_SECURITY

config  RSA_PRIVATE_KEY_PATH
	string "RSA privare key file path"
	default ""
	help
	  RSA private key file path

config  ECC_PRIVATE_KEY_PATH
	string "ECC privare key file path"
	default ""
	help
	  ECC private key file path

config  OPENSSL_PATH
	string "openssl path"
	default "${srctree}/tools/openssl/openssl" if SOC_CV5 || SOC_CV52
	default ""
	help
	  OPENSSL binary path

config SECURE_LNX_SRC_PATH
	string "LNX source path"
	default ""
	help
	  LNX source path, which will be used to encrypt

config SECURE_TYPE_RSA
	bool
	help
	  OTP support RSA

config SECURE_TYPE_ECC
	bool
	help
	  OTP support ECC

config SECURE_ECC_IDX
	int "Index/Id of key used"
	range 0 15
	default 0
	depends on SECURE_TYPE_ECC
	help
	  Select Index/Id of key (0-15)


endif # ENABLE_SECURITY

endmenu

comment "Fast Boot"
menu "Fast Boot with LZ4"
config FASTBOOT_LZ4
	bool "Use LZ4 compress/decompress"
    default y if !QNX && SVC_APPS_ICAM && (SOC_CV5 || SOC_CV52)
	help
	  Use LZ4 compress/decompress for fast boot

if FASTBOOT_LZ4

config FB_LZ4_COMPBASE
	hex "Base address of compression data"
    default 0x08000000
	help
	  Base address of compression data

endif # FASTBOOT_LZ4

endmenu

endmenu
```

## rtos/cortex_a/bsp/Kconfig
```kconfig
menu "Board Support Package"

source build/kconfigs/bsp/cv2/Kconfig
source build/kconfigs/bsp/cv22/Kconfig
source build/kconfigs/bsp/cv25/Kconfig
source build/kconfigs/bsp/h32/Kconfig
source build/kconfigs/bsp/cv2fs/Kconfig
source build/kconfigs/bsp/cv22fs/Kconfig
source build/kconfigs/bsp/cv28/Kconfig
source build/kconfigs/bsp/cv5x/Kconfig

if !FWPROG_R52SYS_ENABLE
config AUTO_DRAM_TRAINING
	bool "Enable automatic dram training"
	default y
	help
		Execute dram training automatically at 1st boot.
endif

if !SOC_CV2FS && !SOC_CV22FS
config BST_DRAM_TRAINING
	bool "Enable BST dram training"
	default y if DRAM_TYPE_LPDDR5
	default y if SOC_CV22 || SOC_CV25 || SOC_CV28 || SOC_H32
	default y if SOC_CV2 && !ENABLE_SECURITY
	default n
	select BST_LARGE_SIZE if SOC_CV5 || SOC_CV52
	help
		Execute dram training automatically in bootstrap at every boot.
endif

config DEVICE_TREE_SUPPORT
	bool "Enable device tree for XEN/RTOS"
	select BUILD_FOSS_LIBFDT
	default y
if DEVICE_TREE_SUPPORT
config DTS
	string "board level dts (device tree source) file path"
	default "${srctree}/bsp/cv2/cv2bub_option_a_v300/cv2bub.dts"   if BSP_CV2BUB_OPTION_A_V300
	default "${srctree}/bsp/cv2/cv2dk/cv2dk.dts"                  if BSP_CV2DK
	default "${srctree}/bsp/cv2/cv2dk/cv2dk.dts"                  if BSP_CV2DK_D_REWORK
	default "${srctree}/bsp/cv22/cv22bub_option_a_v300/cv22bub.dts"  if BSP_CV22BUB_OPTION_A_V300
	default "${srctree}/bsp/cv22/cv22dk/cv22dk.dts"                 if BSP_CV22DK
	default "${srctree}/bsp/cv25/cv25bub_option_a_v300/cv25bub.dts"  if BSP_CV25BUB_OPTION_A_V300
	default "${srctree}/bsp/cv25/cv25bub_option_a_v200/cv25bub.dts"  if BSP_CV25BUB_OPTION_A_V200
	default "${srctree}/bsp/cv25/cv25dk_v100/cv25dk.dts"            if BSP_CV25DK_V100
	default "${srctree}/bsp/cv25/cv25dk_8layer_v110/cv25dk.dts"     if BSP_CV25DK_8LAYER_V110
	default "${srctree}/bsp/h32/h32bub_option_a_v200/h32bub.dts"   if BSP_H32BUB_OPTION_A_V200
	default "${srctree}/bsp/h32/h32bub_option_a_v300/h32bub.dts"   if BSP_H32BUB_OPTION_A_V300
    default "${srctree}/bsp/h32/h32aqbub_option_a_v100/h32bub.dts"   if BSP_H32AQBUB_OPTION_A_V100
	default "${srctree}/bsp/h32/h32dk_v100/h32dk.dts"             if BSP_H32DK_V100
    default "${srctree}/bsp/h32/h32aqdk_option_b_v100/h32dk.dts"  if BSP_H32AQDK_OPTION_B_V100
	default "${srctree}/bsp/h32/h32bub_option_b_v200/h32bub.dts"   if BSP_H32BUB_OPTION_B_V200
	default "${srctree}/bsp/cv2fs/cv2fsbub_option_a_v100/cv2fsbub.dts" if BSP_CV2FSBUB_OPTION_A_V100
	default "${srctree}/bsp/cv2fs/cv2fsdk_option_a_v110/cv2fsdk.dts"  if BSP_CV2FSDK_OPTION_A_V110
	default "${srctree}/bsp/cv2fs/cv2xfsdk_option_b/cv2fsdk.dts"  if BSP_CV2XFSDK_OPTION_B
	default "${srctree}/bsp/cv28/cv28bub_option_a_v100/cv28bub.dts"  if BSP_CV28BUB_OPTION_A_V100
	default "${srctree}/bsp/cv28/cv28dk_8layer_a_v100/cv28dk.dts"   if BSP_CV28DK_8LAYER_A_V100
    default "${srctree}/bsp/cv28/cv28dk_option_b_v100/cv28dk.dts"   if BSP_CV28DK_OPTION_B_V100
	default "${srctree}/bsp/cv5x/cv5bub_option_a_v100/cv5bub.dts"  if BSP_CV5BUB_OPTION_A_V100
	default "${srctree}/bsp/cv5x/cv5bub_option_b_v100/cv5bub.dts"  if BSP_CV5BUB_OPTION_B_V100
    default "${srctree}/bsp/cv5x/cv5dk_option_a_v100/cv5dk.dts"  if BSP_CV5DK_OPTION_A_V100
    default "${srctree}/bsp/cv5x/cv52ndk_option_a_v100/cv52dk.dts"  if BSP_CV52NDK_OPTION_A_V100
    default "${srctree}/bsp/cv5x/cv52ndk_option_b_v100/cv52dk.dts"  if BSP_CV52NDK_OPTION_B_V100
    default "${srctree}/bsp/h32/h32_nexar_d081/h32bub.dts"  if BSP_H32_NEXAR_D081
    default "${srctree}/bsp/cv25/cv25_nexar_d161/cv25bub.dts"  if BSP_CV25_NEXAR_D161
    default "${srctree}/bsp/cv25/cv25_nexar_d161v2/cv25bub.dts"  if BSP_CV25_NEXAR_D161V2
    default "${srctree}/bsp/cv25/cv25_nexar_d080/cv25bub.dts"  if BSP_CV25_NEXAR_D080

config DTB_LOADADDR
	hex "Load address"
	default 0x00040000
config DTB_SIZE
	hex "DTB size"
	default 0x80000 if LINUX
	default 0x10000
endif

comment "Note, please modify bsp folder name once you change BSP configuration."
config BSP_NAME
    string "BSP folder name"
    default "cv2bub_option_a_v300"   if BSP_CV2BUB_OPTION_A_V300
    default "cv2dk"                  if BSP_CV2DK
    default "cv2dk_d"                if BSP_CV2DK_D_REWORK
    default "cv22bub_option_a_v300"  if BSP_CV22BUB_OPTION_A_V300
    default "cv22dk"                 if BSP_CV22DK
    default "cv25bub_option_a_v300"  if BSP_CV25BUB_OPTION_A_V300
    default "cv25bub_option_a_v200"  if BSP_CV25BUB_OPTION_A_V200
    default "cv25dk_v100"            if BSP_CV25DK_V100
    default "cv25dk_8layer_v110"     if BSP_CV25DK_8LAYER_V110
    default "h32bub_option_a_v200"   if BSP_H32BUB_OPTION_A_V200
    default "h32bub_option_a_v300"   if BSP_H32BUB_OPTION_A_V300
    default "h32aqbub_option_a_v100" if BSP_H32AQBUB_OPTION_A_V100
    default "h32dk_v100"             if BSP_H32DK_V100
    default "h32aqdk_option_b_v100"  if BSP_H32AQDK_OPTION_B_V100
    default "h32bub_option_b_v200"   if BSP_H32BUB_OPTION_B_V200
    default "cv2fsbub_option_a_v100" if BSP_CV2FSBUB_OPTION_A_V100
    default "cv2fsdk_option_a_v110"  if BSP_CV2FSDK_OPTION_A_V110
    default "cv2xfsdk_option_b"      if BSP_CV2XFSDK_OPTION_B
    default "cv28bub_option_a_v100"  if BSP_CV28BUB_OPTION_A_V100
    default "cv28dk_8layer_a_v100"   if BSP_CV28DK_8LAYER_A_V100
    default "cv28dk_option_b_v100"   if BSP_CV28DK_OPTION_B_V100
    default "cv5bub_option_a_v100"   if BSP_CV5BUB_OPTION_A_V100
    default "cv5bub_option_b_v100"   if BSP_CV5BUB_OPTION_B_V100
	default "cv5dk_option_a_v100"    if BSP_CV5DK_OPTION_A_V100
    default "cv52ndk_option_a_v100"   if BSP_CV52NDK_OPTION_A_V100
    default "cv52ndk_option_b_v100"   if BSP_CV52NDK_OPTION_B_V100
    default "h32_nexar_d081"     if BSP_H32_NEXAR_D081
    default "cv25_nexar_d161"        if BSP_CV25_NEXAR_D161
    default "cv25_nexar_d161v2"        if BSP_CV25_NEXAR_D161V2
    default "cv25_nexar_d080"        if BSP_CV25_NEXAR_D080
endmenu

config PCBA_DVT
	bool "board for dvt"
	default n
	help
		define whether dvt board

config PCBA_DVT2
	bool "board for dvt2"
	default n
	help
		define whether dvt2 board
```
