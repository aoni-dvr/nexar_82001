## rtos/cortex_a/build/Kconfig
```kconfig
# For a description of the syntax of this configuration file,
# see build/scripts/Documentation/kbuild/kconfig-language.txt.
#
mainmenu "Ambarella SDK Configuration"

source build/kconfigs/Kconfig.arch
source build/kconfigs/Kconfig.toolchain

comment "System Configuration"
#source build/kconfigs/Kconfig.system

comment "Modules Configuration"
#source module/Kconfig


comment "Third-party vendors"
#source build/kconfigs/Kconfig.vendors.bt
#source build/kconfigs/Kconfig.vendors.wifi
#source build/kconfigs/Kconfig.vendors.gps
```

## rtos/cortex_a/build/buildsystem_ut/kconfig/Kconfig
```kconfig
# For a description of the syntax of this configuration file,
# see build/scripts/Documentation/kbuild/kconfig-language.txt.
#
mainmenu "Ambarella SDK Configuration"

source build/kconfigs/Kconfig.arch
source build/kconfigs/Kconfig.toolchain

source build/buildsystem_ut/kconfig/Kconfig.but
```

## rtos/cortex_a/build/buildsystem_ut/kconfig/Kconfig.but
```kconfig
config BUT_VCAST
	bool "Utilities for VectorCAST testing"
	default n
	help
	  Build utilities for VectorCAST testing.

# Do not use standard library. CC_USESTD and reent.h will make VCAST abnormal.
config THREADX
	def_bool y
```

## rtos/cortex_a/build/kconfigs/Kconfig.arch
```kconfig
#
# For a description of the syntax of this configuration file,
# see Documentation/kbuild/kconfig-language.txt.
#
comment "Chip Configuration"

choice
	prompt "Ambarella SOC"
	default SOC_CV22
	help
	  Select Ambarella SOC series

#config SOC_A9AQ
#	bool "Ambarella A9AQ SOC"
#	select CPU_CORTEX_A9
#	help
#	  CPU is Dual-Core Cortex A9

config SOC_H22
	bool "Ambarella H22 SOC"
	select CPU_CORTEX_A53
	help
	  CPU is Quard-Core Cortex A53

config SOC_CV2
	bool "Ambarella CV2 SOC"
	select CPU_CORTEX_A53
	help
	  CPU is Quard-Core Cortex A53

config SOC_CV22
	bool "Ambarella CV22 SOC"
	select CPU_CORTEX_A53
	help
	  CPU is Quard-Core Cortex A53

config SOC_CV25
	bool "Ambarella CV25 SOC"
	select CPU_CORTEX_A53
	help
	  CPU is Quard-Core Cortex A53

config SOC_CV28
	bool "Ambarella CV28 SOC"
	select CPU_CORTEX_A53
	help
	  CPU is Dual-Core Cortex A53

config SOC_CV2FS
	bool "Ambarella CV2FS SOC"
	select CPU_CORTEX_A53
	help
	  CPU is Quard-Core Cortex A53

config SOC_CV22FS
	bool "Ambarella CV22FS SOC"
	select CPU_CORTEX_A53
	help
	  CPU is Quard-Core Cortex A53

config SOC_H32
	bool "Ambarella H32 SOC"
	select CPU_CORTEX_A53
	help
	  CPU is Quard-Core Cortex A53

config SOC_CV5
	bool "Ambarella CV5 SOC"
	select CPU_CORTEX_A76
	help
	  CPU is Dual-Core Cortex A76

config SOC_CV52
	bool "Ambarella CV52 SOC"
	select CPU_CORTEX_A76
	help
	  CPU is Dual-Core Cortex A76

endchoice

config SOC_NAME
    string
    default "cv2" if SOC_CV2
    default "cv22" if SOC_CV22
    default "cv25" if SOC_CV25
    default "cv28" if SOC_CV28
    default "h22" if SOC_H22
    default "h32" if SOC_H32
    default "cv2fs" if SOC_CV2FS
    default "cv22fs" if SOC_CV22FS
    default "cv5x" if SOC_CV5
    default "cv5x" if SOC_CV52

menu "CPU Options"

config CPU_ARMV7
	bool
	default n

config CPU_ARMV8
	bool
	default n

config MMU
	bool

config AEABI
	bool

config CPU_CORTEX_A9
	bool
	default n
	select CPU_ARMV7
	select MMU
	select AEABI
	help
	  Optimize with "-march=armv7-a -mcpu=cortex-a9"

config CPU_CORTEX_A53
	bool
	default n
	select CPU_ARMV8
	select MMU
	select AEABI
	help
	  Optimize with "-march=armv8-a -mtune=cortex-a53 -mcpu=cortex-a53"

config CPU_CORTEX_A76
	bool
	default n
	select CPU_ARMV8
	select MMU
	select AEABI
	help
	  Optimize with "-march=armv8-a -mtune=cortex-a76 -mcpu=cortex-a76"

if CPU_ARMV8

choice
	prompt "Instruction Set"
	default ARM32
	help
	  Select instruction set

config ARM32
	bool "A32"
	depends on !CPU_CORTEX_A76
	help
	  ARM 32-bit (AArch32) support.

config ARM64
	bool "A64"
	help
	  ARM 64-bit (AArch64) support.

endchoice

#if ARM64
#
#choice
#	prompt "C Language Data Type Model"
#	default ABI_LP64
#	help
#	  Two legitimate ABI for AArch64 are LP64 and ILP32.
#	  Not all legacy code can be easily ported to 64-bit (LP64).
#	  ILP32 enables a recompilation of 32-bit source code to a 64-bit ISA but
#	  using the 32-bit data model removing the need for the port and enabling
#	  the legacy code to run on a 64-bit only CPU.
#
#config ABI_LP64
#	bool "LP64"
#	help
#	  The AArch64-LP64 uses the AArch64 instruction set coupled with a data model,
#	  where Long and Pointer are 64-bit, Ints are 32-bit.
#
#config ABI_ILP32
#	bool "ILP32"
#	help
#	  The AArch64-ILP32 uses the AArch64 instruction set coupled with a data model,
#	  where Int, Long and Pointer are 32-bit.
#
#endchoice
#
#endif # ARM64

endif # CPU_ARMV8

choice
	prompt "Execution state"
	default EXE_ARM
	help
	  Generate code that supports calling between the ARM and Thumb
	  instruction sets.

config EXE_ARM
	bool "ARM instruction sets"

config EXE_THUMB
	bool "THUMB instruction sets"

endchoice

choice
	prompt "VFP type"
	default VFP_V3 if CPU_ARMV7
	default VFP_SIMDV8 if CPU_ARMV8
	help
	  Select ARM Floating Point architecture (VFP) type.
	  VFP provides hardware support for floating point operations in
	  half-, single- and double-precision floating point arithmetic.
	  It is fully IEEE 754 compliant with full software library support.

config VFP_V3
	bool "VFPv3"
	help
	  VFPv3 or VFPv3-D32 is an optional extension to the ARM,
	  Thumb and ThumbEE instruction sets in the ARMv7-A and ARMv7-R
	  profiles. VFPv3 implementation is with either thirty-two or
	  sixteen double word registers.

config VFP_SIMDV8
	bool "Advanced SIMD (NEON) Extension support"
	depends on CPU_ARMV8
	help
	  ARMv8 Advanced SIMD with crypto.

config VFP_SOFT
	bool "Software floating-point"
	help
	   Using software floating-point.

endchoice


endmenu # "CPU Options"
```

## rtos/cortex_a/build/kconfigs/Kconfig.bld
```kconfig
choice
	prompt "Boot sequence after amboot"
	default BLD_SEQ_ATF
	help
	  Choice next image to run after amboot

config BLD_SEQ_SHELL
	bool "Boot to shell of amboot"
	help
	  Run shell, bst->amboot

config BLD_SEQ_LINUX
	bool "Boot up Linux by amboot"
	help
	  Run Linux (Non-Secure AArch64)
	  bst->bl2->bl31(->bl32)->amboot->linux
	  bst->amboot->linux

config BLD_SEQ_SRTOS
	bool "Boot up RTOS by amboot"
	help
	  Run Secure-RTOS
	  bst->bl2->bl31(->bl32)->amboot->rtos
	  bst->amboot->rtos

config BLD_SEQ_ATF
	bool "Boot up ATF by amboot"
	help
	  Run ATF BL3x
	  bst->amboot->atf

endchoice # Boot sequence after amboot

if BLD_SEQ_ATF
choice
	prompt "Boot sequence after ATF at A53"
	default BLD_SEQ_ATF_XEN if XEN_SUPPORT
	default BLD_SEQ_ATF_SRTOS if (THREADX || QNX)
	default BLD_SEQ_ATF_LINUX if LINUX
	help
	  Choice next image to boot up after ATF.

config BLD_SEQ_ATF_SRTOS
	bool "Boot Secure RTOS atfer ATF"
	depends on (THREADX || QNX)
	help
	  Next image to boot up is RTOS after ATF.
	  bst->amboot->atf->rtos

config BLD_SEQ_ATF_LINUX
	bool "Boot Non-Secure Linux after ATF"
	select BUILD_FOSS_LIBFDT
	help
	  Next image to boot up is Linux under Non-Secure world after ATF.
	  bst->amboot->atf->linux

config BLD_SEQ_ATF_XEN
	bool "Boot Non-Secure Xen after ATF"
	depends on XEN_SUPPORT
	help
	  Next image to boot up is Xen under Non-Secure world after ATF.

endchoice # Boot sequence after ATF
endif # BLD_SEQ_ATF
```

## rtos/cortex_a/build/kconfigs/Kconfig.foss
```kconfig
#
#

menu "FOSS Options"

config BUILD_FOSS_LIB
	bool "Build FOSS libraries"
	default n
	help
	  Build Free and Open Source Software libraries

if BUILD_FOSS_LIB
config BUILD_FOSS_JSMN
	bool "Build JSMN json parser"
	default n

if BUILD_SSP_ENET
config LZ4_ENET
	bool "Build ethernet porting layer for lz4"
	depends on BUILD_FOSS_LZ4
	default n
endif
endif

config BUILD_FOSS_LWIP
	bool "Build lwIP FOSS library"
	depends on !LINUX
	default n

if BUILD_SSP_ENET
config LWIP_ENET
	bool "Build ethernet porting layer for lwIP"
	depends on BUILD_FOSS_LWIP
	default y
endif

config BUILD_FOSS_MBEDTLS
	bool "Build mbedtls FOSS library"
	default n


config BUILD_FOSS_LVGL
       bool "Build LVGL libraries"
       default y if SVC_APPS_ICAM

config BUILD_FOSS_LZ4
        bool "Build lz4 FOSS library"
        default n


if ENABLE_AMBALINK

config LIBMETAL
	bool
	default n

config OPENAMP
	bool "OpenAMP"
	default n
	select LIBMETAL
	help
	  Open Asymmetric Multi Processing (OpenAMP) .

if OPENAMP
config OPENAMP_NUM_EPT
    int "Number of end-point per RPMSG device"
    default 8
    help
      Max. number of end-pointer per RPMSG device.

endif # OPENAMP

endif # ENABLE_AMBALINK

config BUILD_FOSS_LIBFDT
	bool "Build device tree library"
	default n

endmenu
```
