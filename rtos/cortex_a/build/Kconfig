## rtos/cortex_a/build/kconfigs/bsp/cv2/peripherals/display/Kconfig
```kconfig
menu "FPD Driver"

config FPD_WDF9648W
    bool "Wintek WDF9648W"
    default n
config FPD_WDF9648W_VOUT0
    bool "Vout0"
    depends on FPD_WDF9648W
    default n
config FPD_WDF9648W_VOUT1
    bool "Vout1"
    depends on FPD_WDF9648W
    default n

config FPD_T30P61
    bool "Shenzhen RZW T30P61"
    default n
config FPD_T30P61_VOUT0
    bool "Vout0"
    depends on FPD_T30P61
    default n
config FPD_T30P61_VOUT1
    bool "Vout1"
    depends on FPD_T30P61
    default n

config FPD_Y85006
    bool "DZXtech Y85006"
    default n
config FPD_Y85006_VOUT0
    bool "Vout0"
    depends on FPD_Y85006
    default n
config FPD_Y85006_VOUT1
    bool "Vout1"
    depends on FPD_Y85006
    default n

config FPD_Y85183
    bool "DZXtech Y85183"
    default n
config FPD_Y85183_VOUT0
    bool "Vout0"
    depends on FPD_Y85183
    default n
config FPD_Y85183_VOUT1
    bool "Vout1"
    depends on FPD_Y85183
    default n

config FPD_C101EAN01_0
    bool "AUO C101EAN01.0"
    default n
config FPD_C101EAN01_VOUT0
    bool "Vout0"
    depends on FPD_C101EAN01
    default n
config FPD_C101EAN01_VOUT1
    bool "Vout1"
    depends on FPD_C101EAN01
    default n

config FPD_ZS095BH3001A8H3
    bool "Shenzhen Zhongshen Optoelectronics Co. Ltd ZS095BH3001A8H3"
    default n
config FPD_ZS095BH3001A8H3_VOUT0
    bool "Vout0"
    depends on FPD_ZS095BH3001A8H3
    default n
config FPD_ZS095BH3001A8H3_VOUT1
    bool "Vout1"
    depends on FPD_ZS095BH3001A8H3
    default n

config FPD_ZS095BH3001A8H3_BII
    bool "Shenzhen Zhongshen Optoelectronics Co. Ltd ZS095BH3001A8H3_BII"
    default n

config FPD_MAXIM_DUAL_TFT1280768
    bool "Dual Truly 1280x768 via Maxim 96751/96752 HDMI Serializer"
    default n
config FPD_MAXIM_DUAL_TRULY_VOUT0
    bool "Vout0"
    depends on FPD_MAXIM_DUAL_TFT1280768
    default n
config FPD_MAXIM_DUAL_TRULY_VOUT1
    bool "Vout1"
    depends on FPD_MAXIM_DUAL_TFT1280768
    default n

config FPD_MAXIM_DUAL_ZS095BH
    bool "MAXIM DUAL ZS095BH"
    default n

config FPD_MAXIM_TFT1280768
    bool "MAXIM TFT1280768"
    default n
config FPD_MAXIM_TRULY_VOUT0
    bool "Vout0"
    depends on FPD_MAXIM_TFT1280768
    default n
config FPD_MAXIM_TRULY_VOUT1
    bool "Vout1"
    depends on FPD_MAXIM_TFT1280768
    default n

config FPD_MAXIM_ZS095BH3001A8H3_BII
    bool "ZS095BH3001A8H3 via Maxim 96755/96752 DSI Serializer"
    default n
config FPD_MAXIM_ZS095_VOUT0
    bool "Vout0"
    depends on FPD_MAXIM_ZS095BH3001A8H3_BII
    default n
config FPD_MAXIM_ZS095_VOUT1
    bool "Vout1"
    depends on FPD_MAXIM_ZS095BH3001A8H3_BII
    default n

config FPD_MAXIM_AUOB101UAN02
    bool "MAXIM AUOB101UAN02"
    default n

config FPD_LT9611UXC
    bool "LT9611UXC"
    default n

menuconfig VOUT0_DEVICE_NAME
    string "VOUT0_DEVICE_NAME"
    depends on FPD_WDF9648W_VOUT0 || FPD_T30P61_VOUT0 || FPD_Y85006_VOUT0 || FPD_Y85183_VOUT0 || FPD_C101EAN01_VOUT0 || FPD_ZS095BH3001A8H3_VOUT0 || FPD_MAXIM_ZS095_VOUT0 || FPD_MAXIM_TRULY_VOUT0
    default "WdF9648w"          if FPD_WDF9648W_VOUT0
    default "T30P61"            if FPD_T30P61_VOUT0
    default "Y85006"            if FPD_Y85006_VOUT0
    default "Y85183"            if FPD_Y85183_VOUT0
    default "C101EAN01"         if FPD_C101EAN01_VOUT0
    default "ZS095BH3001A8H3"   if FPD_ZS095BH3001A8H3_VOUT0
    default "MAXIM_ZS095"       if FPD_MAXIM_ZS095_VOUT0
    default "MAXIM_TFT128"      if FPD_MAXIM_TRULY_VOUT0

menuconfig VOUT1_DEVICE_NAME
    string "VOUT1_DEVICE_NAME"
    depends on FPD_WDF9648W_VOUT1 || FPD_T30P61_VOUT1 || FPD_Y85006_VOUT1 || FPD_Y85183_VOUT1 || FPD_C101EAN01_VOUT1 || FPD_ZS095BH3001A8H3_VOUT1 || FPD_MAXIM_DUAL_TRULY_VOUT1 || FPD_MAXIM_TRULY_VOUT1
    default "WdF9648w"          if FPD_WDF9648W_VOUT1
    default "T30P61"            if FPD_T30P61_VOUT1
    default "Y85006"            if FPD_Y85006_VOUT1
    default "Y85183"            if FPD_Y85183_VOUT1
    default "C101EAN01"         if FPD_C101EAN01_VOUT1
    default "ZS095BH3001A8H3"   if FPD_ZS095BH3001A8H3_VOUT1
    default "MAXIM_Dual_TFT128" if FPD_MAXIM_DUAL_TRULY_VOUT1
    default "MAXIM_TFT128"      if FPD_MAXIM_TRULY_VOUT1

endmenu
```

## rtos/cortex_a/build/kconfigs/bsp/cv22/Kconfig
```kconfig
if SOC_CV22

source build/kconfigs/bsp/cv22/peripherals/Kconfig

comment "Board Configuration"
choice CV22_BSP_SELECTION
	prompt "BSP"
	default BSP_CV22BUB_OPTION_A_V300

config BSP_CV22BUB_OPTION_A_V300
	bool "CV22 Bringup Board Option-A V300"
config BSP_CV22DK
	bool "CV22 DK"
endchoice

choice CV22_DRAM_SELECTION
	prompt "Dram"
	default CV22_LPDDR4_MT53D512M32D2DS_1392MHZ

config CV22_LPDDR4_MT53D512M32D2DS_1392MHZ
	bool "MT53D512M32D2DS 1392MHz"
config CV22_LPDDR4_MT53D512M32D2DS_1800MHZ
	bool "MT53D512M32D2DS 1800MHz"
endchoice

config ATT_MAP
	string "Att Map File Name"
	default "AmbaUserMemProt"
	help
		File name of the Att Map file (remove '.c')

endif
```

## rtos/cortex_a/build/kconfigs/bsp/cv22/peripherals/Kconfig
```kconfig
menu "Peripheral Drivers"

source build/kconfigs/bsp/cv22/peripherals/display/Kconfig
source build/kconfigs/bsp/cv22/peripherals/bridge/Kconfig
source build/kconfigs/bsp/cv22/peripherals/sensor/Kconfig
source build/kconfigs/bsp/cv22/peripherals/yuvinput/Kconfig
source build/kconfigs/bsp/cv22/peripherals/audio/Kconfig
source build/kconfigs/bsp/cv22/peripherals/imu/Kconfig
endmenu
```

## rtos/cortex_a/build/kconfigs/bsp/cv22/peripherals/bridge/Kconfig
```kconfig
menu "Sensor and LCD bridge Driver"

menuconfig SENSOR_BRIDGE_MAX9295_9296
    bool "MAXIM MAX9295/9296"
    default n

menuconfig SENSOR_BRIDGE_MAX9295_96712
    bool "MAXIM MAX9295/96712"
    default n

menuconfig SENSOR_BRIDGE_MAX96707_9286
    bool "MAXIM MAX96707/9286"
    default n

menuconfig AMBA_B8
    bool "Ambarella B8"
    default n
    
endmenu
```

## rtos/cortex_a/build/kconfigs/bsp/cv22/peripherals/imu/Kconfig
```kconfig
menu "IMU Driver"

menuconfig IMU_MPU6500
    bool "MPU6500"
    default n
endmenu
```

## rtos/cortex_a/build/kconfigs/bsp/cv22/peripherals/sensor/Kconfig
```kconfig
menu "Image Sensor Driver"

menuconfig SENSOR_SONY_IMX290_MIPI
    bool "Sony IMX290"
    default n

menuconfig SENSOR_SONY_IMX577
    bool "Sony IMX577"
    default n
config IMX577_POSTCFG_ENABLED
    bool "enable post configuration"
    depends on SENSOR_SONY_IMX577
    default n

menuconfig SENSOR_MX00_IMX390
    bool "SONY IMX390 @ MAXIM 9295/9296 (in slave mode)"
    default n
config MX00_IMX390_POSTCFG_ENABLED
    bool "enable post configuration"
    depends on SENSOR_MX00_IMX390
    default n
config MX00_IMX390_IN_SLAVE_MODE
    bool "configure sensor in slave mode"
    depends on SENSOR_MX00_IMX390
    default y
config MX00_IMX390_SHORTEN_SYNC_LATENCY
    bool "shorten sync latency bwtween different VIN"
    depends on MX00_IMX390_IN_SLAVE_MODE
    default n
config MX00_IMX390_SHARING_MASTER_SYNC
    bool "share master sync between different VIN"
    depends on MX00_IMX390_IN_SLAVE_MODE
    default n

menuconfig SENSOR_MX01_IMX390
    bool "SONY IMX390 @ MAXIM 9295/96712 (in slave mode)"
    default n
config MX01_IMX390_POSTCFG_ENABLED
    bool "enable post configuration"
    depends on SENSOR_MX01_IMX390
    default y
config MX01_IMX390_IN_SLAVE_MODE
    bool "configure sensor in slave mode"
    depends on SENSOR_MX01_IMX390
    default y

menuconfig SENSOR_MX01_IMX224
    bool "SONY IMX224 @ MAXIM 9295/96712 (in slave mode)"
    default n  	
menuconfig SENSOR_MX03_AR0144
    bool "OnSemi AR0144 @ MAXIM 96707/9286 (in slave mode)"
    default n
menuconfig SENSOR_MX00_AR0239
	bool "OnSemi AR0239 @ MAXIM 9295/9296 (in slave mode)"
	default n
menuconfig SENSOR_MX01_AR0233
    bool "OnSemi AR0233 @ MAXIM 9295/96712 (in master mode)"
    default n
menuconfig SENSOR_MX00_IMX390_RCCB
    bool "SONY IMX390_RCCB @ MAXIM 9295/9296 (in slave mode)"
    default n
menuconfig SENSOR_MX00_IMX424
    bool "SONY IMX424 @ MAXIM 9295/9296 (in slave mode)"
    default n
menuconfig SENSOR_MX00_AR0233
    bool "OnSemi AR0233 @ MAXIM 9295/9296 (in master mode)"
    default n
menuconfig SENSOR_MX00_OV2312_RGBIR
	bool "OV2312 RGBIR @ MAXIM 9295/9296 (in master mode)"
	default n
menuconfig SENSOR_B8N_IMX290
	bool "Sony IMX290 MIPI @ B8N (in master mode)"
	default n
menuconfig SENSOR_MX00_OV2778_RGBIR
	bool "OV2778 RGBIR @ MAXIM 9295/9296 (in master mode)"
	default n
menuconfig SENSOR_MX00_IMX490
    bool "SONY IMX490 @ MAXIM 9295/9296 (in slave mode)"
    default n
menuconfig SENSOR_MX00_VG1762_RGBIR
    bool "ST VG1762 RGBIR @ MAXIM 9295/9296 (in slave mode)"
    default n
menuconfig SENSOR_MX00_IMX622
    bool "SONY IMX622 @ MAXIM 9295/9296 (in slave mode)"
    default n
menuconfig SENSOR_MX00_IMX623
    bool "SONY IMX623 @ MAXIM 9295/9296 (in slave mode)"
    default n
menuconfig SENSOR_MX00_AR0323
    bool "OnSemi AR0323 @ MAXIM 9295/9296 (in master mode)"
    default n
menuconfig SENSOR_MX00_OX03C
    bool "OV OX03C @ MAXIM 9295/9296 (in slave mode)"
    default n
endmenu
```

## rtos/cortex_a/build/kconfigs/bsp/cv22/peripherals/yuvinput/Kconfig
```kconfig
menu "YUV input Driver"

menuconfig YUVINPUT_LT6911
    bool "LT6911"
    default n

endmenu
```
