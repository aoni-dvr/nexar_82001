## rtos/cortex_a/build/kconfigs/bsp/cv22fs/peripherals/Kconfig
```kconfig
menu "Peripheral Drivers"

source build/kconfigs/bsp/cv22fs/peripherals/audio/Kconfig
source build/kconfigs/bsp/cv22fs/peripherals/display/Kconfig
source build/kconfigs/bsp/cv22fs/peripherals/sensor/Kconfig
source build/kconfigs/bsp/cv22fs/peripherals/yuvinput/Kconfig
source build/kconfigs/bsp/cv22fs/peripherals/bridge/Kconfig

endmenu
```

## rtos/cortex_a/build/kconfigs/bsp/cv22fs/peripherals/audio/Kconfig
```kconfig
menu "Audio codec Driver"

config AUDIO_AK4951EN
	bool "AKM AK4951EN"
	default y

config AUDIO_TITLV320AIC3007
	bool "TI tlv320aic3007"
	default y

config AUDIO_NAU8822
	bool "Nuvoton NAU8822"
	default n

endmenu
```

## rtos/cortex_a/build/kconfigs/bsp/cv22fs/peripherals/display/Kconfig
```kconfig
menu "FPD Driver"

config FPD_Y85006
    bool "DZXtech Y85006"
    default n

config FPD_Y85183
    bool "DZXtech Y85183"
    default n

config FPD_C101EAN01_0
    bool "AUO C101EAN01.0"
    default n

config FPD_ZS095BH3001A8H3
    bool "Shenzhen Zhongshen Optoelectronics Co. Ltd ZS095BH3001A8H3"
    default n

config FPD_ZS095BH3001A8H3_BII
    bool "Shenzhen Zhongshen Optoelectronics Co. Ltd ZS095BH3001A8H3_BII"
    default n

config FPD_MAXIM_TFT1280768
    bool "MAXIM TFT1280768"
    default n

config FPD_MAXIM_ZS095BH3001A8H3_BII
    bool "ZS095BH3001A8H3 via Maxim 96755/96752 DSI Serializer"
    default n
	
config FPD_MAXIM_ZS095_MAX96789
    bool "ZS095BH3001A8H3 via Maxim 96789/96752 DSI Serializer"
    default n

config FPD_MAXIM_AUOB101UAN02
    bool "MAXIM AUOB101UAN02"
    default n

config FPD_LT9611UXC
    bool "LT9611UXC"
    default n

config FPD_HXY500HD10IIN0
    bool "HXY500HD10IIN0"
    default n

endmenu
```

## rtos/cortex_a/build/kconfigs/bsp/cv25/Kconfig
```kconfig
if SOC_CV25

source build/kconfigs/bsp/cv25/peripherals/Kconfig

comment "Board Configuration"
choice CV25_BSP_SELECTION
	prompt "BSP"
	default BSP_CV25BUB_OPTION_A_V300

config BSP_CV25BUB_OPTION_A_V300
	bool "CV25 Bringup Board Option-A V300"
config BSP_CV25BUB_OPTION_A_V200
	bool "CV25 Bringup Board Option-A V200"
config BSP_CV25DK_V100
	bool "CV25 Development Kit V100"
config BSP_CV25DK_8LAYER_V110
	bool "CV25 Development Kit 8-layer V110"
config BSP_CV25_NEXAR_D161
	bool "CV25 D161 For Nexar"
config BSP_CV25_NEXAR_D161V2
	bool "CV25 D161V2 For Nexar"
config BSP_CV25_NEXAR_D080
	bool "CV25 D080 For Nexar"
endchoice

choice CV25_DRAM_SELECTION
	prompt "Dram"
	default CV25_LPDDR4_MT53D512M32D2DS_1200MHZ

config CV25_LPDDR4_MT53D512M32D2DS_1200MHZ
	bool "MT53D512M32D2DS 1200MHz"
config CV25_LPDDR4_MT53D512M32D2DS_1596MHZ
	bool "MT53D512M32D2DS 1596MHz"
endchoice

config ATT_MAP
	string "Att Map File Name"
	default "AmbaUserMemProt"
	help
		File name of the Att Map file (remove '.c')

endif
```

## rtos/cortex_a/build/kconfigs/bsp/cv25/peripherals/Kconfig
```kconfig
menu "Peripheral Drivers"

source build/kconfigs/bsp/cv25/peripherals/display/Kconfig
source build/kconfigs/bsp/cv25/peripherals/bridge/Kconfig
source build/kconfigs/bsp/cv25/peripherals/sensor/Kconfig
source build/kconfigs/bsp/cv25/peripherals/yuvinput/Kconfig
source build/kconfigs/bsp/cv25/peripherals/audio/Kconfig
source build/kconfigs/bsp/cv25/peripherals/pmic/Kconfig
source build/kconfigs/bsp/cv25/peripherals/imu/Kconfig

endmenu
```

## rtos/cortex_a/build/kconfigs/bsp/cv25/peripherals/pmic/Kconfig
```kconfig
menu "Pmic Driver"

config ENABLE_PMIC
        bool "enable pmic"
        default n

if ENABLE_PMIC
config PMIC_AMBA_PWC
	bool "PMIC_AMBA_PWC"
	default n

config PMIC_CHIPON
	bool "PMIC_CHIPON"
	default n
endif
endmenu
```

## rtos/cortex_a/build/kconfigs/bsp/cv25/peripherals/sensor/Kconfig
```kconfig
menu "Image Sensor Driver"

menuconfig SENSOR_SONY_IMX290_MIPI
    bool "Sony IMX290"
    default n

menuconfig SENSOR_SONY_IMX415_MIPI
    bool "Sony IMX415"
    default n

menuconfig SENSOR_GC4653
    bool "GCOREINC GC4653"
    default n

menuconfig SENSOR_GC2053
    bool "GCOREINC GC2053"
    default n

menuconfig SENSOR_SONY_IMX577
    bool "Sony IMX577"
    default n
config IMX577_POSTCFG_ENABLED
    bool "enable post configuration"
    depends on SENSOR_SONY_IMX577
    default n

menuconfig SENSOR_MX00_IMX390
    bool "SONY IMX390 @ MAXIM 9295/9296 (in slave mode)"
    default n
config MX00_IMX390_POSTCFG_ENABLED
    bool "enable post configuration"
    depends on SENSOR_MX00_IMX390
    default n
config MX00_IMX390_IN_SLAVE_MODE
    bool "configure sensor in slave mode"
    depends on SENSOR_MX00_IMX390
    default y
config MX00_IMX390_SHORTEN_SYNC_LATENCY
    bool "shorten sync latency bwtween different VIN"
    depends on MX00_IMX390_IN_SLAVE_MODE
    default n
config MX00_IMX390_SHARING_MASTER_SYNC
    bool "share master sync between different VIN"
    depends on MX00_IMX390_IN_SLAVE_MODE
    default n

menuconfig SENSOR_MX01_IMX390
    bool "SONY IMX390 @ MAXIM 9295/96712 (in slave mode)"
    default n
config MX01_IMX390_POSTCFG_ENABLED
    bool "enable post configuration"
    depends on SENSOR_MX01_IMX390
    default n
config MX01_IMX390_IN_SLAVE_MODE
    bool "configure sensor in slave mode"
    depends on SENSOR_MX01_IMX390
    default y

menuconfig SENSOR_MX03_AR0144
    bool "OnSemi AR0144 @ MAXIM 96707/9286 (in slave mode)"
    default n
menuconfig SENSOR_MX00_AR0239
	bool "OnSemi AR0239 @ MAXIM 9295/9296 (in slave mode)"
	default n
menuconfig SENSOR_MX00_IMX390_RCCB
    bool "SONY IMX390_RCCB @ MAXIM 9295/9296 (in slave mode)"
    default n
menuconfig SENSOR_MX00_IMX424
    bool "SONY IMX424 @ MAXIM 9295/9296 (in slave mode)"
    default n
menuconfig SENSOR_MX00_AR0233
    bool "OnSemi AR0233 @ MAXIM 9295/9296 (in master mode)"
    default n
menuconfig SENSOR_MX00_OV2312_RGBIR
	bool "OV2312 RGBIR @ MAXIM 9295/9296 (in master mode)"
	default n
menuconfig SENSOR_MX00_IMX490
    bool "SONY IMX490 @ MAXIM 9295/9296 (in slave mode)"
    default n
menuconfig SENSOR_MX00_OV2778_RGBIR
	bool "OV2778 RGBIR @ MAXIM 9295/9296 (in master mode)"
	default n
endmenu
```

## rtos/cortex_a/build/kconfigs/bsp/cv28/Kconfig
```kconfig
if SOC_CV28

source build/kconfigs/bsp/cv28/peripherals/Kconfig

comment "Board Configuration"
choice CV28_BSP_SELECTION
	prompt "BSP"
	default BSP_CV28BUB_OPTION_A_V100

config BSP_CV28BUB_OPTION_A_V100
	bool "CV28 Bringup Board Option-A V100"
config BSP_CV28DK_8LAYER_A_V100
	bool "CV28 Development Kit 8-layer Option-A V100"
config BSP_CV28DK_OPTION_B_V100
	bool "CV28 Development Kit Option-B V100"
endchoice

choice CV28_DRAM_SELECTION
	prompt "Dram"
	default CV28_LPDDR4_MT53D512M16D1DS_1200MHZ

config CV28_LPDDR4_MT53D512M16D1DS_1200MHZ
	bool "MT53D512M16D1DS 1200MHz"
config CV28_LPDDR4_MT53D512M16D1DS_1596MHZ
	bool "MT53D512M16D1DS 1596MHz"
endchoice

config ATT_MAP
	string "Att Map File Name"
	default "AmbaUserMemProt"
	help
		File name of the Att Map file (remove '.c')

endif
```

## rtos/cortex_a/build/kconfigs/bsp/cv28/peripherals/Kconfig
```kconfig
menu "Peripheral Drivers"

source build/kconfigs/bsp/cv28/peripherals/display/Kconfig
source build/kconfigs/bsp/cv28/peripherals/bridge/Kconfig
source build/kconfigs/bsp/cv28/peripherals/sensor/Kconfig
source build/kconfigs/bsp/cv28/peripherals/yuvinput/Kconfig
source build/kconfigs/bsp/cv28/peripherals/audio/Kconfig

endmenu
```

## rtos/cortex_a/build/kconfigs/bsp/cv2fs/Kconfig
```kconfig
if SOC_CV2FS

source build/kconfigs/bsp/cv2fs/peripherals/Kconfig

comment "Board Configuration"
choice CV2FS_BSP_SELECTION
	prompt "BSP"
	default BSP_CV2FSBUB_OPTION_A_V100

config BSP_CV2FSBUB_OPTION_A_V100
	bool "CV2FS Bringup Board Option-A V100"
	select NAND_S34ML04G2
config BSP_CV2FSDK_OPTION_A_V110
	bool "CV2FS DK"
config BSP_CV2XFSDK_OPTION_B
	bool "CV2FS DK OPTION B"

endchoice

choice CV2FS_DRAM_SELECTION
        prompt "Dram"
        default CV2FS_LPDDR4X_MT53D512M32D2DS_1800MHZ if BSP_CV2XFSDK_OPTION_B
        default CV2FS_LPDDR4_MT53D512M32D2DS_1800MHZ

config CV2FS_LPDDR4_MT53D512M32D2DS_804MHZ
        bool "MT53D512M32D2DS 804MHz"
config CV2FS_LPDDR4_MT53D512M32D2DS_1800MHZ
        bool "MT53D512M32D2DS 1800MHz"
config CV2FS_LPDDR4X_MT53D512M32D2DS_1800MHZ
        bool "LPDDR4X MT53D512M32D2DS 1800MHz"
endchoice

config ATT_MAP
	string "Att Map File Name"
	default "AmbaUserMemProt"
	help
		File name of the Att Map file (remove '.c')

endif
```

## rtos/cortex_a/build/kconfigs/bsp/cv2fs/peripherals/Kconfig
```kconfig
menu "Peripheral Drivers"

source build/kconfigs/bsp/cv2fs/peripherals/audio/Kconfig
source build/kconfigs/bsp/cv2fs/peripherals/display/Kconfig
source build/kconfigs/bsp/cv2fs/peripherals/sensor/Kconfig
source build/kconfigs/bsp/cv2fs/peripherals/yuvinput/Kconfig
source build/kconfigs/bsp/cv2fs/peripherals/bridge/Kconfig

endmenu
```

## rtos/cortex_a/build/kconfigs/bsp/cv2fs/peripherals/sensor/Kconfig
```kconfig
menu "Image Sensor Driver"

menuconfig SENSOR_SONY_IMX290_MIPI
    bool "Sony IMX290"
    default n

menuconfig SENSOR_SONY_IMX490
    bool "Sony IMX490"
    default n

menuconfig SENSOR_SONY_IMX577
    bool "Sony IMX577"
    default n
config IMX577_POSTCFG_ENABLED
    bool "enable post configuration"
    depends on SENSOR_SONY_IMX577
    default n

menuconfig SENSOR_MX00_IMX424
    bool "SONY IMX424 @ MAXIM 9295/9296 (in slave mode)"
    default n
config IMX424_RCCB_PSLIN_DISABLE
    bool "disable pesudo linear config"
    depends on SENSOR_MX00_IMX424
    default y

menuconfig SENSOR_MX00_AR0220_RCCB
	bool "OnSemi AR0220_RCCB @ MAXIM 9295/9296 (in master mode)"
	default n

menuconfig SENSOR_MX00_OV2312_RGBIR
	bool "OV2312 RGBIR @ MAXIM 9295/9296 (in master mode)"
	default n

menuconfig SENSOR_MX00_VG1762_RGBIR
	bool "VG1762 RGBIR @ MAXIM 9295/9296 (in master mode)"
	default n

menuconfig SENSOR_MX01_IMX390
    bool "SONY IMX390 @ MAXIM 9295/96712 (in slave mode)"
    default n
config MX01_IMX390_ASIL_ENABLED
    bool "enable IMX390 safety check"
    depends on SENSOR_MX01_IMX390
    default n
    
menuconfig SENSOR_MX01_IMX390_VC
    bool "SONY IMX390 @ MAXIM 9295/96712 (in master mode, with VC)"
    default n

menuconfig SENSOR_TI01_AR0220_RCCB
    bool "Onsemi AR0220_RCCB @ TI 953/954"
    default n

menuconfig SENSOR_TI01_AR0233
    bool "Onsemi AR0233 @ TI 953/954 (in slave mode)"
    default n

menuconfig SENSOR_MX01_AR0233
    bool "OnSemi AR0233 @ MAXIM 9295/96712 (in master mode)"
    default n

menuconfig SENSOR_MX00_AR0820_RCCB
    bool "OnSemi AR0820_RCCB @ MAXIM 9295/9296 (in slave mode)"
    default n
	
menuconfig SENSOR_MX00_IMX490
    bool "SONY IMX490 @ MAXIM 9295/9296 (in slave mode)"
    default n
	
menuconfig SENSOR_MX00_IMX390_RCCB
    bool "SONY IMX390_RCCB @ MAXIM 9295/9296 (in slave mode)"
    default n

menuconfig SENSOR_MX00_IMX390
    bool "SONY IMX390 @ MAXIM 9295/9296 (in slave mode)"
    default n
config MX00_IMX390_POSTCFG_ENABLED
    bool "enable post configuration"
    depends on SENSOR_MX00_IMX390
    default n    
config MX00_IMX390_ASIL_ENABLED
    bool "enable IMX390 safety check"
    depends on SENSOR_MX00_IMX390
    default n
	
menuconfig SENSOR_MX00_AR0239
	bool "OnSemi AR0239 @ MAXIM 9295/9296 (in slave mode)"
	default n
	
menuconfig SENSOR_MX03_AR0144
    bool "OnSemi AR0144 @ MAXIM 96707/9286 (in slave mode)"
    default n

menuconfig SENSOR_MX00_OX03C
    bool "OV OX03C @ MAXIM 9295/9296 (in slave mode)"
    default n
	
menuconfig SENSOR_SONY_IMX424_RCCB
    bool "Sony IMX424_RCCB"
    default n
config IMX424_RCCB_PSLIN_DISABLE
    bool "disable pesudo linear config"
    depends on SENSOR_SONY_IMX424_RCCB
    default y

choice SENSOR_MX00_AR0820_RCCB_PIN_RESET
    prompt "Select MAXIM9295 GPIO PIN for sensor reset"
	depends on SENSOR_MX00_AR0820_RCCB
    default RESET_MAX9295_GPIO4

    config RESET_MAX9295_GPIO0
        bool "GPIO0"
    config RESET_MAX9295_GPIO4
        bool "GPIO4"
endchoice

choice SENSOR_MX00_AR0820_RCCB_PIN_TRIGGER
    prompt "Select AR0820_RCCB GPIO PIN for slave trigger"
	depends on SENSOR_MX00_AR0820_RCCB
    default TRIG_SENSOR_GPIO2

    config TRIG_SENSOR_GPIO2
        bool "GPIO2"
    config TRIG_SENSOR_GPIO3
        bool "GPIO3"
endchoice

endmenu
```

## rtos/cortex_a/build/kconfigs/bsp/cv5x/Kconfig
```kconfig
if SOC_CV5

source build/kconfigs/bsp/cv5x/peripherals/Kconfig

comment "Board Configuration"
choice CV5_BSP_SELECTION
	prompt "BSP"
	default BSP_CV5BUB_OPTION_A_V100

config BSP_CV5BUB_OPTION_A_V100
	bool "CV5 Bringup Board Option-A V100"
config BSP_CV5BUB_OPTION_B_V100
	bool "CV5 Bringup Board Option-B V100"
config BSP_CV5DK_OPTION_A_V100
	bool "CV5 DK Board Option-A V100"
endchoice

choice CV5_DRAM_SELECTION
	prompt "Dram"
	default CV5_LPDDR5_2016MHZ

config CV5_LPDDR5_2880MHZ_085V
	bool "LPDDR5 2880MHZ 0.85v"
config CV5_LPDDR5_2880MHZ
	bool "LPDDR5 2880MHZ"
config CV5_LPDDR5_2496MHZ
	bool "LPDDR5 2496MHZ"
config CV5_LPDDR5_2496MHZ_070V
	bool "LPDDR5 2496MHZ 0.70v"
config CV5_LPDDR5_2016MHZ_085V
	bool "LPDDR5 2016MHZ 0.85v"
config CV5_LPDDR5_2016MHZ
	bool "LPDDR5 2016MHZ"
config CV5_LPDDR5_1200MHZ
	bool "LPDDR5 1200MHZ"
config CV5_LPDDR4_MT53D512M32D2DS_540MHZ
    bool "MT53D512M32D2DS 540MHz"
config CV5_LPDDR4_MT53D512M32D2DS_1824MHZ
    bool "MT53D512M32D2DS 1824MHz"
config CV5_LPDDR4_MT53D512M32D2DS_2112MHZ
    bool "MT53D512M32D2DS 2112MHz"
config CV5_LPDDR4_MT53E2G32D4DE_1800MHZ
    bool "MT53E2G32D4DE 1800MHz"
endchoice

endif

if SOC_CV52

source build/kconfigs/bsp/cv5x/peripherals/Kconfig

comment "Board Configuration"
choice CV52_BSP_SELECTION
	prompt "BSP"
	default BSP_CV52NDK_OPTION_A_V100

config BSP_CV52NDK_OPTION_A_V100
	bool "CV52N DK Board Option-A V100"

config BSP_CV52NDK_OPTION_B_V100
	bool "CV52N DK Board Option-B V100"
endchoice

choice CV52_DRAM_SELECTION
	prompt "Dram"
	default CV52_LPDDR4_MT53E1G32D2FW_1824MHZ
config CV52_LPDDR5_1992MHZ
	bool "LPDDR5 1992MHZ"
config CV52_LPDDR5_2496MHZ
	bool "LPDDR5 2496MHZ"
config CV52_LPDDR4_MT53E1G32D2FW_1824MHZ
    bool "LPDDR4 MT53E1G32D2FW 1824MHz"
config CV52_LPDDR4_MT53E1G32D2FW_2112MHZ
    bool "LPDDR4 MT53E1G32D2FW 2112MHz"
endchoice

endif


if SOC_CV5 || SOC_CV52

choice CV5_WDT_PIN_SELECTION
	prompt "Wdt External Function Pin"
	default WDT_PIN_NON

config WDT_PIN_GPIO_0
	bool "WDT_PIN_GPIO_0"
config WDT_PIN_GPIO_5
	bool "WDT_PIN_GPIO_5"
config WDT_PIN_GPIO_19
	bool "WDT_PIN_GPIO_19"
config WDT_PIN_GPIO_36
	bool "WDT_PIN_GPIO_36"
config WDT_PIN_GPIO_116
	bool "WDT_PIN_GPIO_116"
config WDT_PIN_GPIO_119
	bool "WDT_PIN_GPIO_119"
config WDT_PIN_GPIO_138
	bool "WDT_PIN_GPIO_138"
config WDT_PIN_NON
	bool "WDT_PIN_NON"

endchoice

config ATT_8GB
	bool "User ATT 8GB map"
	default n
	help
		User ATT 8GB map.

config ATT_MAP
	string "Att Map File Name"
	default "AmbaUserMemProt_8GB" if ATT_8GB
	default "AmbaUserMemProt"
	help
		File name of the Att Map file (remove '.c')

config ENABLE_ONE_DDRC_HOST
	bool "Enable only one ddrc host"
	default y if SOC_CV52
	default n
	help
		Enable only one ddrc host.

config RESTORE_TRAINING_RESULT
	bool "Enable restore dram training result in BST"
	default y
	help
		Enable restore dram training result in BST.

	if RESTORE_TRAINING_RESULT && DRAM_TYPE_LPDDR5
	choice RESTORE_WDELAY_SELECTION
		prompt "Write Delay update in BST"
		default BST_WDELAY_UPDATE_DRIFT if BST_DRAM_TRAINING
		default BST_WDELAY_UPDATE_NONE

	config BST_WDELAY_UPDATE_NONE
		bool "no change and use restored value"
	config BST_WDELAY_UPDATE_DRIFT
		bool "calculate by drift"
		select BST_LARGE_SIZE
	config BST_WDELAY_UPDATE_RETRAIN
		bool "retrain always"
		depends on BST_DRAM_TRAINING
	endchoice
	endif

config TEST_DRAM_SAVE_RESTORE
	bool "Enable DRAM SAVE/RESTORE parameters test in BLD"
	default n
	help
		Enable DRAM SAVE/RESTORE parameters test in BLD. (Don't enable if you have BL2)

config ENABLE_DRAM_TRAINING_EVERY_BOOT
	bool "Enable DRAM re-training every time in BLD"
	default n
	help
		Enable DRAM re-training every time in BLD.

config BST_LARGE_SIZE
	bool "Enable large size BST which use ScratchPad"
	default n
	help
		Enable large size BST which use ScratchPad.

endif
```
