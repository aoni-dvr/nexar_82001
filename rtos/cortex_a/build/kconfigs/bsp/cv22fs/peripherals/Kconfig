## rtos/cortex_a/build/kconfigs/bsp/cv5x/peripherals/Kconfig
```kconfig
menu "Peripheral Drivers"

source build/kconfigs/bsp/cv5x/peripherals/display/Kconfig
source build/kconfigs/bsp/cv5x/peripherals/bridge/Kconfig
source build/kconfigs/bsp/cv5x/peripherals/sensor/Kconfig
source build/kconfigs/bsp/cv5x/peripherals/yuvinput/Kconfig
source build/kconfigs/bsp/cv5x/peripherals/audio/Kconfig

endmenu
```

## rtos/cortex_a/build/kconfigs/bsp/cv5x/peripherals/sensor/Kconfig
```kconfig
menu "Image Sensor Driver"

menuconfig SENSOR_SONY_IMX290_MIPI
    bool "Sony IMX290"
    default n

menuconfig SENSOR_SONY_IMX455
    bool "Sony IMX455"
    default n

menuconfig SENSOR_SONY_IMX677
    bool "Sony IMX677"
    default n

menuconfig SENSOR_SONY_IMX577
    bool "Sony IMX577"
    default n
config IMX577_POSTCFG_ENABLED
    bool "enable post configuration"
    depends on SENSOR_SONY_IMX577
    default n

menuconfig SENSOR_SONY_IMX334
    bool "Sony IMX334"
    default n

menuconfig SENSOR_SONY_IMX586
    bool "Sony IMX586"
    default n

menuconfig SENSOR_SONY_IMX586
    bool "Sony IMX586"
    default n

menuconfig SENSOR_OV_OV48C40
    bool "OV OV48C40"
    default n

menuconfig SENSOR_MX00_IMX390
    bool "SONY IMX390 @ MAXIM 9295/9296 (in slave mode)"
    default n
config MX00_IMX390_POSTCFG_ENABLED
    bool "enable post configuration"
    depends on SENSOR_MX00_IMX390
    default n
config MX00_IMX390_IN_SLAVE_MODE
    bool "configure sensor in slave mode"
    depends on SENSOR_MX00_IMX390
    default y
config MX00_IMX390_SHORTEN_SYNC_LATENCY
    bool "shorten sync latency bwtween different VIN"
    depends on MX00_IMX390_IN_SLAVE_MODE
    default n
config MX00_IMX390_SHARING_MASTER_SYNC
    bool "share master sync between different VIN"
    depends on MX00_IMX390_IN_SLAVE_MODE
    default n

menuconfig SENSOR_MX01_IMX390
    bool "SONY IMX390 @ MAXIM 9295/96712 (in slave mode)"
    default n
config MX01_IMX390_POSTCFG_ENABLED
    bool "enable post configuration"
    depends on SENSOR_MX01_IMX390
    default n
config MX01_IMX390_IN_SLAVE_MODE
    bool "configure sensor in slave mode"
    depends on SENSOR_MX01_IMX390
    default y
    
menuconfig SENSOR_MX01_IMX390_VC
    bool "SONY IMX390 @ MAXIM 9295/96712 (in master mode, with VC)"
    default n   

menuconfig SENSOR_MX03_AR0144
    bool "OnSemi AR0144 @ MAXIM 96707/9286 (in slave mode)"
    default n
menuconfig SENSOR_MX00_AR0239
	bool "OnSemi AR0239 @ MAXIM 9295/9296 (in slave mode)"
	default n
menuconfig SENSOR_MX00_IMX390_RCCB
    bool "SONY IMX390_RCCB @ MAXIM 9295/9296 (in slave mode)"
    default n

menuconfig SENSOR_MX00_IMX424
    bool "SONY IMX424 @ MAXIM 9295/9296 (in slave mode)"
    default n
config IMX424_RCCB_PSLIN_DISABLE
    bool "disable pesudo linear config"
    depends on SENSOR_MX00_IMX424
    default y

menuconfig SENSOR_MX04_AR0233
    bool "OnSemi AR0233 @ MAXIM 96717/96716 (in slave mode)"
    default n
menuconfig SENSOR_MX00_AR0233
    bool "OnSemi AR0233 @ MAXIM 9295/9296 (in master mode)"
    default n
menuconfig SENSOR_MX00_OV2312_RGBIR
	bool "OV2312 RGBIR @ MAXIM 9295/9296 (in master mode)"
	default n
menuconfig SENSOR_B8N_IMX290
	bool "Sony IMX290 MIPI @ B8N (in master mode)"
	default n
menuconfig SENSOR_MX00_IMX490
    bool "SONY IMX490 @ MAXIM 9295/9296 (in slave mode)"
    default n
menuconfig SENSOR_MX00_VG1762_RGBIR
    bool "ST VG1762_RGBIR @ MAXIM 9295/9296 (in master mode)"
    default n
menuconfig SENSOR_MX00_OX03C
    bool "OV OX03C @ MAXIM 9295/9296 (in slave mode)"
    default n
menuconfig SENSOR_MX01_IMX424_VC
    bool "SONY IMX424 @ MAXIM 9295/96712 (in slave mode, with VC)"
    default n  
menuconfig SENSOR_MX01_WRAPPER
    bool "A driver wrapper to combine independent sensors @ MAXIM 9295/96712"
    default n
endmenu
```

## rtos/cortex_a/build/kconfigs/bsp/cv5x/peripherals/yuvinput/Kconfig
```kconfig
menu "YUV input Driver"

menuconfig YUVINPUT_LT6911
    bool "LT6911"
    default n
config LT6911_ERASED_MCU_FW
    bool "if LT6911 MCU FW erased"
    depends on YUVINPUT_LT6911
    default n

endmenu
```

## rtos/cortex_a/build/kconfigs/bsp/h32/Kconfig
```kconfig
if SOC_H32

source build/kconfigs/bsp/h32/peripherals/Kconfig

comment "Board Configuration"
choice H32_BSP_SELECTION
	prompt "BSP"
	default BSP_H32BUB_OPTION_A_V200

config BSP_H32BUB_OPTION_A_V200
	bool "H32 Bringup Board Option-A V200"

config BSP_H32BUB_OPTION_A_V300
	bool "H32 Bringup Board Option-A V300"

config BSP_H32AQBUB_OPTION_A_V100
	bool "H32AQ Bringup Board Option-A V100"

config BSP_H32DK_V100
	bool "H32 Development Kit V100"

config BSP_H32AQDK_OPTION_B_V100
	bool "H32AQ Development Kit Option-B V100"

config BSP_H32BUB_OPTION_B_V200
	bool "H32 Bringup Board Option-B V200"

config BSP_H32_NEXAR_D081
	bool "H32 Nexar D081"
endchoice

choice H32_DRAM_SELECTION
	prompt "Dram"
	default H32_LPDDR4_MT53D512M16D1DS_1596MHZ

config H32_LPDDR4_MT53D512M16D1DS_1200MHZ
	bool "LPDDR4 MT53D512M16D1DS 1200MHz"
config H32_LPDDR4_MT53D512M16D1DS_1596MHZ
	bool "LPDDR4 MT53D512M16D1DS 1596MHz"
config H32_LPDDR4_IS43LQ16256A062BLI_1596MHZ
	bool "LPDDR4 IS43LQ16256A062BLI 1596MHz"
config H32_DDR4_MT40A512M16LY_1596MHZ
	bool "DDR4 MT40A512M16LY 1596MHz"
endchoice

config ATT_MAP
	string "Att Map File Name"
	default "AmbaUserMemProt"
	help
		File name of the Att Map file (remove '.c')

endif
```

## rtos/cortex_a/build/kconfigs/bsp/h32/peripherals/Kconfig
```kconfig
menu "Peripheral Drivers"

source build/kconfigs/bsp/h32/peripherals/display/Kconfig
source build/kconfigs/bsp/h32/peripherals/bridge/Kconfig
source build/kconfigs/bsp/h32/peripherals/sensor/Kconfig
source build/kconfigs/bsp/h32/peripherals/yuvinput/Kconfig
source build/kconfigs/bsp/h32/peripherals/audio/Kconfig
source build/kconfigs/bsp/h32/peripherals/pmic/Kconfig
source build/kconfigs/bsp/h32/peripherals/imu/Kconfig

endmenu
```

## rtos/cortex_a/build/kconfigs/bsp/h32/peripherals/audio/Kconfig
```kconfig
menu "Audio codec Driver"

config AUDIO_AK4951EN
	bool "AKM AK4951EN"
	default y

config AUDIO_TITLV320AIC3007
	bool "TI tlv320aic3007"
	default y

config AUDIO_NAU8822
	bool "Nuvoton NAU8822"
	default n

config AUDIO_AMBA_SOC_DMIC
	bool "Ambarella SOC DMIC"
	default n

config AUDIO_MAX98090
	bool "MAX98090"
	default n
endmenu
```

## rtos/cortex_a/build/kconfigs/bsp/h32/peripherals/bridge/Kconfig
```kconfig
menu "Sensor and LCD bridge Driver"

menuconfig SENSOR_BRIDGE_MAX9295_9296
    bool "MAXIM MAX9295/9296"
    default n

menuconfig SENSOR_BRIDGE_MAX96707_9286
    bool "MAXIM MAX96707/9286"
    default n

endmenu
```

## rtos/cortex_a/build/kconfigs/bsp/h32/peripherals/display/Kconfig
```kconfig
menu "FPD Driver"

config FPD_WDF9648W
    bool "Wintek WDF9648W"
    default n
config FPD_WDF9648W_VOUT0
    bool "Vout0"
    depends on FPD_WDF9648W
    default n
config FPD_WDF9648W_VOUT1
    bool "Vout1"
    depends on FPD_WDF9648W
    default n

config FPD_T30P61
    bool "Shenzhen RZW T30P61"
    default n
config FPD_T30P61_VOUT0
    bool "Vout0"
    depends on FPD_T30P61
    default n
config FPD_T30P61_VOUT1
    bool "Vout1"
    depends on FPD_T30P61
    default n

config FPD_MAXIM_DUAL_TFT1280768
    bool "Dual Truly 1280x768 via Maxim 96751/96752 HDMI Serializer"
    default n
config FPD_MAXIM_DUAL_TRULY_VOUT0
    bool "Vout0"
    depends on FPD_MAXIM_DUAL_TFT1280768
    default n
config FPD_MAXIM_DUAL_TRULY_VOUT1
    bool "Vout1"
    depends on FPD_MAXIM_DUAL_TFT1280768
    default n

config FPD_MAXIM_DUAL_ZS095BH
    bool "MAXIM DUAL ZS095BH"
    default n

menuconfig VOUT0_DEVICE_NAME
    string "VOUT0_DEVICE_NAME"
    depends on FPD_WDF9648W_VOUT0 || FPD_T30P61_VOUT0
    default "WdF9648w"          if FPD_WDF9648W_VOUT0
    default "T30P61"            if FPD_T30P61_VOUT0

menuconfig VOUT1_DEVICE_NAME
    string "VOUT1_DEVICE_NAME"
    depends on FPD_WDF9648W_VOUT1 || FPD_T30P61_VOUT1 || FPD_MAXIM_DUAL_TRULY_VOUT1
    default "WdF9648w"          if FPD_WDF9648W_VOUT1
    default "T30P61"            if FPD_T30P61_VOUT1
    default "MAXIM_Dual_TFT128" if FPD_MAXIM_DUAL_TRULY_VOUT1

endmenu
```

## rtos/cortex_a/build/kconfigs/bsp/h32/peripherals/imu/Kconfig
```kconfig
menu "Imu Driver"

config ENABLE_IMU
        bool "enable imu"
        default n

if ENABLE_IMU
config IMU_ICM20948
	bool "AKM IMU_ICM20948"
	default n

config IMU_BMI160
	bool "IMU_BMI160"
	default n

config IMU_SH3001
	bool "IMU_SH3001"
	default n

config IMU_ICM42670
	bool "IMU_ICM42670"
	default n

config IMU_ICM42631
	bool "IMU_ICM42631"
	default n
endif
endmenu
```
