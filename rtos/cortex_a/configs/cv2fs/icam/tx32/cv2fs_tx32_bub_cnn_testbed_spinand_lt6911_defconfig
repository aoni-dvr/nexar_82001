## rtos/cortex_a/soc/dsp/Kconfig
```kconfig
menu "DSP Driver"

menuconfig BUILD_DSP_VISUAL
        bool "Build DSP driver"
        default y

if BUILD_DSP_VISUAL
config ENABLE_DSP_COMMAND_PARM_DBG
    bool "Enable DSP command debug"
    default y

config ENABLE_DSP_DEBUG_LOG
    bool "Enable DSP Debug Log"
    default y

config ENABLE_DSP_MONITOR
    bool "Enable DSP monitor"
    default n

config DISABLE_SHADOW_MEMORY_WITH_DSP_MONITOR
	bool "Use rpmsg instead of shadow memory for DSP monitor"
	default n
	help
	  Asil RPMSG must use with shadow memory. QNX not support Asil RPMSG, so that must disable shadow memory.

config ENABLE_DSP_DIAG
    bool "Enable DSP diagnosis"
    default n


config DSP_PROT_CACHE_BUF_SIZE
	hex "dsp protocol cache buffer size"
	default 0x300000

config DSP_PROT_BUF_SIZE
	hex "dsp protocol buffer size"
	default 0x800000

config DSP_BIN_BUF_SIZE
	hex "dsp binary buffer size"
	default 0xC00000

config DSP_DATA_BUF_SIZE
	hex "dsp data buffer size"
    default 0x3AE00000 if SVC_APPS_ICAM && SOC_CV2FS
    default 0x38F00000 if SVC_APPS_ICAM && SOC_CV2
    default 0x38F00000 if SVC_APPS_ICAM && SOC_CV22
    default 0x33C00000 if SVC_APPS_ICAM && SOC_CV25
    default 0x1E000000 if SVC_APPS_ICAM && SOC_CV28
    default 0x24200000 if SVC_APPS_ICAM && SOC_H32
	default 0x20000000
endif

menuconfig BUILD_DSP_AUDIO
        bool "Build Audio modules"
        default y

if BUILD_DSP_AUDIO
config ENABLE_AAC_ENCODER
    bool "Enable AAC encoder"
    default y

config ENABLE_AAC_DECODER
    bool "Enable AAC decoder"
    default y
endif

menuconfig BUILD_IK
        bool "Build Ik"
        default y

endmenu
```

## rtos/cortex_a/soc/io/Kconfig
```kconfig
if ARM32

config MMU_USE_SHORT_DESCRIPTOR
	bool "MMU uses Short Descriptor Translation Table format"
	default y
	help
		Configure MMU to use Short Descriptor Translation Table format.

endif

if ARM64

choice
	prompt "Address translation granule size"
	default TRANSLATION_GRANULE_4KB
	help
	  Select virtual memory translation granule size.

config TRANSLATION_GRANULE_4KB
	bool "4KB"

config TRANSLATION_GRANULE_16KB
	bool "16KB"

config TRANSLATION_GRANULE_64KB
	bool "64KB"

endchoice

endif

config BUILD_SSP_ENET
	bool "Build Ethernet driver"
	depends on !LINUX
	default n
	help

if BUILD_SSP_ENET
config BUILD_SSP_ENET_MTU
	bool "Change MTU Size"
	default n
if BUILD_SSP_ENET_MTU
config ETH_FRAMES_SIZE
	int "Valid range 1514~3840"
	range 1514 3840
	default 1514
endif
endif

config PIO_MEM_ALLOC
	bool "Build Peripheral Memory Allocator"
	default n
	help

if PIO_MEM_ALLOC
config PIO_BASE
	hex "Peripheral Memory Base"
	default 0x7fa00000
	help
		The base address of Peripheral IO memory
config PIO_SIZE
	hex "Peripheral Memory Size"
	default 0x600000
	range 0x200000 0x100000000
	help
		The size of total Peripheral IO memory including both cached & non-cached
if THREADX
config PIO_NONCHED_SIZE
	hex
	default 0x100000
	help
		Cached Peripheral IO memory size, this is sub-part of PIO_SIZE
endif
endif

config VIN_ASIL
	bool "Build VIN ASIL driver"
	depends on AMBALINK_RPMSG_ASIL
	default y

config VOUT_ASIL
	bool "Build VOUT ASIL driver"
	depends on AMBALINK_RPMSG_ASIL
	default y

config BUILD_SSP_OTP
	bool "Build OTP driver"
	default n
	help

##############################################################
# USB part
##############################################################

menuconfig BUILD_SSP_USB_LIBRARY
	bool "Build Universal Serial Bus (USB) subsystem library"
	depends on !LINUX
	default y
	help

if BUILD_SSP_USB_LIBRARY
source vendors/ambarella/wrapper/usb/Kconfig
endif

config BUILD_SSP_PCIE_LIB
	bool "Build PCIE driver"
	depends on !LINUX
	default n
	help
```

## rtos/cortex_a/soc/io/build/threadx/Kconfig
```kconfig
if ARM32

config MMU_USE_SHORT_DESCRIPTOR
	bool "MMU uses Short Descriptor Translation Table format"
	default y
	help
		Configure MMU to use Short Descriptor Translation Table format.

endif

if ARM64

choice
	prompt "Address translation granule size"
	default TRANSLATION_GRANULE_4KB
	help
	  Select virtual memory translation granule size.

config TRANSLATION_GRANULE_4KB
	bool "4KB"

config TRANSLATION_GRANULE_16KB
	bool "16KB"

config TRANSLATION_GRANULE_64KB
	bool "64KB"

endchoice

endif

config BUILD_SSP_ENET
	bool "Build Ethernet driver"
	default n
	help

if BUILD_SSP_ENET
config BUILD_SSP_ENET_MTU
	bool "Change MTU Size"
	default n
if BUILD_SSP_ENET_MTU
config ETH_FRAMES_SIZE
	int "Valid range 1514~3840"
	range 1514 3840
	default 1514
endif
endif

##############################################################
# USB part
##############################################################

config BUILD_SSP_USB_LIBRARY
	bool "Build Universal Serial Bus (USB) subsystem library"
	default y
	help

if BUILD_SSP_USB_LIBRARY
source vendors/ambarella/wrapper/usb/Kconfig
endif
```

## rtos/cortex_a/soc/vision/Kconfig
```kconfig
menu "Ambarella CV sub-system"
    depends on SOC_CV2 || SOC_CV22 || SOC_CV25 || SOC_CV28 || SOC_CV2A || SOC_CV22A || SOC_CV2FS || SOC_CV22FS || SOC_CV5 || SOC_CV52

config CV_MEM_SIZE
	hex "CV memory size"
        default 0x20000000 if BUILD_CV
        default 0x0
	help
	  The size of CV memory partition

config CV_MEM_RTOS_SIZE
	hex "CV RTOS USER memory size"
        default 0x0
	help
	  The size of CV RTOS memory which is inside the CV memory.
	  This area is used by flexidag to allocate IO buffers.
	depends on AMBALINK_BOOT_OS

config CV_MEM_SCHDR_SIZE
	hex "CV SCHDR memory size"
        default 0x4000000 if BUILD_CV
        default 0x0
	help
		SCHDR_SIZE is used for RTOS and Linux

menuconfig BUILD_CV
	bool "Computer Vision for CVx"
	default y

config CV_CONFIG_FILE
	string "file name of CV configuration"
	default "default"
	help
	  the file name of ambacv configuration

config DISABLE_ARM_CVTASK
	bool "Disable arm cvtask"
	help
	  Arm cvtask support is for develop purpose
        default n

config DISABLE_CAVALRY
	bool "Disable cavalry"
	help
	  Cavalry support is for develop purpose
    	default n

config BUILD_CV_THREADX
	bool "Enable to build ambacv with ThreadX"
	default y
	depends on BUILD_CV

config ENABLE_CV_MONITOR
	bool "Enable CV safety monitor"
	default n
	depends on BUILD_CV

config THPOOL_EXTRA_PER_THREAD
	int "extra thread for blockable cvtack per-thread"
	default 2
	depends on !DISABLE_ARM_CVTASK
	help
	  Extra thread for running blockable cvtask

config THPOOL_PRIORITY
	int "thread pool priority"
	default 40
	depends on !DISABLE_ARM_CVTASK
	help
	  Thread priority for runing unblockable cvtask

config EXTRA_THPOOL_PRIORITY
	int "extra thread pool priority"
	default 39
	depends on !DISABLE_ARM_CVTASK
	help
	  Thread priority for running blockable cvtask

config THPOOL_STACK_SIZE
	hex "thread pool stack size"
	default 0x20000
	depends on !DISABLE_ARM_CVTASK
	help
	  Thread stack size for runing unblockable cvtask

config EXTRA_THPOOL_STACK_SIZE
	hex "extra thread pool stack size"
	default 0x20000
	depends on !DISABLE_ARM_CVTASK
	help
	  Thread stack size for runing blockable cvtask

config CV_PROTECT_PRIORITY
	int "cv protect task priority"
	default 40
	help
	  Thread priority for running cv protection flow

config CV_PROTECT_STACK_SIZE
	hex "cv protect stack size"
	default 0x800
	help
	  Thread stack size for running cv protection flow

config CV_CV22FS
	bool "cv chip cv22fs"
	default n

endmenu
```

## rtos/cortex_a/svc/Kconfig
```kconfig
# For a description of the syntax of this configuration file,
# see build/scripts/Documentation/kbuild/kconfig-language.txt.
#
mainmenu "Ambarella SDK Configuration"

# OS (SDK platform)
source build/kconfigs/Kconfig.threadx

# boot
source boot/Kconfig

# BSP
source bsp/Kconfig

# For architecture and building system
source build/kconfigs/Kconfig.arch
source build/kconfigs/Kconfig.toolchain

# For BLD
source build/kconfigs/Kconfig.bld

# SSP
source svc/Kconfig.ssp

# Flash Partitions
source build/kconfigs/Kconfig.fwprog

# Hypervisor
source build/kconfigs/Kconfig.hypervisor

# Ambalink
source svc/comsvc/ambalink/Kconfig

# CV
source soc/vision/Kconfig

# Common Service
source svc/comsvc/Kconfig

# foss
source build/kconfigs/Kconfig.foss

source vendors/arm/arm-trusted-firmware/Kconfig

# App
source svc/apps/Kconfig
```

## rtos/cortex_a/svc/Kconfig.ssp
```kconfig
# For a description of the syntax of this configuration file,
# see build/scripts/Documentation/kbuild/kconfig-language.txt.
#
comment "System Configuration"
menu "System Support Package"

menuconfig BUILD_SSP_KAL
        bool "Build Kernel Abstraction Layer (KAL) support library"
        default y

if BUILD_SSP_KAL
source vendors/ambarella/wrapper/kal/Kconfig
endif

config BUILD_SSP_NETX
	bool "ThreadX NetX support"
	depends on THREADX
	default n
	help
	  NetX: Network protocol stack for ThreadX.

if BUILD_SSP_NETX

config NETX_ENET
	bool "Ethernet driver for Ambarella platform"
	help
	  Ethernet driver for Ambarella platform.

endif # BUILD_SSP_NETX

menuconfig BUILD_SSP_FS
        bool "Build File System (FS) support library"
        depends on !LINUX
        default y

if BUILD_SSP_FS
source vendors/ambarella/wrapper/fs/Kconfig
endif

menuconfig BUILD_SSP_DRIVER
        bool "Build SoC device driver library"
        default y

if BUILD_SSP_DRIVER
source soc/io/Kconfig
source soc/dsp/Kconfig
endif

if SOC_CV2FS
config SHADOW_SHARED_MEM_ADDR
	hex "Shadow memory address"
	default 0x7fe00000
	help
	  Shadow Area Base Memory Address
endif # SOC_CV2FS

config EXCEPTION_BACKTRACE_LEVEL
	hex "System backtrace level in exception handler"
	default 1

endmenu
```

## rtos/cortex_a/svc/apps/Kconfig
```kconfig
# For a description of the syntax of this configuration file,
# see build/scripts/Documentation/kbuild/kconfig-language.txt.
#

# For SVC
comment "SVC Applications"
menu "Applications"

choice
	prompt "Application"
	default SVC_APPS_ICAM
	help
		Select application in SVC
config SVC_APPS_ICAM
	bool "SVC_ICAM"
	help
		SVC_ICAM.
config SVC_APPS_UT
	bool "SVC_UT"
	help
		SVC_UT.
config SVC_APPS_IOUT
	bool "SVC_IOUT"
	help
		SVC_IOUT.
config SVC_APPS_CVUT
	bool "SVC_CVUT"
	help
		SVC_CVUT.
config SVC_APPS_DIAGNOSIS
	bool "SVC_DIAGNOSIS"
	help
		SVC_DIAGNOSIS.
config SVC_APPS_EX
	bool "SVC_Example_Code"
	help
		Simplest Example Codes.
endchoice

config SVC_IOUT_QNX_IMG
	bool "QNX IOUT"
	depends on SVC_APPS_UT
	depends on QNX
	help
		QNX IOUT

choice
	prompt "Example Code"
	default SVC_APPS_EX_DSP001
    depends on SVC_APPS_EX
	help
		Select example code
config SVC_APPS_EX_DSP001
   bool "DSP Driver Example #001"
   help
        DSP Driver Example APP #001
config SVC_APPS_EX_DSP002
   bool "DSP Driver Example #002"
   help
        DSP Driver Example APP #002
config SVC_APPS_EX_DSP003
   bool "DSP Driver Example #003"
   help
        DSP Driver Example APP #003
config SVC_APPS_EX_CV001
   bool "CV Example #001"
   help
        CV Example APP #001
endchoice

config SVC_APP_NAME
    string "SVC APP FOLDER NAME"
    default "icam" if SVC_APPS_ICAM
    default "ut" if SVC_APPS_UT
    default "iout" if SVC_APPS_IOUT
    default "diagnosis" if SVC_APPS_DIAGNOSIS
    default "ex" if SVC_APPS_EX
endmenu

source svc/apps/Kconfig.icam
source svc/apps/Kconfig.ut
source svc/apps/Kconfig.diagnosis
source svc/apps/Kconfig.iout
source svc/apps/Kconfig.cvut

comment "Heap Memory"
config SVC_CACHE_HEAP_SIZE
    hex "cache heap size"
    default 0x05000000 if SVC_APPS_ICAM && SOC_CV28
    default 0x08000000 if SVC_APPS_ICAM
    default 0

config SVC_IO_HEAP_SIZE
    depends on SVC_APPS_ICAM
    hex "io heap size"
    default 0x04000000

config BUILD_QNX_CVFLOW_COMM
    bool "APP CVFLOW_COMM"
    default n
    help
        CV Algorithm Evaluation APP
```

## rtos/cortex_a/svc/apps/Kconfig.cvut
```kconfig
if SVC_APPS_CVUT

menu "CVUT Project"
menuconfig APP_PROJECT_NAME
    string "APP_PROJECT_NAME"
	default "CVUT"

    config DSP_SUB_PART
    hex "dsp sub part number, When cv2xfs, 0x0 imply to cv2fs; 0x1 imply to cv22fs"
    default 0x0
endmenu

endif
```

## rtos/cortex_a/svc/apps/Kconfig.diagnosis
```kconfig
if SVC_APPS_DIAGNOSIS

menu "Diagnosis Project"
    choice
        prompt "TestItem"
        default BUILD_HWSCAN
        help
            Select application in diagnosis

        config BUILD_HWSCAN
            bool "Hardware scan"

        config BUILD_DSPCFG
            bool "Dsp configuration"

        config BUILD_DSPSTATE
            bool "Dsp state test"

    endchoice

    config TEST_ITEM_NAME
        string "Test item folder name"
        default "hwscan" if BUILD_HWSCAN
        default "dspcfg" if BUILD_DSPCFG
        default "dspcfg" if BUILD_DSPSTATE

    config DSP_WORK_SIZE
    hex "dsp work buffer size"
    default 0x0

    config DSP_DATA_BUF_SIZE
    hex "dsp protocol buffer size"
    default 0x0

    config DSP_SUB_PART
    hex "dsp sub part number, When cv2xfs, 0x0 imply to cv2fs; 0x1 imply to cv22fs"
    default 0x0

    config ENABLE_DSP_DATA_BUF
    bool "Enable dsp data buffer"
    default y

    config BUILD_ENGINEERING_DIAG
    bool "Engineering Diag"
    default n
if SOC_CV2FS || SOC_CV22FS
    menuconfig ENABLE_UCODE_BIST
            bool "Enable ucode bist"
            default n

    if ENABLE_UCODE_BIST
        choice
            prompt "Test data location"
            default UC_BIST_DATA_SDCARD
            help
              Select test data location.
        config UC_BIST_DATA_SDCARD
            bool "sdcard"
        config UC_BIST_DATA_NVM
            bool "nvm"
        endchoice
    endif
endif
endmenu

endif
```
