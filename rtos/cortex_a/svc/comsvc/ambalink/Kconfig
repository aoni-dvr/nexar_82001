## rtos/cortex_a/svc/comsvc/ambalink/Kconfig
```kconfig
menu "Ambalink Configuration"

config ENABLE_AMBALINK
	bool "Enable AmbaLink"
	default y if CPU_CORTEX_R52
	default n
	help
	  Enable AmbaLink module.

if ENABLE_AMBALINK

config AMBALINK_BOOT_OS
	bool
	select BUILD_FOSS_LIBFDT
	select OPENAMP if AMBALINK_RPMSG_G2
	default y if THREADX && (CPU_CORTEX_A53 || CPU_CORTEX_A76) && AMBALINK_RPMSG_G1
	default y if THREADX && CPU_CORTEX_R52 && BLD_SEQ_ATF_LINUX
	default n
	help
	  Booting Linux/OS up from RTOS.

if AMBALINK_BOOT_OS

config LNX_CFG_PATH
	string "Linux config to build. Dailybuild only"
	default "cv2_tx32_linux_bub_nand_defconfig" if SOC_CV2
	default "cv2fs_tx32_linux_bub_spinand_defconfig" if SOC_CV2FS
	default "cv5_tx64_linux_bub_spinand_defconfig" if SOC_CV5
	default "cv22_tx32_linux_bub_nand_defconfig" if SOC_CV22
	default "cv22fs_tx32_linux_bub_spinand_defconfig" if SOC_CV22FS
	default "cv25_tx32_linux_bub_nand_defconfig" if SOC_CV25
	default "cv28_tx32_linux_bub_spinand_defconfig" if SOC_CV28
	default "cv52_tx64_linux_bub_spinand_defconfig" if SOC_CV52
	default "h32_tx32_linux_bub_spinand_defconfig" if SOC_H32
	help
	  Linux config to use.

config BOOT_CORE_LINUX
	int
	default 0 if ATF_SPD_OPTEE || BLD_SEQ_LINUX
	default 1 if !ATF_SPD_OPTEE && (SOC_CV28||SOC_CV5||SOC_CV52)
	default 3 if !ATF_SPD_OPTEE && !SOC_CV28

config AMBALINK_CMDLINE
	string "Command line of AmbaLink"
	default "root=/dev/mtdblock5 rootfstype=squashfs quiet console=ttyS1 nr_cpus=4 maxcpus=1" if !ENABLE_EMMC_BOOT
	default "root=/dev/mmcblk0p5 rootfstype=ext2 rootwait ro quiet console=ttyS1 nr_cpus=4 maxcpus=1" if ENABLE_EMMC_BOOT
	help
	  Comand line parameters for AmbaLink

config AMBALINK_DISABLE_CV
	bool "Disable AmbaLink CV Kernel Driver"
	default y if !(BUILD_CV)
	default n
	help
	  If RTOS app run cv thread and launch linux parallelly,
	  cv scheduler region will be memset when linux kdriver alloc cv scheduler
	  which cause RTOS cv thread corrupted.
	  This config set linux cv driver device node to disabled.

config AMBALINK_BOOT_OS_LEGACY_5_7
	bool
	default n if (SOC_CV5 || SOC_CV52)
	default y if !(SOC_CV5 || SOC_CV52)
	help
	  Boot Linux v5.7.x and before.
	  After v5.8, the image should be placed at 2MB alignment.
	  For v5.7.x and before, the image should be placed at 0xXXX8_0000.

endif # AMBALINK_BOOT_OS

if AMBALINK_RPMSG_G2
config AMBALINK_LOCK_ADDR_AUTO
	bool "Auto Select Mutex and Spinlock Address"
	default y
endif

if !AMBALINK_RPMSG_G2
config AMBALINK_LOCK_ADDR_AUTO
	bool
	default y
	help
	  Legacy ambalink do not allow to set AMBALINK_LOCK_ADDR
endif

if !AMBALINK_LOCK_ADDR_AUTO
config AMBALINK_LOCK_ADDR
	hex "Address of Mutex/Spinlock"
	help
	  Address of Mutex and spinlock
	  It's shared by mutltiple OS/core,
	  so it would be non-cached.

config AMBALINK_LOCK_SIZE
	hex
	default 0x2000
	help
	  Memory size of locks.
	  default is 0x1000 for mutex, 0x1000 for spinlock.
endif

if SOC_CV2FS || SOC_CV22FS
config AMBALINK_RPMSG_G1
	bool "Group-1 RPMSG"
	depends on !BLD_SEQ_ATF_LINUX
	default y
	help
	  1st RPMSG (Group-1)
endif

if !SOC_CV2FS && !SOC_CV22FS
config AMBALINK_RPMSG_G1
	bool
	default y
	help
	  Legacy ambalink always have AMBALINK_RPMSG_G1
endif

if AMBALINK_BOOT_OS || AMBALINK_RPMSG_G1
config AMBALINK_MEM_SIZE
	hex "AmbaLink memory size"
	default 0x08000000
	help
	  The memory size for AmbaLink (including shared memory and linux).
endif

if AMBALINK_RPMSG_G1

config AMBALINK_SHARED_MEM_ADDR
	hex "AmbaLink group-1 shared memory address"
	default 0x68000000 if AMBALINK_RPMSG_G2
	default 0x78000000 if !AMBALINK_RPMSG_G2 && !ATF_SPD_OPTEE
	default 0x77c00000 if ATF_SPD_OPTEE
	help
	  The address of ambalink shared memory for A53 RTOS & Linux.
	  This equals to __linux_start or CONFIG_FWPROG_LNX_LOADADDR - CONFIG_AMBALINK_SHARED_MEM_SIZE - 0x80000

config AMBALINK_SHARED_MEM_SIZE
	hex "AmbaLink group-1 shared memory size"
	default 0x00600000
	help
	  The size of shared memory for AmbaLink service.
	  The size is calculated from the size and number of rpmsg and some AmbaLink service,
	  such as global lock and suspend/resume service.
	  This size MUST be 2MB aligned!

config AMBALINK_RPMSG_SIZE
	int "Size of the group-1 RPSMG"
	default 2048
	help
	  The memory size of an RPMSG.

config AMBALINK_RPMSG_NUM
	int "Number of the group-1 RPSMG"
	default 2048
	help
	  The maximum number of RPMSG at the same time.
	  NOTE: Should be consistent with remote site.

endif # AMBALINK_RPMSG_G1

if SOC_CV2FS || SOC_CV22FS
config AMBALINK_RPMSG_G2
	bool "Group-2 RPMSG"
	default y if CPU_CORTEX_R52
	default n
	help
	  2nd RPMSG (Group-2)
endif

if AMBALINK_RPMSG_G2
config AMBALINK_RPMSG_ROLE_CLNT
	bool
	default y if ! CPU_CORTEX_R52
	default n

config AMBALINK_RPMSG_ROLE_MAST
	bool
	default y if CPU_CORTEX_R52
	default n

config AMBALINK_G2_SHARED_MEM_ADDR
	hex "AmbaLink group-2 shared memory address"
	default 0x7c000000
	help
	  The address of ambalink shared memory for A53 & R52.
	  This equals to CONFIG_DDR_SIZE - AMBALINK_G2_SHARED_MEM_SIZE

config AMBALINK_G2_SHARED_MEM_SIZE
	hex "AmbaLink group-2 shared memory size"
	default 0x04000000
	help
	  The size of shared memory for AmbaLink service.
	  The size is calculated from the size and number of rpmsg and some AmbaLink service,
	  such as global lock and suspend/resume service.
	  This size MUST be 2MB aligned!

config AMBALINK_G2_RPMSG_SIZE
	int "Size of the group-2 RPSMG"
	default 2048
	help
	  The memory size of the group-2 RPMSG.

config AMBALINK_G2_RPMSG_NUM
	int "Number of the group-2 RPSMG"
	default 2048
	help
	  The maximum number of the group-2 RPMSG at the same time.

config AMBALINK_RPMSG_ASIL
	bool "Enable ASIL level rpmsg"
	default y if FWPROG_R52SYS_ENABLE
	default y if CPU_CORTEX_R52
	default n if !FWPROG_R52SYS_ENABLE && !CPU_CORTEX_R52
	depends on THREADX
	help
	  Append CRC32 stamp at the end of package and timeout checking.
	  Only support local RPMSG implementation.
	  OpenAMP does not support.

endif # AMBALINK_RPMSG_G2


config AMBALINK_RPMSG_HIBER
	bool
	default n
	depends on CPU_CORTEX_A53 && !OPENAMP
	help
	  Support hibernation control by RPMSG.
	  Only support local RPMSG implementation.
	  OpenAMP does not support.

endif # ENABLE_AMBALINK

endmenu
```

## rtos/cortex_a/svc/comsvc/codec/Kconfig
```kconfig
menuconfig BUILD_COMSVC_DATAFLOW
    depends on BUILD_COMMON_SERVICE_CODEC
    bool "Build Data Flow"
    default y

if BUILD_COMSVC_DATAFLOW
source svc/comsvc/codec/lib/src/common/dataflow/Kconfig
endif

source svc/comsvc/codec/Kconfig.recorder
source svc/comsvc/codec/Kconfig.player
source svc/comsvc/codec/Kconfig.audio
source svc/comsvc/codec/Kconfig.utility
```

## rtos/cortex_a/svc/comsvc/codec/Kconfig.audio
```kconfig
menu "Audio"

config BUILD_COMAMBA_CODEC_AUDIO
    depends on BUILD_COMMON_SERVICE_CODEC
    bool "Build Codec audio"
    default y
    config AENC_NUM 
        hex "Audio encoder number (Max = 0x6)"  
        default 0x1

endmenu
```

## rtos/cortex_a/svc/comsvc/codec/Kconfig.player
```kconfig
menu "Player"
config BUILD_COMSVC_PLAYER
    depends on BUILD_COMMON_SERVICE_CODEC
    bool "Build Player"
    default y

if BUILD_COMSVC_PLAYER
config AMBA_PLAYER_MAX_NUM
    hex "max player number"
    default 0x1
endif

config BUILD_COMSVC_REFPLAYER
    depends on BUILD_COMMON_SERVICE_CODEC
    bool "Build Reference Player"
    default n

endmenu
```

## rtos/cortex_a/svc/comsvc/codec/Kconfig.recorder
```kconfig
menu "Recoder"

config BUILD_COMSVC_RECODER
    depends on BUILD_COMMON_SERVICE_CODEC
    bool "Build Recoder"
    default y

if BUILD_COMSVC_RECODER
config AMBA_REC_RMA_PRIV_SIZE
    hex "record master private size"
    default 0x10000
config AMBA_REC_RSC_PRIV_SIZE
    hex "record source private size"
    default 0x9000
config AMBA_REC_DRSC_TEXTLEN
    hex "data record source text length"
    default 0x80
config AMBA_REC_MAX_VRSC_QUELEN
    hex "video record source queue length"
    default 0x600 if SOC_CV5 || SOC_CV52
    default 0x200
config AMBA_REC_MAX_ARSC_QUELEN
    hex "audio record source queue length"
    default 0x200
config AMBA_REC_MAX_DRSC_QUELEN
    hex "data record source queue length"
    default 0x200
config AMBA_REC_RBX_PRIV_SIZE
    hex "record box private size"
    default 0x8300
config AMBA_REC_RDT_PRIV_SIZE
    hex "record destination private size"
    default 0x400
config AMBA_REC_NMLEVT_BUF_NUM
    hex "normal event record buffer number"
    default 0x3
config AMBA_REC_RBX_MP4_BUF_NUM
    hex "record box mp4 fragment buffer number"
    default 0x00000002
config AMBA_REC_GDMA_USED
    bool "use GDMA for buffer copy"
	default n if SOC_CV5 || SOC_CV52
	default y
config AMBA_REC_FMP4_MEHD_BOX
    bool "insert mehd box in fmp4"
	default n
endif

endmenu
```

## rtos/cortex_a/svc/comsvc/codec/Kconfig.utility
```kconfig
menu "Utility"

config BUILD_COMAMBA_CODEC_COMMON
    depends on BUILD_COMMON_SERVICE_CODEC
    bool "Build Codec Utility"
    default y

if BUILD_COMAMBA_CODEC_COMMON
config AMBA_VFS_ASYNC_MAX_NUM
    hex "max number of async files"
    default 0x00000004
config AMBA_VFS_BANK_PER_FILE
    hex "num of banks per file"
    default 0x00000004
config AMBA_VFS_BANK_SIZE
    hex "bank size"
    default 0x00080000
config AMBA_VFS_GDMA_USED
    bool "use GDMA for buffer copy"
    default y
endif

endmenu
```

## rtos/cortex_a/svc/comsvc/codec/lib/src/common/dataflow/Kconfig
```kconfig
config BUILD_COMSVC_FIFO
    depends on BUILD_COMSVC_DATAFLOW
    bool "Build FIFO"
    default y

config BUILD_COMSVC_CONTAINER
    bool "Build Container Service"
	depends on BUILD_COMSVC_DATAFLOW
    default y

if BUILD_COMSVC_CONTAINER
source svc/comsvc/codec/lib/src/common/dataflow/Kconfig.container
endif
```

## rtos/cortex_a/svc/comsvc/codec/lib/src/common/dataflow/Kconfig.container
```kconfig
menu "Container Service Config"
depends on BUILD_COMSVC_CONTAINER

config BUILD_COMSVC_MUXER
    depends on BUILD_COMSVC_CONTAINER
    bool "Build Container Muxer"
    default y

menu "Muxing Format"
    depends on BUILD_COMSVC_CONTAINER

config BUILD_COMSVC_MX_FMP4
    depends on BUILD_COMSVC_CONTAINER
    bool "Build Container FMP4 Muxing Format"
    default y
config BUILD_COMSVC_MX_EXIF
    depends on BUILD_COMSVC_CONTAINER
    bool "Build Container EXIF Muxing Format"
    default y

endmenu

config BUILD_COMSVC_DEMUXER
    depends on BUILD_COMSVC_MUXER
    bool "Build Container Demuxer"
    default y

menu "Demuxing Format"
    depends on BUILD_COMSVC_DEMUXER

config BUILD_COMSVC_DX_FMP4
    depends on BUILD_COMSVC_DEMUXER
    bool "Build Container FMP4 Demuxing Format"
    default y

config BUILD_COMSVC_DX_MP4
    depends on BUILD_COMSVC_DEMUXER
    bool "Build Container MP4 Demuxing Format"
    default y

config BUILD_COMSVC_DX_EXIF
    depends on BUILD_COMSVC_DEMUXER
    bool "Build Container EXIF Demuxing Format"
    default y

endmenu

config BUILD_COMSVC_STREAM
    depends on BUILD_COMSVC_CONTAINER
    bool "Build Container Stream"
    default y

menu "I/O Stream"
    depends on BUILD_COMSVC_STREAM

config BUILD_COMSVC_FILE
    depends on BUILD_COMSVC_STREAM
    bool "Build Container File Stream"
    default y

endmenu

config SUPPORT_SDK7_SVC_CLIPS
    depends on BUILD_COMSVC_CONTAINER
    bool "Support SDK7 SVC Clips"
    default n

config ENABLE_CAPTURE_TIME_MODE
    depends on BUILD_COMSVC_CONTAINER
    bool "Enable Capture Time Mode"
    default n

endmenu
```

## rtos/cortex_a/svc/comsvc/cv/Kconfig
```kconfig
config CV_EXTERNAL_MSG_THREAD
    bool "Enable external message thread loop"
    default y

menu "CV Configuration"

config CV_FLEXIDAG_UT
    bool "Enable FlexidagUT"
    default n

config CV_FLEXIDAG_AMBAODFC
    bool "Enable FlexidagAmbaODFC"
    default n

config CV_FLEXIDAG_AMBAODEM
    bool "Enable FlexidagAmbaODEM"
    default n

config CV_FLEXIDAG_AMBASEGFC
    bool "Enable FlexidagAmbaSEGFC"
    default n

config CV_FLEXIDAG_AMBASEGAVM
    bool "Enable FlexidagAmbaSEGAVM"
    default n

config CV_FLEXIDAG_AMBAOD37FC
    bool "Enable FlexidagAmbaOD37FC"
    default n

config CV_FLEXIDAG_AMBASEG39FC
    bool "Enable FlexidagAmbaSeg39FC"
    default n

config CV_FLEXIDAG_AMBAPERCEPTION
    bool "Enable FlexidagAmbaPerception"
    default n

config CVALGO_CT_SAMPLE
    bool "Enable CT sample CvAlgo"
    default n

config CV_FLEXIDAG_STIXEL
    bool "Enable FlexidagStixel"
    default n

config CV_FLEXIDAG_STIXEL_V2
    bool "Enable FlexidagStixel V2"
    default n

config BUILD_CTFW
    bool "Build CTFW"
    default n

endmenu
```

## rtos/cortex_a/svc/comsvc/dcf/Kconfig
```kconfig
config BUILD_COMSVC_DCFCORE
    depends on BUILD_COMMON_SERVICE_DCF
    bool "Build DCF Core"
    default y
```

## rtos/cortex_a/svc/comsvc/imgfrw/Kconfig
```kconfig
config BUILD_IMGFRW_AAA
    bool "Build imgfrw aaa functions"
    default y
config BUILD_IMGFRW_RAW_ENC
    bool "Build imgfrw raw enc functions"
    default y
config BUILD_IMGFRW_ISO_DIS
    bool "Build imgfrw iso disable functions"
    default n
menuconfig BUILD_IMGFRW_EFOV
    bool "Build imgfrw ext fov functions"
    default n
if BUILD_IMGFRW_EFOV
config BUILD_IMGFRW_EFOV_LPBK
    bool "Enable imgfrw ext fov loopback"
    default n
endif
menuconfig BUILD_IMGFRW_EIS
    bool "Build imgfrw eis functions"
    default n
if BUILD_IMGFRW_EIS
config BUILD_IMGFRW_EIS_POST
    bool "Enable imgfrw eis post process functions"
    default n
endif
config BUILD_IMGFRW_EIS_GYRODLY
    bool "Build imgfrw eis gyro delay functions"
    default n

config BUILD_IMGFRW_EIS_WARP_CT
    bool "build imgfrw eis warp convert functions"
    default n
menuconfig BUILD_IMGFRW_EIS_WARP_AC
    bool "build imgfrw eis warp accumulate functions"
    default n
if BUILD_IMGFRW_EIS_WARP_AC
config BUILD_IMGFRW_EIS_WARP_LV
    bool "Enable imgfrw eis liv (LDC) warp functions"
    default n
endif
config BUILD_IMGFRW_AF
    bool "Build imgfrw af functions"
    default n
config BUILD_IMGFRW_TD_SM_BCNT
    bool "Build imgfrw time-division sensor mode & bath counter"
    default n
config BUILD_IMGFRW_RAW_PIV
    bool "Build imgfrw raw piv functions"
    default n
config BUILD_IMGFRW_SLAVE_SS
    bool "build imgfrw slave slow shutter functions"
    default n
config BUILD_IMGFRW_HDR_SS
    bool "build imgfrw hdr slow shutter functions"
    default n
config BUILD_IMGFRW_SMC
    bool "build imgfrw slow motion capture functions"
    default n
config BUILD_IMGFRW_AAA_ADJ_EXT
    bool "build imgfrw adj external functions"
    default n
config BUILD_IMGFRW_AAA_SHR_BDY
    bool "build imgfrw ae frame shutter boundary"
    default n
config BUILD_IMGFRW_FIFO_PROT
    bool "build imgfrw fifo overflow proctect"
    default n
```

## rtos/cortex_a/svc/comsvc/imumanager/Kconfig
```kconfig
if BUILD_COMMON_SERVICE_IMUMGR

config IMUMGR_USED
    bool "Use ImuManager"
    default n

endif
```

## rtos/cortex_a/svc/comsvc/monfrw/Kconfig
```kconfig
config BUILD_MONFRW_GRAPH
	bool "Build monfrw graph functions"
    default y

config BUILD_MONFRW_SERDES
	bool "Build monfrw serdes query functions"
    default n
```

## rtos/cortex_a/svc/comsvc/net/Kconfig
```kconfig
config BUILD_COMMON_SERVICE_NET
	bool "Build amba network stacks (used only for enet)"
	default y

if BUILD_COMMON_SERVICE_NET
config AMBA_UDPIP
	bool "Amba tiny UDP/IP example stack"
	depends on THREADX
	default y
config AMBA_AVB
	bool "Amba AVB stack including gPTP, AVTP, VLAN support"
	depends on THREADX
	default y
config AMBA_AVDECC
	bool "Amba AVDECC support"
	depends on THREADX
	default n
menuconfig AMBA_RTSP
	bool "Amba RTSP"
	default n
if AMBA_RTSP
config RTSP_LINUX
    bool "RTSP run in Linux"
    depends on AMBALINK_BOOT_OS || LINUX
    default y
config AMBA_RTSP_HEVC
	bool "Amba RTSP HEVC"
	depends on AMBA_RTSP
	default n
endif
endif
```
