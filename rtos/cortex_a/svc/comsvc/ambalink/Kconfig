## rtos/cortex_a/svc/comsvc/shell/Kconfig
```kconfig
choice A53_CONSOLE_UART
	prompt "A53 Console UART"
	default A53_CONSOLE_APB_0

config A53_CONSOLE_APB_0
	bool "AMBA_UART_APB_CHANNEL0"

config A53_CONSOLE_AHB_0
	bool "AMBA_UART_AHB_CHANNEL0"

config A53_CONSOLE_AHB_1
	bool "AMBA_UART_AHB_CHANNEL1"

config A53_CONSOLE_AHB_2
	bool "AMBA_UART_AHB_CHANNEL2"

endchoice # A53_CONSOLE_UART

choice R52_CONSOLE_UART
	prompt "R52 Console UART"

config R52_CONSOLE_AHB_0
	bool "AMBA_UART_AHB_CHANNEL0"

config R52_CONSOLE_AHB_1
	bool "AMBA_UART_AHB_CHANNEL1"

endchoice
```

## rtos/cortex_a/svc/comsvc/usb/Kconfig
```kconfig
if BUILD_COMMON_SERVICE_USB

config USB_AMAGE_USED
    bool "Use USB Amage features"
    default y

endif
```

## rtos/cortex_a/vendors/ambarella/cppexample/Kconfig
```kconfig
#
# For a description of the syntax of this configuration file,
# see Documentation/kbuild/kconfig-language.txt.
#

#comment "Example to support CPP"
menu "CPP Support Example"

config BUILD_SYSCALL_LIB
	bool "Build libsyscall.a"
	default n
	select CC_CXX_SUPPORT
	help
	  The default system calls from libnosys.a are stub APIs only.
	  Customers can build their own library named libsyscall.a to replace libnosys.a
	  Please check https://sourceware.org/newlib/ for detail.

config BUILD_FOSS_OPENCV
	bool "Build OpenCV libraries"
	default n

endmenu
```

## rtos/cortex_a/vendors/ambarella/wrapper/fs/Kconfig
```kconfig
config ENABLE_EXFAT_SUPPORT
    bool "Enable EXFAT SUPPORT"
    default n
    depends on PF_EXFAT_SUPPORT

menu "PrFILE2 Config"

config PF_CHAR_CODE_SET
	string "The coding set for prfile2"
	help
		The coding set for prfile2
	default ASCII

config PF_MAX_DISK
	int "MAX disk"
	default 16

config PF_MAX_VOLUME
	int "MAX volume"
	default 16

config PF_MAX_FILE_NUM
	int "MAX file number"
	default 20

config PF_MAX_DIR_NUM
	int "Max dir number"
	default 3

config PF_MAX_CONTEXT_NUM
	int "Max context num"
	default 0

config PF_AUTO_CONTEXT_REGISTRATION
	bool "Auto context registration"
	default n

config PF_PARAM_CHECK_ENABLE
	bool "Param check enable"
	default y

config PF_FREE_CLUSTER_SEARCH_SUPPORT
	bool "Free cluster search support"
	default n

config PF_AUTO_REGCTX_SUPPORT
	bool "Auto regctx support"
	default n

config PF_MAX_EMPTY_ENTRY_DETECT
	hex "Max empty entry detect"
	default 0x1000

config PF_SEQUENTIAL_FILE_DETECT
	bool "Sequential file detect"
	default y

config PF_UNICODE_INTERFACE_SUPPORT
	bool "Unicode interface support"
	default n

config PF_EXFAT_SUPPORT
	bool "exFAT support"
	default y

config PF_EXFAT_SET_PERCENT_IN_USE
	bool "Set PercentInUse field for exFAT"
	default y
	depends on PF_EXFAT_SUPPORT

config PF_EXFAT_FORMAT_SUPPORT
	bool "Use exFAT format function"
	default y
	depends on PF_EXFAT_SUPPORT

config PF_EXFAT_USE_FAT_CHAIN
	bool "Use FAT chain"
	default n
	depends on PF_EXFAT_SUPPORT

endmenu
```

## rtos/cortex_a/vendors/ambarella/wrapper/kal/Kconfig
```kconfig
#
# For a description of the syntax of this configuration file,
# see Documentation/kbuild/kconfig-language.txt.
#

if THREADX

menu "ThreadX Configuration"

config KAL_THREADX_SMP
	bool "ThreadX multicore support (SMP)"
	default y
	help
	  ThreadX RTOS is available for multicore systems in both
	  Symmetric Multiprocessing (SMP) or
	  Asymmetric Multiprocessing (AMP) modes.

if KAL_THREADX_SMP
config KAL_THREADX_SMP_NUM_CORES
	int "Number of cores in ThreadX SMP environment"
	default 1
endif

config KAL_THREADX_PROFILE
	bool "ThreadX execution profile support"
	default y
	help
	  ThreadX Execution Profile is designed to track thread
	  execution time based on the hardware timer.

config KAL_THREADX_FIQ
	bool "ThreadX FIQ support"
	default y
	help
	  This option enables FIQ interrupt handling support in the
	  ThreadX assembly files.

config KAL_THREADX_GLOBAL_VFP
	bool "ThreadX save/restore VFP & NEON registers on context switch"
	default y
	help
	  This option enables VFP & NEON registers save/restore during context switch
	  for all the threads. Each thread can change its behavior by tx_thread_vfp_enable
	  and tx_thread_vfp_disable;

config KAL_THREADX_STACK_CHECK
	bool "ThreadX run-time stack checking"
	default y
	help
	  This option enables ThreadX run-time stack checking, which
	  includes analysis of how much stack has been used and
	  examination of data pattern "fences" before and after the stack area.
	  If a stack error is detected, the registered application stack error
	  handler is called. This option does result in slightly increased overhead
	  and code size.

config KAL_THREADX_EVENT_TRACE
	bool "ThreadX trace feature support"
	default n
	help
	  This option enables the internal ThreadX trace feature. The trace buffer
	  is supplied at a later time via an application call to tx_trace_enable.

endmenu
endif # THREADX

if QNX || LINUX

menu "SMP Configuration"
config SMP_CORE_NUM
	int "Number of cores in SMP environment"
	default 4
endmenu

endif
```

## rtos/cortex_a/vendors/ambarella/wrapper/usb/Kconfig
```kconfig
#
# For a description of the syntax of this configuration file,
# see Documentation/kbuild/kconfig-language.txt.
#
config BUILD_SSP_USBX_LIBRARY
	bool "Build USBX libraries"
    depends on BUILD_SSP_USB_LIBRARY
    default y
choice
    prompt "USB controller"
    depends on BUILD_SSP_USB_LIBRARY
    default BUILD_SYNOPSYS_USB2_DRIVER

    config BUILD_SYNOPSYS_USB2_DRIVER
        bool "Build Synopsys USB 2 driver"

    config BUILD_CADENCE_USB3_DRIVER
        bool "Build Cadence USB 3 libraries"
endchoice

config ENABLE_USB_DRV_DBG_MSG
	bool "Enable USB driver debug messages"
    depends on BUILD_SSP_USB_LIBRARY
    default n
```

## rtos/cortex_a/vendors/arm/arm-trusted-firmware/Kconfig
```kconfig
menu "ARM-Trusted-Firmware"

config ATF_BUILD
	bool "Build ATF from source"
	default y

config ATF_DEBUG
	bool "Debug information"
	depends on ATF_BUILD
	default n
	help
	  Include debug information.

config ATF_HAVE_BL2
	bool "Have ATF BL2"
	default n
	help
	  Boot Loader stage 2 (BL2) Trusted Boot Firmware.

if ATF_HAVE_BL2
config ATF_BL2_BASE
	hex
	default FWPROG_BLD_LOADADDR if !SOC_CV2FS
	default FWPROG_BLD2_LOADADDR if SOC_CV2FS
	help
	  For CV2FS, boot-loader runs at R52.
	  So FIP includes BL31, BL32, BL33 (A53 boot-loader), SRTOS image files.

config ATF_BL2_SIZE
	hex "Size of ATF(BL2)"
	default 0x00C00000 if ATF_SPD_OPTEE
	default 0x00A00000 if (!ATF_SPD_OPTEE && AUTO_DRAM_TRAINING)
	default 0x0003C000 if !ATF_SPD_OPTEE

endif # ATF_HAVE_BL2

config ATF_BL31_BASE
	hex "Base Address of ATF(BL31)"
	default FWPROG_ATF_LOADADDR

config ATF_BL31_SIZE
	hex "Size of ATF(BL31)"
	depends on ATF_BUILD
	default 0x0004C000 if (ATF_HAVE_BL2 && !ATF_SPD_OPTEE)
	default 0x000FC000 if (ATF_HAVE_BL2 && ATF_SPD_OPTEE)
	default 0x0003C000 if !ATF_HAVE_BL2

config ATF_SPD_OPTEE
	bool "Have OP-TEE"
	default n
	select ATF_HAVE_BL2
	help
	  Have OP-TEE as BL32.

config ATF_BL32_BASE
	hex
	default 0x00100000
	depends on ATF_SPD_OPTEE

config ATF_BL32_SIZE
	hex
	default 0x00B00000
	depends on ATF_SPD_OPTEE

config ATF_BL32_SHMEM_SIZE
	hex
	default 0x400000
	depends on ATF_SPD_OPTEE
	help
	  cf. TEE_SHMEM_SIZE in core/arch/arm/plat-ambarella/platform_config.h
	      of optee-os
	  The start address is before the end of DDR.

config ATF_BL33_BLD_BASE
	hex
	default 0x3D000000 if (DDR_SIZE <= 0x40000000)
	default 0x6D000000 if (ATF_HAVE_BL2 && !ATF_SPD_OPTEE && (DDR_SIZE > 0x40000000))
	default 0x7D000000
	depends on ATF_HAVE_BL2
	help
	  for PSCI jump to BL33 AmBoot (Temporary)

config ATF_BL33_BASE
	hex
	default FWPROG_SYS_LOADADDR if BLD_SEQ_ATF_SRTOS && !BUILD_QNX_IPL
	default FWPROG_LNX_LOADADDR if BLD_SEQ_ATF_LINUX
	default FWPROG_XEN_LOADADDR if BLD_SEQ_ATF_XEN
	default 0x6F004000 if BUILD_QNX_IPL
	depends on !ATF_HAVE_BL2
	help
	 in QNX, this set to IPL start address
	 in ThreadX/Linux, this set to ThreadX/Linux start address

config ATF_BL31_BIN
	string
	default "${srctree}/vendors/arm/arm-trusted-firmware/bin/${AMBA_CHIP_ID}/bl31.bin"

config ATF_BL32_BIN
	string "Path of BL32 optee os image"
	default "${srctree}/svc/comsvc/ambalink/linux_image/${AMBA_CHIP_ID}/tee-pager_v2.bin"
	depends on ATF_SPD_OPTEE

config ATF_BL33_BIN
	string "Path of BL33 boot loader"
	default "${srctree}/output.64/out/amba_bld.bin"
	depends on ATF_HAVE_BL2

config ATF_AMBALINK
	def_bool y

config ATF_SUSPEND_SRAM
    bool "Support suspend to SRAM and enter DDR self-refresh"
	depends on ATF_BUILD && SOC_CV5
    default n

config ATF_FIP_RTOS
	bool "Add RTOS image into ATF fip image"
	depends on BLD_SEQ_SRTOS && ATF_HAVE_BL2 && ATF_SPD_OPTEE
	default y
	help
	  Add RTOS image into FIP (Firmware Image Package)

config ATF_SCP_SIZE
	hex
	depends on ATF_FIP_RTOS
	default 0xC00000
	help
	  Size of SCP.
	  We put binary of RTOS into this partition.
	  This value is memory size.
	  It's necessary to add this region into mmap before loading image to.

config ATF_FUSA
	bool
	depends on SOC_CV2FS
	default y if !BUILD_QNX_IPL
	default n if BUILD_QNX_IPL
	help
	  FUnctional SAfety & self-diagnostic

endmenu # "ARM-Trusted-Firmware"
```
